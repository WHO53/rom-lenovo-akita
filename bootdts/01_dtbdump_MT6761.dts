/dts-v1/;

/ {
	#address-cells = <0x2>;
	#size-cells = <0x2>;
	compatible = "mediatek,MT6761";
	interrupt-parent = <0x1>;
	model = "MT6761";

	__symbols__ {
		DPIDLE = "/cpus/idle-states/dpidle";
		MCDI_CLUSTER = "/cpus/idle-states/mcdi-cluster";
		MCDI_CPU = "/cpus/idle-states/mcdi-cpu";
		SODI = "/cpus/idle-states/sodi";
		SODI3 = "/cpus/idle-states/sodi3";
		STANDBY = "/cpus/idle-states/standby";
		SUSPEND = "/cpus/idle-states/suspend";
		accdet = "/accdet";
		apdma = "/dma-controller@11000580";
		apmixed = "/apmixed@1000c000";
		audgpio = "/mt_soc_dl1_pcm@11220000";
		audio = "/audio@11220000";
		auxadc = "/auxadc@11001000";
		bat_gm30 = "/battery";
		camsys = "/camsys@15000000";
		charger = "/charger";
		chosen = "/chosen";
		clk26m = "/clocks/clk26m";
		clk32k = "/clocks/clk32k";
		consys = "/consys@18002000";
		cpu0 = "/cpus/cpu@000";
		cpu1 = "/cpus/cpu@001";
		cpu2 = "/cpus/cpu@002";
		cpu3 = "/cpus/cpu@003";
		cpu_dbgapb = "/cpu_dbgapb@0d410000";
		dbmdx = "/dbmdx";
		dbmdx_soundcard = "/dbmdx-soundcard";
		disp_color0 = "/disp_color0@1400f000";
		disp_mutex0 = "/disp_mutex0@14001000";
		dsi_te = "/dsi_te";
		dynamic_options = "/dynamic_options";
		flashlight_core = "/flashlight_core";
		flashlights_mt6370 = "/flashlights_mt6370";
		gce = "/gce@10238000";
		gce_mbox = "/gce_mbox@10238000";
		gic = "/interrupt-controller@0c000000";
		goodix_fp = "/fingerprint";
		gpio = "/gpio@10005000";
		gpio_usage_mapping = "/gpio";
		i2c0 = "/i2c0@11007000";
		i2c1 = "/i2c1@11008000";
		i2c2 = "/i2c2@11009000";
		i2c3 = "/i2c3@1100f000";
		i2c4 = "/i2c4@11011000";
		i2c5 = "/i2c5@11016000";
		i2c6 = "/i2c6@1100d000";
		i2c7 = "/i2c7";
		i2c8 = "/i2c8";
		i2c9 = "/i2c9";
		i2c_common = "/i2c_common";
		infracfg_ao = "/infracfg_ao@10001000";
		iommu = "/m4u@10205000";
		irq_nfc = "/irq_nfc";
		kd_camera_hw1 = "/kd_camera_hw1@15040000";
		keypad = "/kp@10010000";
		lcm = "/lcm_gpio";
		led_pinctrl = "/led_pinctrl";
		lk_charger = "/lk_charger";
		main_pmic = "/mt-pmic";
		md1_sim1_hot_plug_eint = "/md1_sim1_hot_plug_eint";
		md1_sim2_hot_plug_eint = "/md1_sim2_hot_plug_eint";
		mdcldma = "/mdcldma@10014000";
		mdp_ccorr = "/mdp_ccorr0@14005000";
		mdp_rdma0 = "/mdp_rdma0@14004000";
		mdp_rsz0 = "/mdp_rsz0@14006000";
		mdp_rsz1 = "/mdp_rsz1@14007000";
		mdp_tdshp0 = "/mdp_tdshp0@1400a000";
		mdp_wdma0 = "/mdp_wdma0@14008000";
		mdp_wrot0 = "/mdp_wrot0@14009000";
		mfg_cfg = "/mfg_cfg@13ffe000";
		mipi_rx_ana_csi0a = "/mipi_rx_ana_csi0a@11c10000";
		mipi_rx_ana_csi0b = "/mipi_rx_ana_csi0b@11c11000";
		mipi_rx_ana_csi1a = "/mipi_rx_ana_csi1a@11c12000";
		mipi_rx_ana_csi1b = "/mipi_rx_ana_csi1b@11c13000";
		mipi_rx_ana_csi2a = "/mipi_rx_ana_csi2a@11c14000";
		mipi_rx_ana_csi2b = "/mipi_rx_ana_csi2b@11c15000";
		mm_mutex = "/mm_mutex@14016000";
		mmsys_config = "/mmsys_config@14000000";
		mrdump_ext_rst = "/mrdump_ext_rst";
		msdc0 = "/msdc@11230000";
		msdc0_pins_default = "/pinctrl@1000b000/msdc0@default";
		msdc0_pins_hs200 = "/pinctrl@1000b000/msdc0@hs200";
		msdc0_pins_hs400 = "/pinctrl@1000b000/msdc0@hs400";
		msdc0_register_setting_default = "/pinctrl@1000b000/msdc0@register_default";
		msdc1 = "/msdc@11240000";
		msdc1_ins = "/msdc1_ins@0";
		msdc1_pins_ddr50 = "/pinctrl@1000b000/msdc1@ddr50";
		msdc1_pins_default = "/pinctrl@1000b000/msdc1@default";
		msdc1_pins_sdr104 = "/pinctrl@1000b000/msdc1@sdr104";
		msdc1_pins_sdr50 = "/pinctrl@1000b000/msdc1@sdr50";
		msdc1_register_setting_default = "/pinctrl@1000b000/msdc1@register_default";
		msdc2 = "/msdc@11250000";
		msdc3 = "/msdc@11260000";
		msdc3_pins_default = "/pinctrl@1000b000/msdc3@default";
		msdc3_register_setting_default = "/pinctrl@1000b000/msdc3@register_default";
		mt6370_pmu = "/mt6370_pmu_dts";
		mt6370_typec = "/type_c_port0";
		mt_charger = "/mt_charger";
		mt_pmic_vaud28_ldo_reg = "/mt-pmic/ldo_regulators/ldo_vaud28";
		mt_pmic_vaux18_ldo_reg = "/mt-pmic/ldo_regulators/ldo_vaux18";
		mt_pmic_vcama_ldo_reg = "/mt-pmic/ldo_regulators/ldo_vcama";
		mt_pmic_vcamd_ldo_reg = "/mt-pmic/ldo_regulators/ldo_vcamd";
		mt_pmic_vcamio_ldo_reg = "/mt-pmic/ldo_regulators/ldo_vcamio";
		mt_pmic_vcn18_ldo_reg = "/mt-pmic/ldo_regulators/ldo_vcn18";
		mt_pmic_vcn28_ldo_reg = "/mt-pmic/ldo_regulators/ldo_vcn28";
		mt_pmic_vcn33_bt_ldo_reg = "/mt-pmic/ldo_regulators/ldo_vcn33_bt";
		mt_pmic_vcn33_wifi_ldo_reg = "/mt-pmic/ldo_regulators/ldo_vcn33_wifi";
		mt_pmic_vcore_buck_reg = "/mt-pmic/buck_regulators/buck_vcore";
		mt_pmic_vdram_ldo_reg = "/mt-pmic/ldo_regulators/ldo_vdram";
		mt_pmic_vefuse_ldo_reg = "/mt-pmic/ldo_regulators/ldo_vefuse";
		mt_pmic_vemc_ldo_reg = "/mt-pmic/ldo_regulators/ldo_vemc";
		mt_pmic_vfe28_ldo_reg = "/mt-pmic/ldo_regulators/ldo_vfe28";
		mt_pmic_vibr_ldo_reg = "/mt-pmic/ldo_regulators/ldo_vibr";
		mt_pmic_vio18_ldo_reg = "/mt-pmic/ldo_regulators/ldo_vio18";
		mt_pmic_vio28_ldo_reg = "/mt-pmic/ldo_regulators/ldo_vio28";
		mt_pmic_vldo28_ldo_reg = "/mt-pmic/ldo_regulators/ldo_vldo28";
		mt_pmic_vmc_ldo_reg = "/mt-pmic/ldo_regulators/ldo_vmc";
		mt_pmic_vmch_ldo_reg = "/mt-pmic/ldo_regulators/ldo_vmch";
		mt_pmic_vmodem_buck_reg = "/mt-pmic/buck_regulators/buck_vmodem";
		mt_pmic_vpa_buck_reg = "/mt-pmic/buck_regulators/buck_vpa";
		mt_pmic_vproc_buck_reg = "/mt-pmic/buck_regulators/buck_vproc";
		mt_pmic_vrf12_ldo_reg = "/mt-pmic/ldo_regulators/ldo_vrf12";
		mt_pmic_vrf18_ldo_reg = "/mt-pmic/ldo_regulators/ldo_vrf18";
		mt_pmic_vs1_buck_reg = "/mt-pmic/buck_regulators/buck_vs1";
		mt_pmic_vsim1_ldo_reg = "/mt-pmic/ldo_regulators/ldo_vsim1";
		mt_pmic_vsim2_ldo_reg = "/mt-pmic/ldo_regulators/ldo_vsim2";
		mt_pmic_vsram_others_ldo_reg = "/mt-pmic/ldo_regulators/ldo_vsram_others";
		mt_pmic_vsram_proc_ldo_reg = "/mt-pmic/ldo_regulators/ldo_vsram_proc";
		mt_pmic_vusb33_ldo_reg = "/mt-pmic/ldo_regulators/ldo_vusb33";
		mt_pmic_vxo22_ldo_reg = "/mt-pmic/ldo_regulators/ldo_vxo22";
		mtkfb = "/mtkfb@0";
		nfc = "/nfc";
		odm = "/odm";
		otg_iddig = "/otg_iddig";
		pericfg = "/pericfg@10003000";
		pio = "/pinctrl@1000b000";
		pmic_auxadc = "/mt-pmic/mt635x-auxadc";
		pmic_clock_buffer_ctrl = "/pmic_clock_buffer_ctrl";
		pogo_charger = "/pogo_charger";
		pwm = "/pwm@11006000";
		radio_md_cfg = "/radio_md_cfg";
		reserved_memory = "/reserved-memory";
		rt9465_slave_chr = "/rt9465_slave_chr";
		scpsys = "/scpsys@10001000";
		smart_pa = "/smart_pa";
		smi_larb0 = "/smi_larb0@14003000";
		smi_larb1 = "/smi_larb1@17010000";
		smi_larb2 = "/smi_larb2@15001000";
		spi0 = "/spi0@1100a000";
		spi1 = "/spi1@11010000";
		spi2 = "/spi2@11012000";
		spi3 = "/spi3@11013000";
		spi4 = "/spi4@11014000";
		spi5 = "/spi5@11015000";
		subpmic_pmu_eint = "/mt6370_pmu_eint";
		swtp = "/swtp";
		syscfg_pctl_0 = "/syscfg_pctl_0@10005000";
		syscfg_pctl_1 = "/syscfg_pctl_1@10002000";
		syscfg_pctl_2 = "/syscfg_pctl_2@10002200";
		syscfg_pctl_3 = "/syscfg_pctl_3@10002400";
		syscfg_pctl_4 = "/syscfg_pctl_4@10002600";
		syscfg_pctl_5 = "/syscfg_pctl_5@10002800";
		syscfg_pctl_6 = "/syscfg_pctl_6@10002a00";
		syscfg_pctl_7 = "/syscfg_pctl_7@10002c00";
		sysirq = "/intpol-controller@10200a80";
		tcpc_pd = "/tcpc_pd";
		timer = "/timer@10008000";
		topckgen = "/topckgen@10000000";
		touch = "/touch";
		uart0 = "/serial@11020000";
		uart1 = "/serial@11030000";
		venc_gcon = "/venc_gcon@17000000";
	};

	accdet {
		compatible = "mediatek,pmic-accdet";
		linux,phandle = <0x74>;
		phandle = <0x74>;
	};

	aes_top0@10016000 {
		compatible = "mediatek,aes_top0";
		reg = <0x0 0x10016000 0x0 0x1000>;
	};

	amms_control {
		compatible = "mediatek,amms";
		interrupts = <0x0 0x43 0x1>;
	};

	ap_ccif0@10209000 {
		compatible = "mediatek,ap_ccif0";
		interrupts = <0x0 0x5c 0x8>;
		reg = <0x0 0x10209000 0x0 0x1000>;
	};

	ap_ccif1@1020b000 {
		compatible = "mediatek,ap_ccif1";
		interrupts = <0x0 0x5e 0x8>;
		reg = <0x0 0x1020b000 0x0 0x1000>;
	};

	ap_ccif2@1023c000 {
		compatible = "mediatek,ap_ccif2";
		interrupts = <0x0 0x57 0x8>;
		reg = <0x0 0x1023c000 0x0 0x1000>;
	};

	ap_ccif3@1023e000 {
		compatible = "mediatek,ap_ccif3";
		interrupts = <0x0 0x5a 0x8>;
		reg = <0x0 0x1023e000 0x0 0x1000>;
	};

	ap_dma@11000000 {
		compatible = "mediatek,ap_dma";
		interrupts = <0x0 0x29 0x8>;
		reg = <0x0 0x11000000 0x0 0x1000>;
	};

	apcldmain@1021b000 {
		compatible = "mediatek,apcldmain";
		reg = <0x0 0x1021b000 0x0 0x100>;
	};

	apcldmain_ao@10014000 {
		compatible = "mediatek,apcldmain_ao";
		reg = <0x0 0x10014000 0x0 0x400>;
	};

	apcldmamisc@1021b800 {
		compatible = "mediatek,apcldmamisc";
		interrupts = <0x0 0x6d 0x4>;
		reg = <0x0 0x1021b800 0x0 0x100>;
	};

	apcldmamisc_ao@10014800 {
		compatible = "mediatek,apcldmamisc_ao";
		reg = <0x0 0x10014800 0x0 0x400>;
	};

	apcldmamisc_ao@10014c00 {
		compatible = "mediatek,apcldmamisc_ao";
		reg = <0x0 0x10014c00 0x0 0x400>;
	};

	apcldmaout@1021b400 {
		compatible = "mediatek,apcldmaout";
		reg = <0x0 0x1021b400 0x0 0x100>;
	};

	apcldmaout_ao@10014400 {
		compatible = "mediatek,apcldmaout_ao";
		reg = <0x0 0x10014400 0x0 0x400>;
	};

	apirq@1000b000 {
		compatible = "mediatek,apirq";
		interrupts = <0x0 0x73 0x4>;
		reg = <0x0 0x1000b000 0x0 0x1000>;
	};

	apmixed@1000c000 {
		#clock-cells = <0x1>;
		compatible = "mediatek,apmixed", "syscon";
		linux,phandle = <0x3b>;
		phandle = <0x3b>;
		reg = <0x0 0x1000c000 0x0 0x1000>;
	};

	atf_logger {
		compatible = "mediatek,atf_logger";
		interrupts = <0x0 0x4e 0x1>;
	};

	audio@11220000 {
		#clock-cells = <0x1>;
		compatible = "mediatek,audio", "syscon";
		linux,phandle = <0x3a>;
		phandle = <0x3a>;
		reg = <0x0 0x11220000 0x0 0x1000>;
	};

	audio_snd_card {
		compatible = "mediatek,audio_snd_card";
	};

	audio_sram@11221000 {
		compatible = "mediatek,audio_sram";
		reg = <0x0 0x11221000 0x0 0x9000>;
	};

	auxadc@11001000 {
		clock-names = "auxadc-main";
		clocks = <0x1f 0x21>;
		compatible = "mediatek,auxadc";
		interrupts = <0x0 0x14 0x2>;
		linux,phandle = <0x7a>;
		phandle = <0x7a>;
		reg = <0x0 0x11001000 0x0 0x1000>;
	};

	battery {
		CAR_TUNE_VALUE = <0x64>;
		DIFFERENCE_FULLOCV_ITH = <0xc8>;
		EMBEDDED_SEL = <0x0>;
		FG_METER_RESISTANCE = <0x4b>;
		KEEP_100_PERCENT = <0x1>;
		PMIC_MIN_VOL = <0x82dc>;
		PMIC_SHUTDOWN_CURRENT = <0x14>;
		POWERON_SYSTEM_IBOOT = <0x1f4>;
		Q_MAX_SYS_VOLTAGE_BAT0 = <0xd16>;
		Q_MAX_SYS_VOLTAGE_BAT1 = <0xd16>;
		Q_MAX_SYS_VOLTAGE_BAT2 = <0xd16>;
		Q_MAX_SYS_VOLTAGE_BAT3 = <0xd16>;
		R_FG_VALUE = <0xa>;
		SHUTDOWN_1_TIME = <0x5>;
		SHUTDOWN_GAUGE0_VOLTAGE = <0x84d0>;
		TEMPERATURE_T0 = <0x32>;
		TEMPERATURE_T1 = <0x19>;
		TEMPERATURE_T2 = <0xa>;
		TEMPERATURE_T3 = <0x0>;
		TEMPERATURE_T4 = <0xfffffff6>;
		battery0_name = "M8_NVT_4V43_5000mah";
		battery0_profile_t0 = <0x0 0xac44 0x47e 0x1fa 0xac42 0x479 0x3f5 0xabaa 0x307 0x5ef 0xab1d 0x306 0x7e9 0xaa9a 0x2ef 0x9e3 0xaa2a 0x305 0xbde 0xa9b0 0x2ee 0xdd8 0xa93f 0x2eb 0xfd2 0xa8c6 0x2d5 0x11cc 0xa84d 0x2d8 0x13c7 0xa7de 0x2ee 0x15c1 0xa76b 0x2ee 0x17bb 0xa6eb 0x2ee 0x19b5 0xa67a 0x2ee 0x1bb0 0xa601 0x2ee 0x1daa 0xa587 0x2ee 0x1fa4 0xa50e 0x2ee 0x219e 0xa496 0x2f4 0x2399 0xa424 0x307 0x2593 0xa3a9 0x307 0x278d 0xa333 0x307 0x2988 0xa2c2 0x300 0x2b82 0xa24b 0x2ee 0x2d7c 0xa1dc 0x2ee 0x2f76 0xa16d 0x2f6 0x3171 0xa0fd 0x307 0x336b 0xa08b 0x2fe 0x3565 0xa01b 0x300 0x375f 0x9fb7 0x316 0x395a 0x9f4c 0x311 0x3b54 0x9ee6 0x320 0x3d4e 0x9e7d 0x315 0x3f48 0x9e16 0x312 0x4143 0x9db7 0x320 0x433d 0x9d56 0x320 0x4537 0x9cfb 0x32c 0x4731 0x9ca0 0x339 0x492c 0x9c45 0x339 0x4b26 0x9be9 0x339 0x4d20 0x9b92 0x354 0x4f1b 0x9b3c 0x36b 0x5115 0x9ae0 0x35d 0x530f 0x9a7f 0x361 0x5509 0x9a08 0x34d 0x5704 0x9985 0x32a 0x58fe 0x9907 0x310 0x5af8 0x98a1 0x307 0x5cf2 0x984c 0x2f7 0x5eed 0x9802 0x2ff 0x60e7 0x97bb 0x2f6 0x62e1 0x9774 0x2ee 0x64db 0x9734 0x2ee 0x66d6 0x96f7 0x2dc 0x68d0 0x96c2 0x2e7 0x6aca 0x968f 0x2ee 0x6cc4 0x965d 0x2ee 0x6ebf 0x962a 0x2ee 0x70b9 0x95f7 0x2ee 0x72b3 0x95cc 0x302 0x74ad 0x959b 0x2f3 0x76a8 0x9571 0x2ee 0x78a2 0x9548 0x2ee 0x7a9c 0x9528 0x319 0x7c97 0x94f9 0x2f5 0x7e91 0x94d8 0x31a 0x808b 0x94b9 0x320 0x8285 0x9492 0x309 0x8480 0x9472 0x31e 0x867a 0x9454 0x337 0x8874 0x9436 0x339 0x8a6e 0x9404 0x321 0x8c69 0x93d1 0x320 0x8e63 0x9376 0x2d5 0x905d 0x9325 0x2d6 0x9257 0x92f3 0x307 0x9452 0x92c0 0x306 0x964c 0x928d 0x2ef 0x9846 0x925b 0x305 0x9a40 0x9229 0x2f0 0x9c3b 0x9200 0x307 0x9e35 0x91d8 0x304 0xa02f 0x91af 0x2f1 0xa22a 0x9185 0x307 0xa424 0x9150 0x303 0xa61e 0x9114 0x2ee 0xa818 0x90d9 0x2f3 0xaa13 0x90a4 0x30c 0xac0d 0x9063 0x31b 0xae07 0x9019 0x301 0xb001 0x8fed 0x2ee 0xb1fc 0x8fdc 0x2f4 0xb3f6 0x8fcf 0x307 0xb5f0 0x8fbb 0x315 0xb7ea 0x8f9e 0x340 0xb9e5 0x8f41 0x33c 0xbbdf 0x8e46 0x307 0xbdd9 0x8c9c 0x307 0xbfd3 0x8a62 0x30f 0xc1ce 0x875d 0x33a 0xc3c8 0x84f8 0x36b>;
		battery0_profile_t0_col = <0x3>;
		battery0_profile_t0_num = <0x64>;
		battery0_profile_t1 = <0x0 0xac6c 0x47e 0x1fa 0xabca 0x39d 0x3f5 0xab51 0x3b5 0x5ef 0xaace 0x39e 0x7e9 0xaa6b 0x3b6 0x9e3 0xa9fb 0x3b6 0xbde 0xa98b 0x3b5 0xdd8 0xa913 0x39f 0xfd2 0xa8a2 0x3b4 0x11cc 0xa82a 0x39f 0x13c7 0xa7b9 0x3b6 0x15c1 0xa740 0x3b3 0x17bb 0xa6c9 0x3a0 0x19b5 0xa64f 0x3b6 0x1bb0 0xa5d6 0x3b6 0x1daa 0xa55c 0x3b6 0x1fa4 0xa4e4 0x3ba 0x219e 0xa473 0x3cf 0x2399 0xa3fa 0x3cf 0x2593 0xa381 0x3ca 0x278d 0xa30b 0x3bb 0x2988 0xa29a 0x3cf 0x2b82 0xa222 0x3cf 0x2d7c 0xa1b3 0x3d5 0x2f76 0xa144 0x3e8 0x3171 0xa0d4 0x3e8 0x336b 0xa065 0x3e8 0x3565 0x9ff9 0x3ef 0x375f 0x9f92 0x401 0x395a 0x9f26 0x401 0x3b54 0x9ec0 0x408 0x3d4e 0x9e5b 0x41a 0x3f48 0x9df6 0x422 0x4143 0x9d91 0x433 0x433d 0x9d2f 0x43c 0x4537 0x9cd1 0x443 0x4731 0x9c70 0x43c 0x492c 0x9c15 0x455 0x4b26 0x9bb6 0x465 0x4d20 0x9b51 0x465 0x4f1b 0x9aec 0x465 0x5115 0x9a7a 0x450 0x530f 0x99ff 0x428 0x5509 0x998c 0x405 0x5704 0x991d 0x3dd 0x58fe 0x98bc 0x3cf 0x5af8 0x9861 0x3b8 0x5cf2 0x980f 0x3a9 0x5eed 0x97c4 0x39e 0x60e7 0x977c 0x390 0x62e1 0x9740 0x39d 0x64db 0x9703 0x39d 0x66d6 0x96c7 0x39d 0x68d0 0x9690 0x39d 0x6aca 0x965d 0x39d 0x6cc4 0x962b 0x39d 0x6ebf 0x95f8 0x39d 0x70b9 0x95cb 0x39d 0x72b3 0x95a3 0x3ac 0x74ad 0x957b 0x3c5 0x76a8 0x9552 0x3cf 0x78a2 0x952a 0x3cf 0x7a9c 0x9501 0x3cf 0x7c97 0x94d9 0x3bf 0x7e91 0x94b7 0x3c6 0x808b 0x9498 0x3cf 0x8285 0x9473 0x3cf 0x8480 0x9458 0x3e0 0x867a 0x9437 0x3e8 0x8874 0x9415 0x3e8 0x8a6e 0x93f0 0x3d7 0x8c69 0x93cf 0x3e1 0x8e63 0x93a2 0x3c4 0x905d 0x9377 0x3b6 0x9257 0x934e 0x3b6 0x9452 0x9326 0x3b6 0x964c 0x92ee 0x3a3 0x9846 0x92c1 0x39d 0x9a40 0x9299 0x39d 0x9c3b 0x9270 0x389 0x9e35 0x9250 0x398 0xa02f 0x9229 0x39d 0xa22a 0x91f9 0x39d 0xa424 0x91c6 0x39d 0xa61e 0x918b 0x39d 0xa818 0x9158 0x39d 0xaa13 0x9125 0x3b2 0xac0d 0x90d8 0x3a0 0xae07 0x9087 0x39d 0xb001 0x905a 0x387 0xb1fc 0x904d 0x3b1 0xb3f6 0x903a 0x39f 0xb5f0 0x902f 0x3cc 0xb7ea 0x9008 0x3cf 0xb9e5 0x8fce 0x3e6 0xbbdf 0x8f03 0x3d0 0xbdd9 0x8d6d 0x3cf 0xbfd3 0x8b3c 0x3e7 0xc1ce 0x8853 0x419 0xc3c8 0x83e0 0x465>;
		battery0_profile_t1_col = <0x3>;
		battery0_profile_t1_num = <0x64>;
		battery0_profile_t2 = <0x0 0xac8a 0x4e2 0x1fa 0xabde 0x60e 0x3f5 0xab51 0x5f5 0x5ef 0xaae1 0x5f4 0x7e9 0xaa68 0x5dc 0x9e3 0xa9f9 0x5dc 0xbde 0xa98a 0x5da 0xdd8 0xa91a 0x5c3 0xfd2 0xa8aa 0x5be 0x11cc 0xa830 0x594 0x13c7 0xa7b8 0x5ad 0x15c1 0xa746 0x5bc 0x17bb 0xa6c5 0x595 0x19b5 0xa654 0x5aa 0x1bb0 0xa5db 0x5aa 0x1daa 0xa561 0x5aa 0x1fa4 0xa4e8 0x5a5 0x219e 0xa46e 0x591 0x2399 0xa3f7 0x597 0x2593 0xa385 0x5a4 0x278d 0xa30e 0x597 0x2988 0xa29c 0x5a3 0x2b82 0xa226 0x598 0x2d7c 0xa1b6 0x5aa 0x2f76 0xa147 0x5b2 0x3171 0xa0d8 0x5c3 0x336b 0xa068 0x5c3 0x3565 0x9ffc 0x5cb 0x375f 0x9f93 0x5dc 0x395a 0x9f28 0x5dc 0x3b54 0x9ec2 0x5e5 0x3d4e 0x9e5d 0x5f5 0x3f48 0x9df4 0x5ff 0x4143 0x9d89 0x60e 0x433d 0x9d28 0x619 0x4537 0x9cc8 0x627 0x4731 0x9c63 0x627 0x492c 0x9c07 0x633 0x4b26 0x9bac 0x634 0x4d20 0x9b4b 0x633 0x4f1b 0x9ae5 0x626 0x5115 0x9a7b 0x5e6 0x530f 0x9a0a 0x5c3 0x5509 0x9997 0x5a7 0x5704 0x9927 0x574 0x58fe 0x98c3 0x550 0x5af8 0x9868 0x537 0x5cf2 0x9813 0x52d 0x5eed 0x97c2 0x51d 0x60e7 0x977e 0x524 0x62e1 0x973b 0x51d 0x64db 0x96fa 0x514 0x66d6 0x96be 0x503 0x68d0 0x9688 0x50c 0x6aca 0x9655 0x514 0x6cc4 0x961b 0x502 0x6ebf 0x95ed 0x50d 0x70b9 0x95bd 0x514 0x72b3 0x9592 0x514 0x74ad 0x956a 0x527 0x76a8 0x9541 0x51a 0x78a2 0x9519 0x528 0x7a9c 0x94f8 0x52d 0x7c97 0x94d2 0x52d 0x7e91 0x94b1 0x542 0x808b 0x948b 0x546 0x8285 0x946b 0x546 0x8480 0x944c 0x546 0x867a 0x942e 0x546 0x8874 0x9418 0x55c 0x8a6e 0x93fb 0x55f 0x8c69 0x93dd 0x55f 0x8e63 0x93be 0x55f 0x905d 0x93a0 0x55f 0x9257 0x9382 0x55f 0x9452 0x935a 0x52f 0x964c 0x9331 0x52d 0x9846 0x92ff 0x4fc 0x9a40 0x92e0 0x514 0x9c3b 0x92b8 0x514 0x9e35 0x9299 0x52c 0xa02f 0x9270 0x514 0xa22a 0x923e 0x515 0xa424 0x920a 0x52c 0xa61e 0x91ce 0x516 0xa818 0x919c 0x52f 0xaa13 0x9168 0x548 0xac0d 0x9128 0x55c 0xae07 0x90cf 0x546 0xb001 0x908f 0x549 0xb1fc 0x907b 0x563 0xb3f6 0x9067 0x57c 0xb5f0 0x9051 0x595 0xb7ea 0x9031 0x5b3 0xb9e5 0x8ffa 0x5e6 0xbbdf 0x8f5f 0x60e 0xbdd9 0x8df3 0x61f 0xbfd3 0x8bd5 0x682 0xc1ce 0x88fb 0x75f 0xc3c8 0x8638 0x866>;
		battery0_profile_t2_col = <0x3>;
		battery0_profile_t2_num = <0x64>;
		battery0_profile_t3 = <0x0 0xac4e 0x726 0x1fa 0xaba2 0x8b1 0x3f5 0xab1f 0x898 0x5ef 0xaaa5 0x897 0x7e9 0xaa2c 0x87f 0x9e3 0xa9bd 0x87f 0xbde 0xa94d 0x87d 0xdd8 0xa8d5 0x866 0xfd2 0xa866 0x866 0x11cc 0xa7ed 0x864 0x13c7 0xa773 0x84d 0x15c1 0xa6fa 0x84d 0x17bb 0xa67f 0x846 0x19b5 0xa5fd 0x81f 0x1bb0 0xa583 0x830 0x1daa 0xa50a 0x81b 0x1fa4 0xa490 0x81b 0x219e 0xa417 0x81b 0x2399 0xa39d 0x81b 0x2593 0xa326 0x81b 0x278d 0xa2b4 0x81b 0x2988 0xa23d 0x821 0x2b82 0xa1cb 0x82e 0x2d7c 0xa155 0x822 0x2f76 0xa0e5 0x82d 0x3171 0xa071 0x822 0x336b 0xa009 0x834 0x3565 0x9f99 0x834 0x375f 0x9f2d 0x83c 0x395a 0x9ec8 0x85d 0x3b54 0x9e5f 0x87f 0x3d4e 0x9df0 0x888 0x3f48 0x9d84 0x8a1 0x4143 0x9d1b 0x8a8 0x433d 0x9cb0 0x8a1 0x4537 0x9c48 0x89e 0x4731 0x9bdd 0x87f 0x492c 0x9b78 0x875 0x4b26 0x9b0e 0x851 0x4d20 0x9aa3 0x834 0x4f1b 0x9a3e 0x829 0x5115 0x99d0 0x7f9 0x530f 0x995f 0x7c4 0x5509 0x98fa 0x7ab 0x5704 0x9895 0x785 0x58fe 0x983a 0x76c 0x5af8 0x97ea 0x75f 0x5cf2 0x9799 0x73a 0x5eed 0x9753 0x714 0x60e7 0x9711 0x708 0x62e1 0x96cf 0x6ed 0x64db 0x9692 0x6c8 0x66d6 0x965b 0x6bd 0x68d0 0x9623 0x691 0x6aca 0x95f2 0x663 0x6cc4 0x95bd 0x63b 0x6ebf 0x958d 0x627 0x70b9 0x9565 0x627 0x72b3 0x9536 0x617 0x74ad 0x9517 0x61e 0x76a8 0x94ef 0x72c 0x78a2 0x94c3 0x7b7 0x7a9c 0x949b 0x7c8 0x7c97 0x9479 0x7e1 0x7e91 0x9454 0x7d7 0x808b 0x9433 0x7f4 0x8285 0x9414 0x802 0x8480 0x93f6 0x802 0x867a 0x93d7 0x802 0x8874 0x93b9 0x802 0x8a6e 0x93a2 0x815 0x8c69 0x9386 0x807 0x8e63 0x9378 0x816 0x905d 0x935e 0x81b 0x9257 0x9340 0x81b 0x9452 0x9321 0x81b 0x964c 0x9303 0x81b 0x9846 0x92dc 0x81b 0x9a40 0x92bc 0x830 0x9c3b 0x9295 0x834 0x9e35 0x926d 0x860 0xa02f 0x923b 0x87c 0xa22a 0x91f7 0x868 0xa424 0x91c2 0x894 0xa61e 0x9186 0x8af 0xa818 0x9149 0x8c9 0xaa13 0x910e 0x910 0xac0d 0x90b5 0x92d 0xae07 0x9063 0x946 0xb001 0x9043 0x990 0xb1fc 0x9024 0x9dc 0xb3f6 0x9006 0xa41 0xb5f0 0x8fe7 0xada 0xb7ea 0x8fb3 0xbbf 0xb9e5 0x8f31 0xcf8 0xbbdf 0x8dce 0xf24 0xbdd9 0x8b81 0x1446 0xbfd3 0x883f 0x270e 0xc1ce 0x84d0 0x1e78 0xc3c8 0x84d0 0x1e78>;
		battery0_profile_t3_col = <0x3>;
		battery0_profile_t3_num = <0x64>;
		battery0_profile_t4 = <0x0 0xac6c 0xbb8 0x1fa 0xab98 0x141e 0x3f5 0xaaf6 0x1434 0x5ef 0xaa69 0x13d2 0x7e9 0xa9e6 0x13bb 0x9e3 0xa976 0x13ce 0xbde 0xa8f4 0x1388 0xdd8 0xa883 0x1384 0xfd2 0xa801 0x1353 0x11cc 0xa790 0x1337 0x13c7 0xa717 0x1308 0x15c1 0xa69c 0x12eb 0x17bb 0xa61b 0x12bc 0x19b5 0xa5a9 0x12a3 0x1bb0 0xa529 0x128a 0x1daa 0xa4b6 0x126c 0x1fa4 0xa436 0x1243 0x219e 0xa3c7 0x1243 0x2399 0xa353 0x1238 0x2593 0xa2d4 0x1211 0x278d 0xa264 0x1211 0x2988 0xa1f2 0x1204 0x2b82 0xa179 0x11d8 0x2d7c 0xa102 0x11bf 0x2f76 0xa090 0x11a5 0x3171 0xa01a 0x1194 0x336b 0x9fad 0x1194 0x3565 0x9f45 0x119c 0x375f 0x9ed5 0x11ad 0x395a 0x9e62 0x11bf 0x3b54 0x9de9 0x11d6 0x3d4e 0x9d6f 0x11bc 0x3f48 0x9cf6 0x11a3 0x4143 0x9c7c 0x1175 0x433d 0x9c03 0x1134 0x4537 0x9b8e 0x1101 0x4731 0x9b1e 0x10da 0x492c 0x9ab8 0x10cc 0x4b26 0x9a58 0x10b4 0x4d20 0x99f3 0x108e 0x4f1b 0x9993 0x108e 0x5115 0x9933 0x108d 0x530f 0x98d3 0x1074 0x5509 0x9878 0x1068 0x5704 0x9822 0x1076 0x58fe 0x97d1 0x1081 0x5af8 0x9786 0x108f 0x5cf2 0x973f 0x109a 0x5eed 0x96f8 0x109a 0x60e7 0x96b1 0x109a 0x62e1 0x9677 0x10b9 0x64db 0x963e 0x10dc 0x66d6 0x9601 0x10f5 0x68d0 0x95c4 0x10fe 0x6aca 0x9595 0x1120 0x6cc4 0x9566 0x1152 0x6ebf 0x9533 0x1174 0x70b9 0x9507 0x118d 0x72b3 0x94df 0x11b8 0x74ad 0x94af 0x11c6 0x76a8 0x948b 0x11fe 0x78a2 0x9465 0x1224 0x7a9c 0x943d 0x123d 0x7c97 0x941c 0x1257 0x7e91 0x9406 0x1284 0x808b 0x93ea 0x12a2 0x8285 0x93d3 0x12d0 0x8480 0x93bf 0x12ee 0x867a 0x93ab 0x131d 0x8874 0x9397 0x1365 0x8a6e 0x9382 0x13b1 0x8c69 0x936e 0x13fd 0x8e63 0x935a 0x145f 0x905d 0x933d 0x14ae 0x9257 0x931e 0x1528 0x9452 0x9300 0x15be 0x964c 0x92d8 0x1656 0x9846 0x92b9 0x1736 0x9a40 0x9291 0x181a 0x9c3b 0x925f 0x18e5 0x9e35 0x922c 0x19e2 0xa02f 0x91ef 0x1ae0 0xa22a 0x91bc 0x1c28 0xa424 0x9180 0x1d5b 0xa61e 0x9142 0x1ed8 0xa818 0x90f1 0x2070 0xaa13 0x90aa 0x2241 0xac0d 0x905b 0x249a 0xae07 0x901e 0x27ba 0xb001 0x8fe2 0x2b99 0xb1fc 0x8fb0 0x3158 0xb3f6 0x8f7c 0x3889 0xb5f0 0x8f3c 0x3f70 0xb7ea 0x8edf 0x467d 0xb9e5 0x8e62 0x4fc9 0xbbdf 0x8e62 0x4fc9 0xbdd9 0x8e62 0x4fc9 0xbfd3 0x8e62 0x4fc9 0xc1ce 0x8e62 0x4fc9 0xc3c8 0x8e62 0x4fc9>;
		battery0_profile_t4_col = <0x3>;
		battery0_profile_t4_num = <0x64>;
		battery1_name = "M8_SCUD_4V43_5000mah";
		battery1_profile_t0 = <0x0 0xa9a6 0x280 0x1f4 0xa924 0x28a 0x3e8 0xa8ac 0x28a 0x5dc 0xa834 0x28a 0x7d0 0xa7bc 0x29b 0x9c4 0xa73a 0x28a 0xbb8 0xa6cc 0x28a 0xdac 0xa654 0x28a 0xfa0 0xa5d2 0x28a 0x1194 0xa564 0x29b 0x1388 0xa4ec 0x29b 0x157c 0xa474 0x29b 0x1770 0xa3fc 0x28a 0x1964 0xa38e 0x2ab 0x1b58 0xa316 0x29b 0x1d4c 0xa2a8 0x2ab 0x1f40 0xa230 0x29b 0x2134 0xa1c2 0x29b 0x2328 0xa154 0x2ab 0x251c 0xa0e6 0x29b 0x2710 0xa078 0x2ab 0x2904 0xa014 0x2ab 0x2af8 0x9fa6 0x2ab 0x2cec 0x9f42 0x2bc 0x2ee0 0x9ed4 0x2ab 0x30d4 0x9e70 0x2ab 0x32c8 0x9e20 0x2cd 0x34bc 0x9db2 0x2ab 0x36b0 0x9d58 0x2bc 0x38a4 0x9cf4 0x2bc 0x3a98 0x9ca4 0x2dd 0x3c8c 0x9c4a 0x2cd 0x3e80 0x9bf0 0x2dd 0x4074 0x9b96 0x2cd 0x4268 0x9b46 0x2ee 0x445c 0x9af6 0x2ee 0x4650 0x9aa6 0x2ff 0x4844 0x9a56 0x30f 0x4a38 0x9a06 0x30f 0x4c2c 0x99a2 0x30f 0x4e20 0x992a 0x2ff 0x5014 0x9894 0x2bc 0x5208 0x981c 0x29b 0x53fc 0x97cc 0x2ab 0x55f0 0x977c 0x29b 0x57e4 0x9736 0x29b 0x59d8 0x96fa 0x29b 0x5bcc 0x96be 0x29b 0x5dc0 0x968c 0x2ab 0x5fb4 0x9650 0x29b 0x61a8 0x961e 0x29b 0x639c 0x95f6 0x2ab 0x6590 0x95c4 0x29b 0x6784 0x9592 0x29b 0x6978 0x9560 0x28a 0x6b6c 0x9542 0x2ab 0x6d60 0x951a 0x2ab 0x6f54 0x94f2 0x2ab 0x7148 0x94d4 0x2ab 0x733c 0x94ac 0x2ab 0x7530 0x948e 0x2bc 0x7724 0x9470 0x2bc 0x7918 0x9452 0x2cd 0x7b0c 0x942a 0x2bc 0x7d00 0x940c 0x2bc 0x7ef4 0x93f8 0x2cd 0x80e8 0x93da 0x2bc 0x82dc 0x93bc 0x2cd 0x84d0 0x939e 0x2cd 0x86c4 0x9358 0x2ab 0x88b8 0x9308 0x28a 0x8aac 0x92cc 0x29b 0x8ca0 0x92a4 0x2ab 0x8e94 0x927c 0x29b 0x9088 0x9254 0x2ab 0x927c 0x9222 0x29b 0x9470 0x9204 0x2ab 0x9664 0x91dc 0x29b 0x9858 0x91be 0x2ab 0x9a4c 0x91a0 0x2ab 0x9c40 0x916e 0x2ab 0x9e34 0x9132 0x29b 0xa028 0x90f6 0x29b 0xa21c 0x90ba 0x29b 0xa410 0x9088 0x2ab 0xa604 0x9042 0x2ab 0xa7f8 0x8fe8 0x28a 0xa9ec 0x8fd4 0x29b 0xabe0 0x8fca 0x29b 0xadd4 0x8fc0 0x2ab 0xafc8 0x8fb6 0x2bc 0xb1bc 0x8fa2 0x2cd 0xb3b0 0x8f7a 0x2dd 0xb5a4 0x8eee 0x2bc 0xb798 0x8d9a 0x2bc 0xb98c 0x8ba6 0x2cd 0xbb80 0x8912 0x2bc 0xbd74 0x8584 0x30f 0xbf68 0x7f62 0x395 0xc15c 0x7f62 0x395>;
		battery1_profile_t0_col = <0x3>;
		battery1_profile_t0_num = <0x64>;
		battery1_profile_t1 = <0x0 0xa99c 0x352 0x1f4 0xa910 0x352 0x3e8 0xa88e 0x341 0x5dc 0xa816 0x352 0x7d0 0xa79e 0x352 0x9c4 0xa726 0x363 0xbb8 0xa6ae 0x352 0xdac 0xa636 0x352 0xfa0 0xa5b4 0x341 0x1194 0xa546 0x352 0x1388 0xa4ce 0x352 0x157c 0xa456 0x352 0x1770 0xa3de 0x352 0x1964 0xa37a 0x363 0x1b58 0xa302 0x363 0x1d4c 0xa28a 0x352 0x1f40 0xa21c 0x363 0x2134 0xa1ae 0x363 0x2328 0xa140 0x363 0x251c 0xa0c8 0x352 0x2710 0xa064 0x363 0x2904 0x9ff6 0x363 0x2af8 0x9f92 0x384 0x2cec 0x9f2e 0x373 0x2ee0 0x9ed4 0x384 0x30d4 0x9e66 0x384 0x32c8 0x9e02 0x384 0x34bc 0x9da8 0x395 0x36b0 0x9d44 0x395 0x38a4 0x9cea 0x3a5 0x3a98 0x9c90 0x3b6 0x3c8c 0x9c36 0x3b6 0x3e80 0x9be6 0x3c7 0x4074 0x9b96 0x3e8 0x4268 0x9b3c 0x3d7 0x445c 0x9aec 0x3e8 0x4650 0x9a9c 0x409 0x4844 0x9a4c 0x409 0x4a38 0x99e8 0x409 0x4c2c 0x9984 0x409 0x4e20 0x98f8 0x3b6 0x5014 0x9876 0x384 0x5208 0x97fe 0x352 0x53fc 0x97ae 0x352 0x55f0 0x975e 0x341 0x57e4 0x9718 0x341 0x59d8 0x96e6 0x341 0x5bcc 0x96aa 0x341 0x5dc0 0x9678 0x341 0x5fb4 0x9646 0x341 0x61a8 0x9614 0x341 0x639c 0x95e2 0x341 0x6590 0x95ba 0x341 0x6784 0x9588 0x341 0x6978 0x9560 0x341 0x6b6c 0x9538 0x331 0x6d60 0x9510 0x331 0x6f54 0x94f2 0x352 0x7148 0x94ca 0x352 0x733c 0x94ac 0x363 0x7530 0x948e 0x352 0x7724 0x9470 0x363 0x7918 0x945c 0x373 0x7b0c 0x943e 0x363 0x7d00 0x9420 0x373 0x7ef4 0x940c 0x373 0x80e8 0x93ee 0x384 0x82dc 0x93da 0x384 0x84d0 0x93bc 0x384 0x86c4 0x939e 0x373 0x88b8 0x9376 0x363 0x8aac 0x934e 0x352 0x8ca0 0x9330 0x352 0x8e94 0x9308 0x352 0x9088 0x92ea 0x352 0x927c 0x92b8 0x341 0x9470 0x929a 0x352 0x9664 0x927c 0x352 0x9858 0x9254 0x341 0x9a4c 0x9236 0x352 0x9c40 0x920e 0x363 0x9e34 0x91d2 0x352 0xa028 0x918c 0x341 0xa21c 0x915a 0x352 0xa410 0x911e 0x341 0xa604 0x90e2 0x352 0xa7f8 0x907e 0x331 0xa9ec 0x9056 0x331 0xabe0 0x904c 0x352 0xadd4 0x9042 0x363 0xafc8 0x9038 0x363 0xb1bc 0x901a 0x363 0xb3b0 0x9006 0x395 0xb5a4 0x8fc0 0x3b6 0xb798 0x8eb2 0x3a5 0xb98c 0x8cd2 0x395 0xbb80 0x8a70 0x3c7 0xbd74 0x870a 0x41a 0xbf68 0x8188 0x514 0xc15c 0x781e 0xa17>;
		battery1_profile_t1_col = <0x3>;
		battery1_profile_t1_num = <0x64>;
		battery1_profile_t2 = <0x0 0xa938 0x51e 0x1f4 0xa88e 0x525 0x3e8 0xa802 0x535 0x5dc 0xa780 0x546 0x7d0 0xa6fe 0x535 0x9c4 0xa686 0x557 0xbb8 0xa60e 0x557 0xdac 0xa596 0x557 0xfa0 0xa514 0x557 0x1194 0xa49c 0x557 0x1388 0xa42e 0x567 0x157c 0xa3b6 0x567 0x1770 0xa33e 0x557 0x1964 0xa2d0 0x567 0x1b58 0xa258 0x567 0x1d4c 0xa1ea 0x567 0x1f40 0xa17c 0x567 0x2134 0xa10e 0x567 0x2328 0xa0a0 0x578 0x251c 0xa032 0x578 0x2710 0x9fce 0x599 0x2904 0x9f60 0x589 0x2af8 0x9efc 0x589 0x2cec 0x9e98 0x599 0x2ee0 0x9e34 0x5aa 0x30d4 0x9dd0 0x5aa 0x32c8 0x9d6c 0x5aa 0x34bc 0x9d08 0x5bb 0x36b0 0x9cb8 0x5dc 0x38a4 0x9c54 0x5dc 0x3a98 0x9c04 0x5ed 0x3c8c 0x9bb4 0x5fd 0x3e80 0x9b50 0x5ed 0x4074 0x9b00 0x60e 0x4268 0x9aa6 0x5fd 0x445c 0x9a4c 0x60e 0x4650 0x99f2 0x5fd 0x4844 0x9984 0x5ed 0x4a38 0x9916 0x5cb 0x4c2c 0x989e 0x599 0x4e20 0x9830 0x567 0x5014 0x97cc 0x546 0x5208 0x9772 0x535 0x53fc 0x972c 0x535 0x55f0 0x96e6 0x535 0x57e4 0x96aa 0x535 0x59d8 0x966e 0x535 0x5bcc 0x963c 0x535 0x5dc0 0x960a 0x535 0x5fb4 0x95d8 0x535 0x61a8 0x95a6 0x535 0x639c 0x957e 0x546 0x6590 0x9556 0x546 0x6784 0x952e 0x557 0x6978 0x9506 0x557 0x6b6c 0x94de 0x567 0x6d60 0x94c0 0x578 0x6f54 0x94a2 0x578 0x7148 0x9484 0x589 0x733c 0x9466 0x589 0x7530 0x9448 0x599 0x7724 0x942a 0x599 0x7918 0x9416 0x5aa 0x7b0c 0x93f8 0x599 0x7d00 0x93e4 0x5aa 0x7ef4 0x93c6 0x599 0x80e8 0x93bc 0x5bb 0x82dc 0x93a8 0x5bb 0x84d0 0x9394 0x5bb 0x86c4 0x9380 0x5cb 0x88b8 0x936c 0x5bb 0x8aac 0x934e 0x5dc 0x8ca0 0x9330 0x5cb 0x8e94 0x9312 0x5cb 0x9088 0x92f4 0x5ed 0x927c 0x92cc 0x5ed 0x9470 0x92a4 0x5ed 0x9664 0x9286 0x60e 0x9858 0x925e 0x61f 0x9a4c 0x9222 0x62f 0x9c40 0x91e6 0x62f 0x9e34 0x91a0 0x640 0xa028 0x916e 0x672 0xa21c 0x9132 0x693 0xa410 0x90d8 0x6a4 0xa604 0x9088 0x6b5 0xa7f8 0x9060 0x6d6 0xa9ec 0x904c 0x729 0xabe0 0x902e 0x75b 0xadd4 0x9010 0x7d0 0xafc8 0x8fe8 0x866 0xb1bc 0x8fac 0x971 0xb3b0 0x8f2a 0xabe 0xb5a4 0x8db8 0xc3d 0xb798 0x8b7e 0xf1b 0xb98c 0x885e 0x1493 0xbb80 0x839a 0x2155 0xbd74 0x7e5e 0x1838 0xbf68 0x7aee 0x1219 0xc15c 0x7aee 0x1219>;
		battery1_profile_t2_col = <0x3>;
		battery1_profile_t2_num = <0x64>;
		battery1_profile_t3 = <0x0 0xa8d4 0x884 0x1f4 0xa7f8 0x887 0x3e8 0xa744 0x8ca 0x5dc 0xa6ae 0x8fc 0x7d0 0xa622 0x8fc 0x9c4 0xa5a0 0x90d 0xbb8 0xa51e 0x91d 0xdac 0xa4a6 0x92e 0xfa0 0xa42e 0x92e 0x1194 0xa3b6 0x92e 0x1388 0xa33e 0x92e 0x157c 0xa2c6 0x92e 0x1770 0xa258 0x93f 0x1964 0xa1ea 0x93f 0x1b58 0xa172 0x93f 0x1d4c 0xa104 0x92e 0x1f40 0xa096 0x93f 0x2134 0xa028 0x91d 0x2328 0x9fc4 0x93f 0x251c 0x9f56 0x93f 0x2710 0x9ef2 0x93f 0x2904 0x9e8e 0x94f 0x2af8 0x9e2a 0x94f 0x2cec 0x9dbc 0x94f 0x2ee0 0x9d58 0x960 0x30d4 0x9cf4 0x960 0x32c8 0x9c9a 0x981 0x34bc 0x9c36 0x971 0x36b0 0x9bdc 0x981 0x38a4 0x9b82 0x992 0x3a98 0x9b28 0x992 0x3c8c 0x9ace 0x9a3 0x3e80 0x9a6a 0x992 0x4074 0x99fc 0x981 0x4268 0x9998 0x981 0x445c 0x9920 0x94f 0x4650 0x98a8 0x92e 0x4844 0x9844 0x90d 0x4a38 0x97e0 0x90d 0x4c2c 0x9786 0x8eb 0x4e20 0x9740 0x8fc 0x5014 0x96fa 0x8fc 0x5208 0x96be 0x90d 0x53fc 0x9682 0x90d 0x55f0 0x9646 0x90d 0x57e4 0x9614 0x92e 0x59d8 0x95e2 0x93f 0x5bcc 0x95b0 0x94f 0x5dc0 0x9588 0x960 0x5fb4 0x9556 0x960 0x61a8 0x952e 0x971 0x639c 0x9506 0x981 0x6590 0x94de 0x992 0x6784 0x94c0 0x9b3 0x6978 0x94a2 0x9c4 0x6b6c 0x947a 0x9e5 0x6d60 0x9452 0x9e5 0x6f54 0x943e 0xa07 0x7148 0x9420 0xa17 0x733c 0x9402 0xa39 0x7530 0x93ee 0xa49 0x7724 0x93da 0xa6b 0x7918 0x93c6 0xa7b 0x7b0c 0x93bc 0xaad 0x7d00 0x93a8 0xacf 0x7ef4 0x939e 0xb01 0x80e8 0x9380 0xb11 0x82dc 0x936c 0xb43 0x84d0 0x934e 0xb75 0x86c4 0x933a 0xbb8 0x88b8 0x9312 0xbd9 0x8aac 0x92f4 0xc1c 0x8ca0 0x92c2 0xc3d 0x8e94 0x92a4 0xca1 0x9088 0x9272 0xcf5 0x927c 0x9236 0xd37 0x9470 0x9204 0xd9b 0x9664 0x91be 0xdff 0x9858 0x9182 0xe74 0x9a4c 0x913c 0xf0a 0x9c40 0x90ec 0xf7f 0x9e34 0x90a6 0x1025 0xa028 0x9060 0x10cc 0xa21c 0x9024 0x11a5 0xa410 0x8ffc 0x12c0 0xa604 0x8fd4 0x140d 0xa7f8 0x8f98 0x159d 0xa9ec 0x8f48 0x1781 0xabe0 0x8ed0 0x19e9 0xadd4 0x8dea 0x1cb6 0xafc8 0x8c6e 0x204b 0xb1bc 0x8a20 0x2591 0xb3b0 0x86ec 0x28c1 0xb5a4 0x86ec 0x28c1 0xb798 0x86ec 0x28c1 0xb98c 0x86ec 0x28c1 0xbb80 0x86ec 0x28c1 0xbd74 0x86ec 0x28c1 0xbf68 0x86ec 0x28c1 0xc15c 0x86ec 0x28c1>;
		battery1_profile_t3_col = <0x3>;
		battery1_profile_t3_num = <0x64>;
		battery1_profile_t4 = <0x0 0xa85c 0x12f2 0x1f4 0xa74e 0x12f2 0x3e8 0xa64a 0x141e 0x5dc 0xa53c 0x14e6 0x7d0 0xa456 0x1623 0x9c4 0xa3ac 0x170c 0xbb8 0xa302 0x1770 0xdac 0xa280 0x17c3 0xfa0 0xa1f4 0x17d4 0x1194 0xa172 0x1806 0x1388 0xa0f0 0x1817 0x157c 0xa078 0x1827 0x1770 0x9ff6 0x1827 0x1964 0x9f7e 0x1838 0x1b58 0x9f06 0x1849 0x1d4c 0x9e84 0x1859 0x1f40 0x9e02 0x1849 0x2134 0x9d80 0x1838 0x2328 0x9cf4 0x1838 0x251c 0x9c7c 0x1838 0x2710 0x9bf0 0x1817 0x2904 0x9b6e 0x17e5 0x2af8 0x9af6 0x17d4 0x2cec 0x9a88 0x17e5 0x2ee0 0x9a06 0x17c3 0x30d4 0x99ac 0x17c3 0x32c8 0x9948 0x17c3 0x34bc 0x98f8 0x17d4 0x36b0 0x989e 0x17d4 0x38a4 0x984e 0x17b3 0x3a98 0x97fe 0x17c3 0x3c8c 0x97c2 0x17f5 0x3e80 0x977c 0x17f5 0x4074 0x9740 0x1817 0x4268 0x96fa 0x1817 0x445c 0x96be 0x1827 0x4650 0x968c 0x1859 0x4844 0x9646 0x1859 0x4a38 0x9614 0x186a 0x4c2c 0x95d8 0x187b 0x4e20 0x95b0 0x189c 0x5014 0x957e 0x18ad 0x5208 0x954c 0x18ce 0x53fc 0x9524 0x18ef 0x55f0 0x94f2 0x18ef 0x57e4 0x94d4 0x1921 0x59d8 0x94a2 0x1932 0x5bcc 0x947a 0x1943 0x5dc0 0x9452 0x1964 0x5fb4 0x942a 0x1996 0x61a8 0x940c 0x19b7 0x639c 0x93ee 0x1a0b 0x6590 0x93c6 0x1a3d 0x6784 0x93a8 0x1a7f 0x6978 0x9380 0x1ab1 0x6b6c 0x9358 0x1b05 0x6d60 0x9330 0x1b47 0x6f54 0x9308 0x1b9b 0x7148 0x92d6 0x1bee 0x733c 0x92a4 0x1c52 0x7530 0x9268 0x1ca5 0x7724 0x9236 0x1d1a 0x7918 0x91fa 0x1d7e 0x7b0c 0x91be 0x1df3 0x7d00 0x9182 0x1e78 0x7ef4 0x9146 0x1efd 0x80e8 0x910a 0x1f83 0x82dc 0x90ce 0x204b 0x84d0 0x9088 0x20e1 0x86c4 0x904c 0x2198 0x88b8 0x9006 0x2281 0x8aac 0x8fb6 0x235a 0x8ca0 0x8f52 0x2422 0x8e94 0x8ec6 0x24ea 0x9088 0x8dea 0x256f 0x927c 0x8c96 0x25f5 0x9470 0x8a98 0x2669 0x9664 0x87be 0x27a6 0x9858 0x8386 0x237b 0x9a4c 0x7ec2 0x16fb 0x9c40 0x7ec2 0x16fb 0x9e34 0x7ec2 0x16fb 0xa028 0x7ec2 0x16fb 0xa21c 0x7ec2 0x16fb 0xa410 0x7ec2 0x16fb 0xa604 0x7ec2 0x16fb 0xa7f8 0x7ec2 0x16fb 0xa9ec 0x7ec2 0x16fb 0xabe0 0x7ec2 0x16fb 0xadd4 0x7ec2 0x16fb 0xafc8 0x7ec2 0x16fb 0xb1bc 0x7ec2 0x16fb 0xb3b0 0x7ec2 0x16fb 0xb5a4 0x7ec2 0x16fb 0xb798 0x7ec2 0x16fb 0xb98c 0x7ec2 0x16fb 0xbb80 0x7ec2 0x16fb 0xbd74 0x7ec2 0x16fb 0xbf68 0x7ec2 0x16fb 0xc15c 0x7ec2 0x16fb>;
		battery1_profile_t4_col = <0x3>;
		battery1_profile_t4_num = <0x64>;
		compatible = "mediatek,bat_gm30";
		g_FG_PSEUDO100_T0 = <0x64>;
		g_FG_PSEUDO100_T1 = <0x64>;
		g_FG_PSEUDO100_T2 = <0x64>;
		g_FG_PSEUDO100_T3 = <0x64>;
		g_FG_PSEUDO100_T4 = <0x64>;
		linux,phandle = <0x78>;
		phandle = <0x78>;
	};

	bpi_bsi_slv0@1021e000 {
		compatible = "mediatek,bpi_bsi_slv0";
		reg = <0x0 0x1021e000 0x0 0x1000>;
	};

	bpi_bsi_slv1@1021f000 {
		compatible = "mediatek,bpi_bsi_slv1";
		reg = <0x0 0x1021f000 0x0 0x6000>;
	};

	bpi_bsi_slv2@10225000 {
		compatible = "mediatek,bpi_bsi_slv2";
		reg = <0x0 0x10225000 0x0 0x1000>;
	};

	btcvsd@10001000 {
		compatible = "mediatek,audio_bt_cvsd";
		interrupts = <0x0 0xd2 0x8>;
		offset = <0xf00 0x800 0x140 0x144 0x148>;
		reg = <0x0 0x10001000 0x0 0x1000 0x0 0x18050000 0x0 0x1000 0x0 0x18080000 0x0 0x10000>;
	};

	btif@1100c000 {
		clock-names = "btifc", "apdmac";
		clocks = <0x1f 0x1a 0x1f 0x26>;
		compatible = "mediatek,btif";
		interrupts = <0x0 0x38 0x8 0x0 0x4c 0x8 0x0 0x4d 0x8>;
		reg = <0x0 0x1100c000 0x0 0x1000 0x0 0x11000880 0x0 0x80 0x0 0x11000900 0x0 0x80>;
	};

	bus_dbg@10208000 {
		compatible = "mediatek,bus_dbg-v2";
		interrupts = <0x0 0x55 0x8>;
		mediatek,bus_dbg_con_offset = <0x2fc>;
		reg = <0x0 0x10208000 0x0 0x1000 0x0 0x10001000 0x0 0x1000>;
	};

	cam@15004000 {
		compatible = "mediatek,cam";
		reg = <0x0 0x15004000 0x0 0x1000>;
	};

	cam_dma@15007000 {
		compatible = "mediatek,cam_dma";
		reg = <0x0 0x15007000 0x0 0x1000>;
	};

	cam_inner@1500d000 {
		compatible = "mediatek,cam_inner";
		reg = <0x0 0x1500d000 0x0 0x1000>;
	};

	cam_inner_dma@1500f000 {
		compatible = "mediatek,cam_inner_dma";
		reg = <0x0 0x1500f000 0x0 0x1000>;
	};

	cam_lut@15005000 {
		compatible = "mediatek,cam_lut";
		reg = <0x0 0x15005000 0x0 0x1000>;
	};

	camd@15006000 {
		compatible = "mediatek,camd";
		reg = <0x0 0x15006000 0x0 0x1000>;
	};

	camd_inner@1500e000 {
		compatible = "mediatek,camd_inner";
		reg = <0x0 0x1500e000 0x0 0x1000>;
	};

	camsv0@15050000 {
		compatible = "mediatek,camsv0";
		reg = <0x0 0x15050000 0x0 0x1000>;
	};

	camsv1@15051000 {
		compatible = "mediatek,camsv1";
		reg = <0x0 0x15051000 0x0 0x1000>;
	};

	camsys@15000000 {
		#clock-cells = <0x1>;
		compatible = "mediatek,camsys", "syscon";
		linux,phandle = <0x3c>;
		phandle = <0x3c>;
		reg = <0x0 0x15000000 0x0 0x1000>;
	};

	charger {
		ac_charger_current = <0x2625a0>;
		ac_charger_input_current = <0x1e8480>;
		algorithm_name = "SwitchCharging";
		apple_1_0a_charger_current = <0x9eb10>;
		apple_2_1a_charger_current = <0xc3500>;
		atika_ac_charger_current = <0x16e360>;
		atika_ac_charger_input_current = <0xf4240>;
		atika_charging_host_charger_current = <0xf4240>;
		atika_jeita_temp_above_t4_cc = <0x0>;
		atika_jeita_temp_above_t4_cic = <0x0>;
		atika_jeita_temp_below_t0_cc = <0x0>;
		atika_jeita_temp_below_t0_cic = <0x0>;
		atika_jeita_temp_t0_to_t1_cc = <0x0>;
		atika_jeita_temp_t0_to_t1_cic = <0x0>;
		atika_jeita_temp_t1_to_t2_cc = <0xf4240>;
		atika_jeita_temp_t1_to_t2_cic = <0xf4240>;
		atika_jeita_temp_t2_to_t3_cc = <0xf4240>;
		atika_jeita_temp_t2_to_t3_cic = <0xf4240>;
		atika_jeita_temp_t3_to_t4_cc = <0xf4240>;
		atika_jeita_temp_t3_to_t4_cic = <0xf4240>;
		atika_non_std_ac_charger_current = <0xdbba0>;
		battery_cv = <0x43a080>;
		bif_cv_under_threshold2 = <0x43e6d0>;
		bif_threshold1 = <0x40d990>;
		bif_threshold2 = <0x419ce0>;
		cable_imp_threshold = <0x2bb>;
		charging_host_charger_current = <0x16e360>;
		chg1_ta_ac_charger_current = <0x16e360>;
		chg2_ta_ac_charger_current = <0x16e360>;
		compatible = "mediatek,charger";
		enable_min_charge_temp;
		enable_sw_jeita;
		jeita_temp_above_t4_cc = <0x0>;
		jeita_temp_above_t4_cic = <0x0>;
		jeita_temp_above_t4_cv = <0x403580>;
		jeita_temp_below_t0_cc = <0x0>;
		jeita_temp_below_t0_cic = <0x0>;
		jeita_temp_below_t0_cv = <0x43a080>;
		jeita_temp_t0_to_t1_cc = <0x0>;
		jeita_temp_t0_to_t1_cic = <0x0>;
		jeita_temp_t0_to_t1_cv = <0x43a080>;
		jeita_temp_t1_to_t2_cc = <0xf4240>;
		jeita_temp_t1_to_t2_cic = <0xf4240>;
		jeita_temp_t1_to_t2_cv = <0x43a080>;
		jeita_temp_t2_to_t3_cc = <0x1e8480>;
		jeita_temp_t2_to_t3_cic = <0x1e8480>;
		jeita_temp_t2_to_t3_cv = <0x43a080>;
		jeita_temp_t3_to_t4_cc = <0x124f80>;
		jeita_temp_t3_to_t4_cic = <0x124f80>;
		jeita_temp_t3_to_t4_cv = <0x403580>;
		linux,phandle = <0xa3>;
		max_charge_temp = <0x32>;
		max_charge_temp_minus_x_degree = <0x2f>;
		max_charger_voltage = <0x632ea0>;
		min_charge_temp = <0x0>;
		min_charge_temp_plus_x_degree = <0x6>;
		min_charger_voltage = <0x4630c0>;
		non_std_ac_charger_current = <0xdbba0>;
		pe20_ichg_level_threshold = <0xf4240>;
		pe40_dual_charger_chg1_current = <0x1e8480>;
		pe40_dual_charger_chg2_current = <0x1e8480>;
		pe40_dual_charger_input_current = <0x1e8480>;
		pe40_r_cable_1a_lower = <0x229>;
		pe40_r_cable_2a_lower = <0x19f>;
		pe40_r_cable_3a_lower = <0x113>;
		pe40_single_charger_current = <0x1e8480>;
		pe40_single_charger_input_current = <0x1e8480>;
		pe40_stop_battery_soc = <0x50>;
		pe_ichg_level_threshold = <0xf4240>;
		phandle = <0xa3>;
		pogo_charger_current = <0x16e360>;
		pogo_charger_input_current = <0x16e360>;
		power_path_support;
		ta_12v_support;
		ta_9v_support;
		ta_ac_12v_input_current = <0x1e8480>;
		ta_ac_7v_input_current = <0x1e8480>;
		ta_ac_9v_input_current = <0x1e8480>;
		ta_ac_charger_current = <0x1e8480>;
		ta_start_battery_soc = <0x0>;
		ta_stop_battery_soc = <0x55>;
		temp_neg_10_thres = <0x0>;
		temp_t0_thres = <0x0>;
		temp_t0_thres_plus_x_degree = <0x0>;
		temp_t1_thres = <0x0>;
		temp_t1_thres_plus_x_degree = <0x1>;
		temp_t2_thres = <0xf>;
		temp_t2_thres_plus_x_degree = <0x10>;
		temp_t3_thres = <0x2d>;
		temp_t3_thres_minus_x_degree = <0x2c>;
		temp_t4_thres = <0x32>;
		temp_t4_thres_minus_x_degree = <0x31>;
		usb_charger_current = <0x7a120>;
		usb_charger_current_configured = <0x7a120>;
		usb_charger_current_suspend = <0x0>;
		usb_charger_current_unconfigured = <0x11170>;
		vbat_cable_imp_threshold = <0x3b8260>;
	};

	chipid@08000000 {
		compatible = "mediatek,chipid";
		reg = <0x0 0x8000000 0x0 0x4 0x0 0x8000004 0x0 0x4 0x0 0x8000008 0x0 0x4 0x0 0x800000c 0x0 0x4>;
	};

	chosen {
		bootargs = "console=tty0 console=ttyS0,921600n1 vmalloc=496M slub_max_order=0 slub_debug=OFZPU page_owner=on androidboot.hardware=mt6761 maxcpus=8 firmware_class.path=/vendor/firmware loop.max_part=7";
		kaslr-seed = <0x0 0x0>;
		linux,phandle = <0x45>;
		phandle = <0x45>;
	};

	clocks {

		clk26m {
			#clock-cells = <0x0>;
			clock-frequency = <0x18cba80>;
			compatible = "fixed-clock";
			linux,phandle = <0x1b>;
			phandle = <0x1b>;
		};

		clk32k {
			#clock-cells = <0x0>;
			clock-frequency = <0x7d00>;
			compatible = "fixed-clock";
			linux,phandle = <0x1a>;
			phandle = <0x1a>;
		};
	};

	consys@18002000 {
		#address-cells = <0x2>;
		#size-cells = <0x2>;
		clock-names = "conn";
		clocks = <0x20 0x1>;
		compatible = "mediatek,mt6761-consys";
		interrupts = <0x0 0xd3 0x8 0x0 0xd5 0x8 0x0 0xd6 0x1>;
		linux,phandle = <0xf>;
		phandle = <0xf>;
		reg = <0x0 0x18002000 0x0 0x1000 0x0 0x10007000 0x0 0x100 0x0 0x10001000 0x0 0x1000 0x0 0x10006000 0x0 0x1000 0x0 0x18007000 0x0 0x1000 0x0 0x180b1000 0x0 0x1000 0x0 0x180a3000 0x0 0x1000 0x0 0x180a5000 0x0 0x800 0x0 0x180c1000 0x0 0x1000 0x0 0x18004000 0x0 0x1000>;
	};

	cpu_dbgapb@0d410000 {
		compatible = "mediatek,hw_dbg";
		linux,phandle = <0x47>;
		num = <0x8>;
		phandle = <0x47>;
		reg = <0x0 0xd410000 0x0 0x1000 0x0 0xd510000 0x0 0x1000 0x0 0xd610000 0x0 0x1000 0x0 0xd710000 0x0 0x1000 0x0 0xd810000 0x0 0x1000 0x0 0xd910000 0x0 0x1000 0x0 0xda10000 0x0 0x1000 0x0 0xdb10000 0x0 0x1000>;
	};

	cpus {
		#address-cells = <0x1>;
		#size-cells = <0x0>;

		cpu-map {

			cluster0 {

				core0 {
					cpu = <0x9>;
				};

				core1 {
					cpu = <0xa>;
				};

				core2 {
					cpu = <0xb>;
				};

				core3 {
					cpu = <0xc>;
				};
			};
		};

		cpu@000 {
			clock-frequency = <0x8b799100>;
			compatible = "arm,cortex-a53";
			cpu-idle-states = <0x2 0x3 0x4 0x5 0x6 0x7 0x8>;
			device_type = "cpu";
			enable-method = "psci";
			linux,phandle = <0x9>;
			phandle = <0x9>;
			reg = <0x0>;
		};

		cpu@001 {
			clock-frequency = <0x8b799100>;
			compatible = "arm,cortex-a53";
			cpu-idle-states = <0x2 0x3 0x4 0x5 0x6 0x7 0x8>;
			device_type = "cpu";
			enable-method = "psci";
			linux,phandle = <0xa>;
			phandle = <0xa>;
			reg = <0x1>;
		};

		cpu@002 {
			clock-frequency = <0x8b799100>;
			compatible = "arm,cortex-a53";
			cpu-idle-states = <0x2 0x3 0x4 0x5 0x6 0x7 0x8>;
			device_type = "cpu";
			enable-method = "psci";
			linux,phandle = <0xb>;
			phandle = <0xb>;
			reg = <0x2>;
		};

		cpu@003 {
			clock-frequency = <0x8b799100>;
			compatible = "arm,cortex-a53";
			cpu-idle-states = <0x2 0x3 0x4 0x5 0x6 0x7 0x8>;
			device_type = "cpu";
			enable-method = "psci";
			linux,phandle = <0xc>;
			phandle = <0xc>;
			reg = <0x3>;
		};

		idle-states {
			entry-method = "arm,psci";

			dpidle {
				arm,psci-suspend-param = <0x1010004>;
				compatible = "arm,idle-state";
				entry-latency-us = <0x320>;
				exit-latency-us = <0x3e8>;
				linux,phandle = <0x7>;
				min-residency-us = <0x7d0>;
				phandle = <0x7>;
			};

			mcdi-cluster {
				arm,psci-suspend-param = <0x1010001>;
				compatible = "arm,idle-state";
				entry-latency-us = <0x258>;
				exit-latency-us = <0x258>;
				linux,phandle = <0x4>;
				min-residency-us = <0x4b0>;
				phandle = <0x4>;
			};

			mcdi-cpu {
				arm,psci-suspend-param = <0x10001>;
				compatible = "arm,idle-state";
				entry-latency-us = <0x258>;
				exit-latency-us = <0x258>;
				linux,phandle = <0x3>;
				min-residency-us = <0x4b0>;
				phandle = <0x3>;
			};

			sodi {
				arm,psci-suspend-param = <0x1010002>;
				compatible = "arm,idle-state";
				entry-latency-us = <0x320>;
				exit-latency-us = <0x3e8>;
				linux,phandle = <0x5>;
				min-residency-us = <0x7d0>;
				phandle = <0x5>;
			};

			sodi3 {
				arm,psci-suspend-param = <0x1010003>;
				compatible = "arm,idle-state";
				entry-latency-us = <0x320>;
				exit-latency-us = <0x3e8>;
				linux,phandle = <0x6>;
				min-residency-us = <0x7d0>;
				phandle = <0x6>;
			};

			standby {
				arm,psci-suspend-param = <0x1>;
				compatible = "arm,idle-state";
				entry-latency-us = <0x258>;
				exit-latency-us = <0x258>;
				linux,phandle = <0x2>;
				min-residency-us = <0x4b0>;
				phandle = <0x2>;
			};

			suspend {
				arm,psci-suspend-param = <0x1010005>;
				compatible = "arm,idle-state";
				entry-latency-us = <0x320>;
				exit-latency-us = <0x3e8>;
				linux,phandle = <0x8>;
				min-residency-us = <0x7d0>;
				phandle = <0x8>;
			};
		};
	};

	cq_dma@10212000 {
		clock-names = "cqdma";
		clocks = <0x1f 0x43>;
		compatible = "mediatek,mt-cqdma-v1";
		interrupts = <0x0 0x39 0x8 0x0 0x3a 0x8 0x0 0x3b 0x8>;
		keep_clock_ao = "yes";
		nr_channel = <0x3>;
		reg = <0x0 0x10212000 0x0 0x80 0x0 0x10212080 0x0 0x80 0x0 0x10212100 0x0 0x68>;
	};

	dbg_apmcu_mp0@0d400000 {
		compatible = "mediatek,dbg_apmcu_mp0";
		reg = <0x0 0xd400000 0x0 0x1000>;
	};

	dbg_apmcu_mp0@0d410000 {
		compatible = "mediatek,dbg_apmcu_mp0";
		reg = <0x0 0xd410000 0x0 0x1000>;
	};

	dbg_apmcu_mp0@0d420000 {
		compatible = "mediatek,dbg_apmcu_mp0";
		reg = <0x0 0xd420000 0x0 0x1000>;
	};

	dbg_apmcu_mp0@0d430000 {
		compatible = "mediatek,dbg_apmcu_mp0";
		reg = <0x0 0xd430000 0x0 0x1000>;
	};

	dbg_apmcu_mp0@0d440000 {
		compatible = "mediatek,dbg_apmcu_mp0";
		reg = <0x0 0xd440000 0x0 0x1000>;
	};

	dbg_apmcu_mp0@0d510000 {
		compatible = "mediatek,dbg_apmcu_mp0";
		reg = <0x0 0xd510000 0x0 0x1000>;
	};

	dbg_apmcu_mp0@0d520000 {
		compatible = "mediatek,dbg_apmcu_mp0";
		reg = <0x0 0xd520000 0x0 0x1000>;
	};

	dbg_apmcu_mp0@0d530000 {
		compatible = "mediatek,dbg_apmcu_mp0";
		reg = <0x0 0xd530000 0x0 0x1000>;
	};

	dbg_apmcu_mp0@0d540000 {
		compatible = "mediatek,dbg_apmcu_mp0";
		reg = <0x0 0xd540000 0x0 0x1000>;
	};

	dbg_apmcu_mp0@0d610000 {
		compatible = "mediatek,dbg_apmcu_mp0";
		reg = <0x0 0xd610000 0x0 0x1000>;
	};

	dbg_apmcu_mp0@0d620000 {
		compatible = "mediatek,dbg_apmcu_mp0";
		reg = <0x0 0xd620000 0x0 0x1000>;
	};

	dbg_apmcu_mp0@0d630000 {
		compatible = "mediatek,dbg_apmcu_mp0";
		reg = <0x0 0xd630000 0x0 0x1000>;
	};

	dbg_apmcu_mp0@0d640000 {
		compatible = "mediatek,dbg_apmcu_mp0";
		reg = <0x0 0xd640000 0x0 0x1000>;
	};

	dbg_apmcu_mp0@0d710000 {
		compatible = "mediatek,dbg_apmcu_mp0";
		reg = <0x0 0xd710000 0x0 0x1000>;
	};

	dbg_apmcu_mp0@0d720000 {
		compatible = "mediatek,dbg_apmcu_mp0";
		reg = <0x0 0xd720000 0x0 0x1000>;
	};

	dbg_apmcu_mp0@0d730000 {
		compatible = "mediatek,dbg_apmcu_mp0";
		reg = <0x0 0xd730000 0x0 0x1000>;
	};

	dbg_apmcu_mp0@0d740000 {
		compatible = "mediatek,dbg_apmcu_mp0";
		reg = <0x0 0xd740000 0x0 0x1000>;
	};

	dbg_apmcu_mp1@0d800000 {
		compatible = "mediatek,dbg_apmcu_mp1";
		reg = <0x0 0xd800000 0x0 0x1000>;
	};

	dbg_apmcu_mp1@0d810000 {
		compatible = "mediatek,dbg_apmcu_mp1";
		reg = <0x0 0xd810000 0x0 0x1000>;
	};

	dbg_apmcu_mp1@0d820000 {
		compatible = "mediatek,dbg_apmcu_mp1";
		reg = <0x0 0xd820000 0x0 0x1000>;
	};

	dbg_apmcu_mp1@0d830000 {
		compatible = "mediatek,dbg_apmcu_mp1";
		reg = <0x0 0xd830000 0x0 0x1000>;
	};

	dbg_apmcu_mp1@0d840000 {
		compatible = "mediatek,dbg_apmcu_mp1";
		reg = <0x0 0xd840000 0x0 0x1000>;
	};

	dbg_apmcu_mp1@0d910000 {
		compatible = "mediatek,dbg_apmcu_mp1";
		reg = <0x0 0xd910000 0x0 0x1000>;
	};

	dbg_apmcu_mp1@0d920000 {
		compatible = "mediatek,dbg_apmcu_mp1";
		reg = <0x0 0xd920000 0x0 0x1000>;
	};

	dbg_apmcu_mp1@0d930000 {
		compatible = "mediatek,dbg_apmcu_mp1";
		reg = <0x0 0xd930000 0x0 0x1000>;
	};

	dbg_apmcu_mp1@0d940000 {
		compatible = "mediatek,dbg_apmcu_mp1";
		reg = <0x0 0xd940000 0x0 0x1000>;
	};

	dbg_apmcu_mp1@0da10000 {
		compatible = "mediatek,dbg_apmcu_mp1";
		reg = <0x0 0xda10000 0x0 0x1000>;
	};

	dbg_apmcu_mp1@0da20000 {
		compatible = "mediatek,dbg_apmcu_mp1";
		reg = <0x0 0xda20000 0x0 0x1000>;
	};

	dbg_apmcu_mp1@0da30000 {
		compatible = "mediatek,dbg_apmcu_mp1";
		reg = <0x0 0xda30000 0x0 0x1000>;
	};

	dbg_apmcu_mp1@0da40000 {
		compatible = "mediatek,dbg_apmcu_mp1";
		reg = <0x0 0xda40000 0x0 0x1000>;
	};

	dbg_apmcu_mp1@0db10000 {
		compatible = "mediatek,dbg_apmcu_mp1";
		reg = <0x0 0xdb10000 0x0 0x1000>;
	};

	dbg_apmcu_mp1@0db20000 {
		compatible = "mediatek,dbg_apmcu_mp1";
		reg = <0x0 0xdb20000 0x0 0x1000>;
	};

	dbg_apmcu_mp1@0db30000 {
		compatible = "mediatek,dbg_apmcu_mp1";
		reg = <0x0 0xdb30000 0x0 0x1000>;
	};

	dbg_apmcu_mp1@0db40000 {
		compatible = "mediatek,dbg_apmcu_mp1";
		reg = <0x0 0xdb40000 0x0 0x1000>;
	};

	dbg_cti@0d020000 {
		compatible = "mediatek,dbg_cti";
		reg = <0x0 0xd020000 0x0 0x10000>;
	};

	dbg_dem@0d0a0000 {
		compatible = "mediatek,dbg_dem";
		interrupts = <0x0 0x54 0x8>;
		reg = <0x0 0xd0a0000 0x0 0x10000>;
	};

	dbg_etr@0d030000 {
		compatible = "mediatek,dbg_etr";
		reg = <0x0 0xd030000 0x0 0x10000>;
	};

	dbg_funnel@0d040000 {
		compatible = "mediatek,dbg_funnel";
		reg = <0x0 0xd040000 0x0 0x10000>;
	};

	dbg_mdsys1@0d0c0000 {
		compatible = "mediatek,dbg_mdsys1";
		reg = <0x0 0xd0c0000 0x0 0x40000>;
	};

	dbmdx {
		compatible = "dspg,dbmdx-codec";
		linux,phandle = <0x75>;
		phandle = <0x75>;
	};

	dbmdx-soundcard {
		compatible = "dbmdx,dbmdx-soundcard";
		linux,phandle = <0x76>;
		phandle = <0x76>;
	};

	devapc@10207000 {
		clock-names = "devapc-infra-clock";
		clocks = <0x1f 0x28>;
		compatible = "mediatek,devapc";
		interrupts = <0x0 0x56 0x8>;
		reg = <0x0 0x10207000 0x0 0x1000>;
	};

	dfd@10200b00 {
		compatible = "mediatek,dfd";
		mediatek,chain_length = <0x61a8>;
		mediatek,enabled = <0x1>;
		mediatek,rg_dfd_timeout = <0xa0>;
		reg = <0x0 0x10200b00 0x0 0x10000>;
	};

	disp_aal0@14011000 {
		compatible = "mediatek,disp_aal0";
		interrupts = <0x0 0xa6 0x8>;
		reg = <0x0 0x14011000 0x0 0x1000>;
	};

	disp_ccorr0@14010000 {
		compatible = "mediatek,disp_ccorr0";
		interrupts = <0x0 0xa5 0x8>;
		reg = <0x0 0x14010000 0x0 0x1000>;
	};

	disp_color0@1400f000 {
		compatible = "mediatek,disp_color0";
		interrupts = <0x0 0xa4 0x8>;
		linux,phandle = <0x28>;
		phandle = <0x28>;
		reg = <0x0 0x1400f000 0x0 0x1000>;
	};

	disp_dither0@14013000 {
		compatible = "mediatek,disp_dither0";
		interrupts = <0x0 0xa8 0x8>;
		reg = <0x0 0x14013000 0x0 0x1000>;
	};

	disp_gamma0@14012000 {
		compatible = "mediatek,disp_gamma0";
		interrupts = <0x0 0xa7 0x8>;
		reg = <0x0 0x14012000 0x0 0x1000>;
	};

	disp_mutex0@14001000 {
		compatible = "mediatek,disp_mutex0";
		interrupts = <0x0 0x9a 0x8>;
		linux,phandle = <0x2a>;
		phandle = <0x2a>;
		reg = <0x0 0x14001000 0x0 0x1000>;
	};

	disp_ovl0@1400b000 {
		compatible = "mediatek,disp_ovl0";
		interrupts = <0x0 0xa1 0x8>;
		reg = <0x0 0x1400b000 0x0 0x1000>;
	};

	disp_ovl0_2l@1400c000 {
		compatible = "mediatek,disp_ovl0_2l";
		interrupts = <0x0 0xad 0x8>;
		reg = <0x0 0x1400c000 0x0 0x1000>;
	};

	disp_pwm@1100e000 {
		compatible = "mediatek,disp_pwm";
		reg = <0x0 0x1100e000 0x0 0x1000>;
	};

	disp_rdma0@1400d000 {
		compatible = "mediatek,disp_rdma0";
		interrupts = <0x0 0xa2 0x8>;
		reg = <0x0 0x1400d000 0x0 0x1000>;
	};

	disp_rsz0@14015000 {
		compatible = "mediatek,disp_rsz0";
		interrupts = <0x0 0xdc 0x8>;
		reg = <0x0 0x14015000 0x0 0x1000>;
	};

	disp_wdma0@1400e000 {
		compatible = "mediatek,disp_wdma0";
		interrupts = <0x0 0xa3 0x8>;
		reg = <0x0 0x1400e000 0x0 0x1000>;
	};

	dispsys {
		clock-names = "MMSYS_MTCMOS", "MMSYS_SMI_COMMON", "MMSYS_SMI_LARB0", "MMSYS_GALS_COMM0", "MMSYS_GALS_COMM1", "MMSYS_DISP_OVL0", "MMSYS_DISP_OVL0_2L", "MMSYS_DISP_RDMA0", "MMSYS_DISP_WDMA0", "MMSYS_DISP_COLOR0", "MMSYS_DISP_CCORR0", "MMSYS_DISP_AAL0", "MMSYS_DISP_GAMMA0", "MMSYS_DISP_DITHER0", "MMSYS_DSI0_MM_CK", "MMSYS_DSI0_IF_CK", "MMSYS_26M", "MMSYS_DISP_RSZ0", "APMIXED_MIPI_26M", "TOP_MUX_DISP_PWM", "DISP_PWM", "TOP_26M", "TOP_UNIVPLL2_D4", "TOP_ULPOSC1_D2", "TOP_ULPOSC1_D8";
		clocks = <0x20 0x3 0x21 0x13 0x21 0x14 0x21 0x15 0x21 0x16 0x21 0x7 0x21 0x8 0x21 0xa 0x21 0xb 0x21 0xc 0x21 0xd 0x21 0xe 0x21 0xf 0x21 0x10 0x21 0x11 0x21 0x1c 0x21 0x1d 0x21 0x9 0x3b 0x13 0x19 0x7c 0x1f 0x31 0x1b 0x19 0x1e 0x19 0x2f 0x19 0x31>;
		compatible = "mediatek,dispsys";
		mediatek,larb = <0x1c>;
	};

	dma-controller@11000580 {
		#dma-cells = <0x1>;
		clock-names = "apdma";
		clocks = <0x1f 0x26>;
		compatible = "mediatek,mt6577-uart-dma";
		interrupts = <0x0 0x35 0x8 0x0 0x36 0x8 0x0 0x37 0x8 0x0 0x3c 0x8>;
		linux,phandle = <0x2c>;
		phandle = <0x2c>;
		reg = <0x0 0x11000680 0x0 0x80 0x0 0x11000700 0x0 0x80 0x0 0x11000780 0x0 0x80 0x0 0x11000800 0x0 0x80>;
	};

	dramc@1022a000 {
		compatible = "mediatek,dramc";
		reg = <0x0 0x1022a000 0x0 0x2000 0x0 0x10232000 0x0 0x2000 0x0 0x1022c000 0x0 0x1000 0x0 0x10234000 0x0 0x1000 0x0 0x10228000 0x0 0x2000 0x0 0x10230000 0x0 0x2000 0x0 0x1022e000 0x0 0x1000 0x0 0x10236000 0x0 0x1000>;
	};

	dsi0@14014000 {
		compatible = "mediatek,dsi0";
		interrupts = <0x0 0xa9 0x8>;
		reg = <0x0 0x14014000 0x0 0x1000>;
	};

	dsi_te {
		compatible = "mediatek, DSI_TE-eint";
		linux,phandle = <0x9a>;
		phandle = <0x9a>;
		status = "disabled";
	};

	dvfsp@00110800 {
		compatible = "mediatek,mt6761-dvfsp";
		reg = <0x0 0x110800 0x0 0x1400 0x0 0x110800 0x0 0x1400>;
	};

	dvfsp@10227000 {
		compatible = "mediatek,dvfsp";
		reg = <0x0 0x10227000 0x0 0x1000>;
	};

	dvfsrc@10012000 {
		compatible = "mediatek,dvfsrc";
		reg = <0x0 0x10012000 0x0 0x1000 0x0 0x110780 0x0 0x80>;
	};

	dxcc_sec@10210000 {
		compatible = "mediatek,dxcc_sec";
		interrupts = <0x0 0x6a 0x4>;
		reg = <0x0 0x10210000 0x0 0x1000>;
	};

	dynamic_options {
		compatible = "mediatek,dynamic_options";
		linux,phandle = <0xa9>;
		phandle = <0xa9>;
	};

	eem_fsm@1100b000 {
		compatible = "mediatek,eem_fsm";
		interrupts = <0x0 0x45 0x8>;
		reg = <0x0 0x1100b000 0x0 0x1000>;
	};

	efuse_dbg@10004000 {
		compatible = "mediatek,efuse_dbg";
		reg = <0x0 0x10004000 0x0 0x1000>;
	};

	efusec@11c50000 {
		compatible = "mediatek,efusec";
		reg = <0x0 0x11c50000 0x0 0x10000>;
	};

	emi@10219000 {
		compatible = "mediatek,emi";
		interrupts = <0x0 0x58 0x8>;
		reg = <0x0 0x10219000 0x0 0x1000 0x0 0x10226000 0x0 0x1000 0x0 0x1022d000 0x0 0x1000 0x0 0x10235000 0x0 0x1000>;
	};

	fdvt@1500b000 {
		clock-names = "FD_CLK_CAM_FDVT";
		clocks = <0x3c 0x6>;
		compatible = "mediatek,fdvt";
		interrupts = <0x0 0xb6 0x8>;
		reg = <0x0 0x1500b000 0x0 0x1000>;
	};

	fhctl@1000ce00 {
		compatible = "mediatek,fhctl";
		reg = <0x0 0x1000ce00 0x0 0x200>;
	};

	fingerprint {
		compatible = "mediatek,goodix-fp";
		linux,phandle = <0x77>;
		phandle = <0x77>;
	};

	firmware {

		android {
			compatible = "android,firmware";

			fstab {
				compatible = "android,fstab";

				product {
					compatible = "android,product";
					dev = "/dev/block/platform/bootdevice/by-name/product";
					fsmgr_flags = "wait";
					mnt_flags = "rw,noatime";
					type = "ext4";
				};

				vendor {
					compatible = "android,vendor";
					dev = "/dev/block/platform/bootdevice/by-name/vendor";
					fsmgr_flags = "wait,avb";
					mnt_flags = "ro";
					type = "ext4";
				};
			};

			vbmeta {
				compatible = "android,vbmeta";
				parts = "vbmeta,boot,system,vendor,recovery";
			};
		};
	};

	flashlight_core {
		compatible = "mediatek,flashlight_core";
		linux,phandle = <0x9d>;
		phandle = <0x9d>;
	};

	flashlights_mt6370 {
		compatible = "mediatek,flashlights_mt6370";
		decouple = <0x0>;
		linux,phandle = <0x9e>;
		phandle = <0x9e>;

		channel@1 {
			ct = <0x0>;
			part = <0x0>;
			type = <0x0>;
		};

		channel@2 {
			ct = <0x1>;
			part = <0x0>;
			type = <0x0>;
		};
	};

	gauge_timer {
		compatible = "mediatek,gauge_timer_service";
	};

	gce@10238000 {
		#clock-cells = <0x1>;
		ap_dma_base = <0x18010000 0x17 0xffff0000>;
		audio_base = <0x17000000 0x12 0xffff0000>;
		buf_underrun_event_0 = <0x8c>;
		camsv_0_pass1_done = <0x106>;
		camsv_1_pass1_done = <0x107>;
		camsys1_base = <0x180a0000 0x1c 0xffff0000>;
		camsys2_base = <0x180b0000 0x1d 0xffff0000>;
		camsys_base = <0x18080000 0x1b 0xffff0000>;
		clock-names = "GCE", "GCE_TIMER";
		clocks = <0x1f 0x9 0x1f 0x18>;
		compatible = "mediatek,gce", "syscon";
		conn_peri_base = <0x18820000 0x7 0xffff0000>;
		dip_cq_thread0_frame_done = <0x103>;
		dip_cq_thread1_frame_done = <0x102>;
		dip_cq_thread2_frame_done = <0x101>;
		disp_2l_ovl0_frame_done = <0x1c>;
		disp_2l_ovl0_sof = <0x8>;
		disp_aal0_frame_done = <0x22>;
		disp_aal0_sof = <0xd>;
		disp_ccorr0_frame_done = <0x21>;
		disp_ccorr0_sof = <0xc>;
		disp_color0_frame_done = <0x20>;
		disp_color0_sof = <0xb>;
		disp_dither0_frame_done = <0x24>;
		disp_dither0_sof = <0xf>;
		disp_dither_base = <0x14010000 0x2 0xffff0000>;
		disp_dsi0_frame_done = <0x25>;
		disp_dsi0_sof = <0x10>;
		disp_gamma0_frame_done = <0x23>;
		disp_gamma0_sof = <0xe>;
		disp_ovl0_frame_done = <0x1b>;
		disp_ovl0_frame_rst_done_pusle = <0x98>;
		disp_ovl0_sof = <0x7>;
		disp_pwm0_sof = <0x13>;
		disp_rdma0_frame_done = <0x1e>;
		disp_rdma0_sof = <0x9>;
		disp_rsz0_frame_done = <0x1d>;
		disp_rsz0_sof = <0x11>;
		disp_wdma0_frame_done = <0x1f>;
		disp_wdma0_rst_done = <0x93>;
		disp_wdma0_sof = <0xa>;
		dsi0_done_event = <0x8f>;
		dsi0_irq_event = <0x8e>;
		dsi0_te_event = <0x8d>;
		g3d_config_base = <0x13000000 0x0 0xffff0000>;
		gce_base = <0x18020000 0x18 0xffff0000>;
		gcpu_base = <0x10050000 0xf 0xffff0000>;
		img_dl_relay_sof = <0x12>;
		imgsys_base = <0x15020000 0x4 0xffff0000>;
		infra_na3_base = <0x10010000 0xb 0xffff0000>;
		infra_na4_base = <0x10020000 0xc 0xffff0000>;
		interrupts = <0x0 0x62 0x8>;
		isp_frame_done_p1_0 = <0x105>;
		isp_frame_done_p1_1 = <0x104>;
		jpgdec_done = <0x123>;
		jpgenc_done = <0x122>;
		kp_base = <0x18840000 0x9 0xffff0000>;
		linux,phandle = <0x79>;
		max_prefetch_cnt = <0x1>;
		mboxes = <0x2b 0x0 0x0 0x4 0x2b 0x1 0x0 0x4 0x2b 0x2 0x0 0x5 0x2b 0x3 0x0 0x4 0x2b 0x4 0x0 0x4 0x2b 0x5 0x0 0x4 0x2b 0x6 0xc8 0x4 0x2b 0x7 0xffffffff 0x2 0x2b 0x8 0x0 0x1 0x2b 0x9 0x0 0x1 0x2b 0xa 0x0 0x1 0x2b 0xb 0x0 0x1 0x2b 0xc 0x0 0x1 0x2b 0xd 0x0 0x1 0x2b 0xe 0x0 0x1 0x2b 0xf 0x0 0x1>;
		mcucfg_base = <0x10040000 0xe 0xffff0000>;
		mdp_ccorr0 = <0x29>;
		mdp_ccorr0_frame_done = <0x15>;
		mdp_ccorr0_sof = <0x1>;
		mdp_color0 = <0x28>;
		mdp_rdma0 = <0x22>;
		mdp_rdma0_frame_done = <0x14>;
		mdp_rdma0_rst_done = <0x97>;
		mdp_rdma0_sof = <0x0>;
		mdp_rsz0 = <0x23>;
		mdp_rsz0_frame_done = <0x16>;
		mdp_rsz0_sof = <0x2>;
		mdp_rsz1 = <0x24>;
		mdp_rsz1_frame_done = <0x17>;
		mdp_rsz1_sof = <0x3>;
		mdp_tdshp0 = <0x27>;
		mdp_tdshp0_frame_done = <0x1a>;
		mdp_tdshp0_sof = <0x6>;
		mdp_wdma0 = <0x25>;
		mdp_wdma_frame_done = <0x19>;
		mdp_wdma_rst_done = <0x94>;
		mdp_wdma_sof = <0x4>;
		mdp_wrot0 = <0x26>;
		mdp_wrot0_rst_done = <0x95>;
		mdp_wrot0_sof = <0x5>;
		mdp_wrot0_write_frame_done = <0x18>;
		mediatek,mailbox-gce = <0x2b>;
		mipitx0_base = <0x11c80000 0x63 0xffff0000>;
		mm_mutex = <0x2a>;
		mm_na_base = <0x14020000 0x3 0xffff0000>;
		mmsys_config = <0x21>;
		mmsys_config_base = <0x14000000 0x1 0xffff0000>;
		msdc2_base = <0x17020000 0x14 0xffff0000>;
		msdc3_base = <0x18000000 0x16 0xffff0000>;
		phandle = <0x79>;
		prefetch_size = <0x60>;
		pwm_sw_base = <0x1100e000 0x63 0xffff0000>;
		reg = <0x0 0x10238000 0x0 0x4000>;
		scp_base = <0x10030000 0xd 0xffff0000>;
		scp_sram_base = <0x10000000 0xa 0xffff0000>;
		seninf_0_fifo_full = <0x108>;
		seninf_1_fifo_full = <0x109>;
		seninf_2_fifo_full = <0x10a>;
		seninf_3_fifo_full = <0x10b>;
		seninf_4_fifo_full = <0x10c>;
		seninf_5_fifo_full = <0x10d>;
		seninf_6_fifo_full = <0x10e>;
		seninf_7_fifo_full = <0x10f>;
		sram_share_cnt = <0x1>;
		sram_share_engine = <0xa>;
		sram_share_event = <0x2c6>;
		sram_size_cpr_64 = <0x40>;
		stream_done_0 = <0x82>;
		stream_done_1 = <0x83>;
		stream_done_2 = <0x84>;
		stream_done_3 = <0x85>;
		stream_done_4 = <0x86>;
		stream_done_5 = <0x87>;
		stream_done_6 = <0x88>;
		stream_done_7 = <0x89>;
		stream_done_8 = <0x8a>;
		stream_done_9 = <0x8b>;
		topckgen_base = <0x18830000 0x8 0xffff0000>;
		usb0_base = <0x10200000 0x10 0xffff0000>;
		usb_sif_base = <0x10280000 0x11 0xffff0000>;
		vdec1_base = <0x17030000 0x15 0xffff0000>;
		vdec2_base = <0x18040000 0x19 0xffff0000>;
		vdec3_base = <0x18050000 0x1a 0xffff0000>;
		vdec_base = <0x17010000 0x13 0xffff0000>;
		vdec_gcon_base = <0x18800000 0x5 0xffff0000>;
		venc_128byte_cnt_done = <0x125>;
		venc_done = <0x121>;
		venc_gcon_base = <0x18810000 0x6 0xffff0000>;
		venc_mb_done = <0x124>;
	};

	gce_mbox@10238000 {
		#gce-event-cells = <0x1>;
		#gce-subsys-cells = <0x2>;
		#mbox-cells = <0x3>;
		clock-names = "gce", "GCE_TIMER";
		clocks = <0x1f 0x9 0x1f 0x18>;
		compatible = "mediatek,mailbox-gce";
		interrupts = <0x0 0x62 0x8>;
		linux,phandle = <0x2b>;
		phandle = <0x2b>;
		reg = <0x0 0x10238000 0x0 0x4000>;
	};

	gic500@0c000000 {
		compatible = "mediatek,gic500";
		reg = <0x0 0xc000000 0x0 0x400000>;
	};

	gic_cpu@0c400000 {
		compatible = "mediatek,gic_cpu";
		reg = <0x0 0xc400000 0x0 0x40000>;
	};

	gpio {
		compatible = "mediatek,gpio_usage_mapping";
		linux,phandle = <0x4d>;
		phandle = <0x4d>;
	};

	gpio@10005000 {
		compatible = "mediatek,gpio";
		linux,phandle = <0x4e>;
		phandle = <0x4e>;
		reg = <0x0 0x10005000 0x0 0x1000>;
	};

	gpufreq {
		clock-names = "clk_mux", "clk_main_parent", "clk_sub_parent", "mtcmos_mfg_async", "mtcmos_mfg", "mtcmos_mfg_core0";
		clocks = <0x19 0x6d 0x19 0x28 0x1b 0x20 0x7 0x20 0x4 0x20 0x6>;
		compatible = "mediatek,mt6761-gpufreq";
	};

	hacc@1000a000 {
		compatible = "mediatek,hacc";
		interrupts = <0x0 0x85 0x8>;
		reg = <0x0 0x1000a000 0x0 0x1000>;
	};

	i2c0@11007000 {
		aed = <0x1a>;
		clock-div = <0x5>;
		clock-names = "main", "dma";
		clocks = <0x1f 0xb 0x1f 0x26>;
		compatible = "mediatek,i2c";
		eh_cfg = <0x20>;
		gpio_start = <0x10002a00>;
		id = <0x0>;
		interrupts = <0x0 0x1c 0x8>;
		linux,phandle = <0x7f>;
		mediatek,hs_only;
		mem_len = <0x200>;
		phandle = <0x7f>;
		pu_cfg = <0x50>;
		reg = <0x0 0x11007000 0x0 0x1000 0x0 0x11000080 0x0 0x80>;
		rsel_cfg = <0x70>;
		scl-gpio-id = <0x53>;
		sda-gpio-id = <0x52>;
	};

	i2c1@11008000 {
		aed = <0x1a>;
		clock-div = <0x5>;
		clock-names = "main", "dma";
		clocks = <0x1f 0xb 0x1f 0x26>;
		compatible = "mediatek,i2c";
		eh_cfg = <0x20>;
		gpio_start = <0x10002a00>;
		id = <0x1>;
		interrupts = <0x0 0x1d 0x8>;
		linux,phandle = <0x80>;
		mediatek,hs_only;
		mem_len = <0x200>;
		phandle = <0x80>;
		pu_cfg = <0x50>;
		reg = <0x0 0x11008000 0x0 0x1000 0x0 0x11000100 0x0 0x80>;
		rsel_cfg = <0x70>;
		scl-gpio-id = <0x54>;
		sda-gpio-id = <0x51>;
	};

	i2c2@11009000 {
		aed = <0x1a>;
		ch_offset_ccu = <0x200>;
		ch_offset_default = <0x100>;
		clock-div = <0x5>;
		clock-names = "main", "dma";
		clocks = <0x1f 0xb 0x1f 0x26>;
		compatible = "mediatek,i2c";
		eh_cfg = <0x20>;
		gpio_start = <0x10002800>;
		id = <0x2>;
		interrupts = <0x0 0x1e 0x8>;
		linux,phandle = <0x81>;
		mediatek,hs_only;
		mem_len = <0x200>;
		phandle = <0x81>;
		pu_cfg = <0x60>;
		reg = <0x0 0x11009000 0x0 0x1000 0x0 0x11000180 0x0 0x180>;
		rsel_cfg = <0xa0>;
		scl-gpio-id = <0x67>;
		sda-gpio-id = <0x68>;
	};

	i2c3@1100f000 {
		aed = <0x1a>;
		ch_offset_default = <0x100>;
		clock-div = <0x5>;
		clock-names = "main", "dma";
		clocks = <0x1f 0xb 0x1f 0x26>;
		compatible = "mediatek,i2c";
		eh_cfg = <0x20>;
		gpio_start = <0x10002600>;
		id = <0x3>;
		interrupts = <0x0 0x1f 0x8>;
		linux,phandle = <0x82>;
		mediatek,hs_only;
		mem_len = <0x200>;
		phandle = <0x82>;
		pu_cfg = <0x90>;
		reg = <0x0 0x1100f000 0x0 0x1000 0x0 0x11000300 0x0 0x100>;
		rsel_cfg = <0xb0>;
		scl-gpio-id = <0x32>;
		sda-gpio-id = <0x33>;
	};

	i2c4@11011000 {
		aed = <0x1a>;
		ch_offset_ccu = <0x200>;
		ch_offset_default = <0x100>;
		clock-div = <0x5>;
		clock-names = "main", "dma";
		clocks = <0x1f 0xb 0x1f 0x26>;
		compatible = "mediatek,i2c";
		eh_cfg = <0x20>;
		gpio_start = <0x10002800>;
		id = <0x4>;
		interrupts = <0x0 0x20 0x8>;
		linux,phandle = <0x83>;
		mediatek,hs_only;
		mem_len = <0x200>;
		phandle = <0x83>;
		pu_cfg = <0x60>;
		reg = <0x0 0x11011000 0x0 0x1000 0x0 0x11000400 0x0 0x180>;
		rsel_cfg = <0xa0>;
		scl-gpio-id = <0x69>;
		sda-gpio-id = <0x6a>;
	};

	i2c5@11016000 {
		aed = <0x1a>;
		clock-div = <0x5>;
		clock-names = "main", "dma";
		clocks = <0x1f 0xb 0x1f 0x26>;
		compatible = "mediatek,i2c";
		eh_cfg = <0x20>;
		gpio_start = <0x10002600>;
		id = <0x5>;
		interrupts = <0x0 0x4a 0x8>;
		linux,phandle = <0x84>;
		mediatek,hs_only;
		mem_len = <0x200>;
		phandle = <0x84>;
		pu_cfg = <0x90>;
		reg = <0x0 0x11016000 0x0 0x1000 0x0 0x11000580 0x0 0x80>;
		rsel_cfg = <0xb0>;
		scl-gpio-id = <0x30>;
		sda-gpio-id = <0x31>;
	};

	i2c6@1100d000 {
		aed = <0x1a>;
		ch_offset_ccu = <0x200>;
		ch_offset_default = <0x100>;
		clock-div = <0x5>;
		clock-names = "main", "dma";
		clocks = <0x1f 0xb 0x1f 0x26>;
		compatible = "mediatek,i2c";
		eh_cfg = <0x20>;
		gpio_start = <0x10002c00>;
		id = <0x6>;
		interrupts = <0x0 0x4b 0x8>;
		linux,phandle = <0x85>;
		mediatek,hs_only;
		mem_len = <0x200>;
		phandle = <0x85>;
		pu_cfg = <0x50>;
		reg = <0x0 0x1100d000 0x0 0x1000 0x0 0x11000600 0x0 0x80>;
		rsel_cfg = <0x70>;
		scl-gpio-id = <0xa1>;
		sda-gpio-id = <0xa2>;
	};

	i2c7 {
		linux,phandle = <0x86>;
		phandle = <0x86>;
	};

	i2c8 {
		linux,phandle = <0x87>;
		phandle = <0x87>;
	};

	i2c9 {
		linux,phandle = <0x88>;
		phandle = <0x88>;
	};

	i2c_common {
		check_max_freq = [01];
		cnt_constraint = [01];
		compatible = "mediatek,i2c_common";
		dma_support = [02];
		ext_time_config = [18 01];
		idvfs = [01];
		linux,phandle = <0x7e>;
		phandle = <0x7e>;
		set_dt_div = [01];
		set_ltiming = [01];
		ver = [02];
	};

	imp_iic@11017000 {
		compatible = "mediatek,imp_iic";
		reg = <0x0 0x11017000 0x0 0x1000>;
	};

	infra_mbist@1020d000 {
		compatible = "mediatek,infra_mbist";
		reg = <0x0 0x1020d000 0x0 0x1000>;
	};

	infracfg@1020e000 {
		compatible = "mediatek,infracfg";
		reg = <0x0 0x1020e000 0x0 0x1000>;
	};

	infracfg_ao@10001000 {
		#clock-cells = <0x1>;
		compatible = "mediatek,infracfg_ao", "syscon";
		interrupts = <0x0 0x5b 0x1>;
		linux,phandle = <0x1f>;
		phandle = <0x1f>;
		reg = <0x0 0x10001000 0x0 0x1000>;
	};

	interrupt-controller@0c000000 {
		#address-cells = <0x2>;
		#interrupt-cells = <0x3>;
		#redistributor-regions = <0x1>;
		#size-cells = <0x2>;
		compatible = "arm,gic-v3";
		interrupt-controller;
		interrupt-parent = <0xd>;
		interrupts = <0x1 0x9 0x4>;
		linux,phandle = <0xd>;
		phandle = <0xd>;
		reg = <0x0 0xc000000 0x0 0x40000 0x0 0xc080000 0x0 0x200000 0x0 0x10200a80 0x0 0x50>;
	};

	intpol-controller@10200a80 {
		#interrupt-cells = <0x3>;
		compatible = "mediatek,mt6577-sysirq";
		interrupt-controller;
		interrupt-parent = <0xd>;
		linux,phandle = <0x1>;
		phandle = <0x1>;
		reg = <0x0 0x10200a80 0x0 0x50>;
	};

	io_cfg_bl@10002600 {
		compatible = "mediatek,io_cfg_bl";
		reg = <0x0 0x10002600 0x0 0x200>;
	};

	io_cfg_lb@10002400 {
		compatible = "mediatek,io_cfg_lb";
		reg = <0x0 0x10002400 0x0 0x200>;
	};

	io_cfg_lm@10002200 {
		compatible = "mediatek,io_cfg_lm";
		reg = <0x0 0x10002200 0x0 0x200>;
	};

	io_cfg_lt@10002000 {
		compatible = "mediatek,io_cfg_lt";
		reg = <0x0 0x10002000 0x0 0x200>;
	};

	io_cfg_rb@10002a00 {
		compatible = "mediatek,io_cfg_rb";
		reg = <0x0 0x10002a00 0x0 0x200>;
	};

	io_cfg_rr@10002800 {
		compatible = "mediatek,io_cfg_rr";
		reg = <0x0 0x10002800 0x0 0x200>;
	};

	io_cfg_rt@10002c00 {
		compatible = "mediatek,io_cfg_rt";
		reg = <0x0 0x10002c00 0x0 0x200>;
	};

	iocfg_0@10002000 {
		compatible = "mediatek,iocfg_0";
		reg = <0x0 0x10002000 0x0 0x200>;
	};

	iocfg_1@10002200 {
		compatible = "mediatek,iocfg_1";
		reg = <0x0 0x10002200 0x0 0x200>;
	};

	iocfg_2@10002400 {
		compatible = "mediatek,iocfg_2";
		reg = <0x0 0x10002400 0x0 0x200>;
	};

	iocfg_3@10002600 {
		compatible = "mediatek,iocfg_3";
		reg = <0x0 0x10002600 0x0 0x200>;
	};

	iocfg_4@10002800 {
		compatible = "mediatek,iocfg_4";
		reg = <0x0 0x10002800 0x0 0x200>;
	};

	iocfg_5@10002a00 {
		compatible = "mediatek,iocfg_5";
		reg = <0x0 0x10002a00 0x0 0x200>;
	};

	irq_nfc {
		compatible = "mediatek,irq_nfc-eint";
		linux,phandle = <0x97>;
		phandle = <0x97>;
	};

	ispsys@15000000 {
		clock-names = "CG_SCP_SYS_DIS", "CG_SCP_SYS_CAM", "CG_CAM_LARB2", "CG_CAM", "CG_CAMTG", "CG_CAM_SENINF", "CG_CAMSV0", "CG_CAMSV1", "CG_MM_SMI_COMM0", "CG_MM_SMI_COMM1", "CG_MM_SMI_COMMON";
		clocks = <0x20 0x3 0x20 0x8 0x3c 0x0 0x3c 0x1 0x3c 0x2 0x3c 0x3 0x3c 0x4 0x3c 0x5 0x21 0x15 0x21 0x16 0x21 0x13>;
		compatible = "mediatek,mt6761-ispsys";
		interrupts = <0x0 0xb3 0x8 0x0 0xb4 0x8 0x0 0xb5 0x8 0x0 0xb8 0x8 0x0 0xb9 0x8 0x0 0xba 0x8 0x0 0xbb 0x8>;
		reg = <0x0 0x15004000 0x0 0x9000 0x0 0x1500d000 0x0 0x1000 0x0 0x15000000 0x0 0x52000 0x0 0x15040000 0x0 0x8000 0x0 0x10215000 0x0 0x3000 0x0 0x10211000 0x0 0x1000>;
	};

	kd_camera_hw1@15040000 {
		clock-names = "CLK_TOP_CAMTG_SEL", "CLK_TOP_CAMTG1_SEL", "CLK_TOP_CAMTG2_SEL", "CLK_TOP_CAMTG3_SEL", "CLK_MCLK_6M", "CLK_MCLK_12M", "CLK_MCLK_13M", "CLK_MCLK_48M", "CLK_MCLK_52M", "CLK_MCLK_24M", "CLK_MCLK_26M", "CLK_CAM_SENINF_CG", "CLK_MIPI_C0_26M_CG", "CLK_MIPI_C1_26M_CG", "CLK_MIPI_ANA_0A_CG", "CLK_MIPI_ANA_0B_CG", "CLK_MIPI_ANA_1A_CG", "CLK_MIPI_ANA_1B_CG", "CLK_MIPI_ANA_2A_CG", "CLK_MIPI_ANA_2B_CG", "CLK_TOP_CAMTM_SEL_CG", "CLK_TOP_CAMTM_208_CG", "CLK_SCP_SYS_CAM";
		clocks = <0x19 0x6f 0x19 0x70 0x19 0x71 0x19 0x72 0x19 0x16 0x19 0x15 0x19 0x20 0x19 0x13 0x19 0x1f 0x19 0x14 0x1b 0x3c 0x3 0x3b 0xc 0x3b 0x10 0x3d 0x0 0x3e 0x0 0x3f 0x0 0x40 0x0 0x41 0x0 0x42 0x0 0x19 0x86 0x19 0x1d 0x20 0x8>;
		compatible = "mediatek,camera_hw";
		linux,phandle = <0x9c>;
		phandle = <0x9c>;
		reg = <0x0 0x15040000 0x0 0x1000>;
	};

	kp@10010000 {
		compatible = "mediatek,kp";
		interrupts = <0x0 0x7c 0x2>;
		linux,phandle = <0xe>;
		phandle = <0xe>;
		reg = <0x0 0x10010000 0x0 0x1000>;
	};

	l2c_parity {
		compatible = "mediatek,l2c_parity-v1";
		interrupts = <0x0 0x0 0x4>;
	};

	lcm_gpio {
		compatible = "mediatek,lcm_gpio";
		linux,phandle = <0x72>;
		phandle = <0x72>;
	};

	led_pinctrl {
		compatible = "mediatek,led_pinctrl";
		linux,phandle = <0xaa>;
		phandle = <0xaa>;
	};

	lk_charger {
		ac_charger_current = <0x2625a0>;
		ac_charger_input_current = <0x1e8480>;
		atika_ac_charger_current = <0x16e360>;
		atika_ac_charger_input_current = <0xf4240>;
		atika_charging_host_charger_current = <0xf4240>;
		atika_non_std_ac_charger_current = <0xdbba0>;
		charging_host_charger_current = <0x16e360>;
		compatible = "mediatek,lk_charger";
		enable_anime;
		fast_charge_voltage = <0x2dc6c0>;
		linux,phandle = <0xa2>;
		max_charger_voltage = <0x632ea0>;
		non_std_ac_charger_current = <0xdbba0>;
		pd_charger_current = <0x7a120>;
		phandle = <0xa2>;
		power_path_support;
		ta_ac_charger_current = <0x1e8480>;
		temp_t1_threshold = <0x0>;
		temp_t3_threshold = <0x2d>;
		temp_t4_threshold = <0x32>;
		usb_charger_current = <0x7a120>;
	};

	m4u@10205000 {
		#iommu-cells = <0x1>;
		cell-index = <0x0>;
		compatible = "mediatek,iommu_v0";
		interrupts = <0x0 0x9e 0x8>;
		linux,phandle = <0x44>;
		mediatek,larbs = <0x1c 0x1d 0x1e>;
		phandle = <0x44>;
		reg = <0x0 0x10205000 0x0 0x1000>;
	};

	mbist@17050000 {
		compatible = "mediatek,mbist";
		reg = <0x0 0x17050000 0x0 0x10000>;
	};

	mbist_ao@10013000 {
		compatible = "mediatek,mbist_ao";
		reg = <0x0 0x10013000 0x0 0x1000>;
	};

	mcdi@0010fc00 {
		compatible = "mediatek,mt6761-mcdi";
		reg = <0x0 0x10fc00 0x0 0x800>;
	};

	mcucfg@10200000 {
		compatible = "mediatek,mcucfg";
		interrupts = <0x0 0x0 0x4>;
		reg = <0x0 0x10200000 0x0 0x200>;
	};

	mcucfg@10200200 {
		compatible = "mediatek,mcucfg";
		interrupts = <0x0 0x1 0x8>;
		reg = <0x0 0x10200200 0x0 0x200>;
	};

	mcucfg@10200400 {
		compatible = "mediatek,mcucfg";
		interrupts = <0x0 0x2 0x4>;
		reg = <0x0 0x10200400 0x0 0x200>;
	};

	mcucfg@10200600 {
		compatible = "mediatek,mcucfg";
		interrupts = <0x0 0x3 0x4>;
		reg = <0x0 0x10200600 0x0 0x200>;
	};

	mcucfg@10200800 {
		compatible = "mediatek,mcucfg";
		interrupts = <0x0 0x4 0x4>;
		reg = <0x0 0x10200800 0x0 0x200>;
	};

	mcucfg@10200a00 {
		compatible = "mediatek,mcucfg";
		interrupts = <0x0 0x5 0x8>;
		reg = <0x0 0x10200a00 0x0 0x300>;
	};

	mcucfg@10200f00 {
		compatible = "mediatek,mcucfg";
		interrupts = <0x0 0x6 0x8>;
		reg = <0x0 0x10200f00 0x0 0x100>;
	};

	mcucfg@10201000 {
		compatible = "mediatek,mcucfg";
		interrupts = <0x0 0x7 0x8>;
		reg = <0x0 0x10201000 0x0 0x1000>;
	};

	mcucfg@10202000 {
		compatible = "mediatek,mcucfg";
		interrupts = <0x0 0x8 0x8>;
		reg = <0x0 0x10202000 0x0 0x1000>;
	};

	mcucfg@10203000 {
		compatible = "mediatek,mcucfg";
		interrupts = <0x0 0x9 0x8>;
		reg = <0x0 0x10203000 0x0 0x1000>;
	};

	mcucfg_mp0_counter@10200000 {
		compatible = "mediatek,mcucfg_mp0_counter";
		reg = <0x0 0x10200000 0x0 0x4000>;
	};

	mcupm_reg@10216000 {
		compatible = "mediatek,mcupm_reg";
		reg = <0x0 0x10216000 0x0 0x1000>;
	};

	mcupm_sram0@10217000 {
		compatible = "mediatek,mcupm_sram0";
		reg = <0x0 0x10217000 0x0 0x1000>;
	};

	mcupm_sram1@10218000 {
		compatible = "mediatek,mcupm_sram1";
		reg = <0x0 0x10218000 0x0 0x1000>;
	};

	mcupm_sram2@10211000 {
		compatible = "mediatek,mcupm_sram2";
		reg = <0x0 0x10211000 0x0 0x1000>;
	};

	mcupm_sram3@10213000 {
		compatible = "mediatek,mcupm_sram3";
		reg = <0x0 0x10213000 0x0 0x1000>;
	};

	md1_sim1_hot_plug_eint {
		linux,phandle = <0x4b>;
		phandle = <0x4b>;
	};

	md1_sim2_hot_plug_eint {
		linux,phandle = <0x4c>;
		phandle = <0x4c>;
	};

	md_ccif0@1020a000 {
		compatible = "mediatek,md_ccif0";
		reg = <0x0 0x1020a000 0x0 0x1000>;
	};

	md_ccif1@1020c000 {
		compatible = "mediatek,md_ccif1";
		reg = <0x0 0x1020c000 0x0 0x1000>;
	};

	md_ccif2@1023d000 {
		compatible = "mediatek,md_ccif2";
		reg = <0x0 0x1023d000 0x0 0x1000>;
	};

	md_ccif3@1023f000 {
		compatible = "mediatek,md_ccif3";
		reg = <0x0 0x1023f000 0x0 0x1000>;
	};

	mdcldma@10014000 {
		clock-names = "scp-sys-md1-main", "infra-cldma-bclk", "infra-ccif-ap", "infra-ccif-md", "infra-ccif1-ap", "infra-ccif1-md", "infra-ccif2-ap", "infra-ccif2-md";
		clocks = <0x20 0x0 0x1f 0x32 0x1f 0x29 0x1f 0x2c 0x1f 0x23 0x1f 0x24 0x1f 0x58 0x1f 0x59>;
		compatible = "mediatek,mdcldma";
		interrupts = <0x0 0x6d 0x4 0x0 0x5c 0x8 0x0 0x5d 0x8 0x0 0xcd 0x2>;
		linux,phandle = <0x10>;
		mediatek,cldma_capability = <0x6>;
		mediatek,md_id = <0x0>;
		phandle = <0x10>;
		reg = <0x0 0x10014000 0x0 0x1000 0x0 0x1021b000 0x0 0x1000 0x0 0x10209000 0x0 0x1000 0x0 0x1020a000 0x0 0x1000>;
	};

	mdcldmain@1021c000 {
		compatible = "mediatek,mdcldmain";
		reg = <0x0 0x1021c000 0x0 0x400>;
	};

	mdcldmain_ao@10015000 {
		compatible = "mediatek,mdcldmain_ao";
		reg = <0x0 0x10015000 0x0 0x400>;
	};

	mdcldmamisc@1021c800 {
		compatible = "mediatek,mdcldmamisc";
		reg = <0x0 0x1021c800 0x0 0x1000>;
	};

	mdcldmamisc_ao@10015800 {
		compatible = "mediatek,mdcldmamisc_ao";
		reg = <0x0 0x10015800 0x0 0x400>;
	};

	mdcldmaout@1021c400 {
		compatible = "mediatek,mdcldmaout";
		reg = <0x0 0x1021c400 0x0 0x400>;
	};

	mdcldmaout_ao@10015400 {
		compatible = "mediatek,mdcldmaout_ao";
		reg = <0x0 0x10015400 0x0 0x400>;
	};

	mdp_ccorr0@14005000 {
		clock-names = "MDP_CCORR";
		clocks = <0x21 0x1>;
		compatible = "mediatek,mdp_ccorr0";
		interrupts = <0x0 0xaa 0x8>;
		linux,phandle = <0x29>;
		phandle = <0x29>;
		reg = <0x0 0x14005000 0x0 0x1000>;
	};

	mdp_rdma0@14004000 {
		clock-names = "MDP_RDMA0";
		clocks = <0x21 0x0>;
		compatible = "mediatek,mdp_rdma0";
		interrupts = <0x0 0x9b 0x8>;
		linux,phandle = <0x22>;
		phandle = <0x22>;
		reg = <0x0 0x14004000 0x0 0x1000>;
	};

	mdp_rsz0@14006000 {
		clock-names = "MDP_RSZ0";
		clocks = <0x21 0x2>;
		compatible = "mediatek,mdp_rsz0";
		interrupts = <0x0 0x9c 0x8>;
		linux,phandle = <0x23>;
		phandle = <0x23>;
		reg = <0x0 0x14006000 0x0 0x1000>;
	};

	mdp_rsz1@14007000 {
		clock-names = "MDP_RSZ1";
		clocks = <0x21 0x3>;
		compatible = "mediatek,mdp_rsz1";
		interrupts = <0x0 0x9d 0x8>;
		linux,phandle = <0x24>;
		phandle = <0x24>;
		reg = <0x0 0x14007000 0x0 0x1000>;
	};

	mdp_tdshp0@1400a000 {
		clock-names = "MDP_TDSHP";
		clocks = <0x21 0x4>;
		compatible = "mediatek,mdp_tdshp0";
		linux,phandle = <0x27>;
		phandle = <0x27>;
		reg = <0x0 0x1400a000 0x0 0x1000>;
	};

	mdp_wdma0@14008000 {
		clock-names = "MDP_WDMA";
		clocks = <0x21 0x6>;
		compatible = "mediatek,mdp_wdma0";
		interrupts = <0x0 0xa0 0x8>;
		linux,phandle = <0x25>;
		phandle = <0x25>;
		reg = <0x0 0x14008000 0x0 0x1000>;
	};

	mdp_wrot0@14009000 {
		clock-names = "MDP_WROT0";
		clocks = <0x21 0x5>;
		compatible = "mediatek,mdp_wrot0";
		interrupts = <0x0 0x9f 0x8>;
		linux,phandle = <0x26>;
		phandle = <0x26>;
		reg = <0x0 0x14009000 0x0 0x1000>;
	};

	memory {
		device_type = "memory";
		reg = <0x0 0x40000000 0x0 0x20000000>;
	};

	mfg_cfg@13ffe000 {
		#clock-cells = <0x1>;
		compatible = "mediatek,mfgcfg", "syscon";
		linux,phandle = <0x95>;
		phandle = <0x95>;
		reg = <0x0 0x13ffe000 0x0 0x1000>;
	};

	mfg_clark@13000000 {
		clock-frequency = <0x21f98280>;
		compatible = "mediatek,clark";
		interrupt-names = "RGX";
		interrupts = <0x0 0xcb 0x8>;
		reg = <0x0 0x13000000 0x0 0x80000>;
	};

	mipi_rx_ana_csi0a@11c10000 {
		#clock-cells = <0x1>;
		compatible = "mediatek,mipi_rx_ana_csi0a", "syscon";
		linux,phandle = <0x3d>;
		phandle = <0x3d>;
		reg = <0x0 0x11c10000 0x0 0x1000>;
	};

	mipi_rx_ana_csi0b@11c11000 {
		#clock-cells = <0x1>;
		compatible = "mediatek,mipi_rx_ana_csi0b", "syscon";
		linux,phandle = <0x3e>;
		phandle = <0x3e>;
		reg = <0x0 0x11c11000 0x0 0x1000>;
	};

	mipi_rx_ana_csi1@11c20000 {
		compatible = "mediatek,mipi_rx_ana_csi1";
		reg = <0x0 0x11c20000 0x0 0x10000>;
	};

	mipi_rx_ana_csi1a@11c12000 {
		#clock-cells = <0x1>;
		compatible = "mediatek,mipi_rx_ana_csi1a", "syscon";
		linux,phandle = <0x3f>;
		phandle = <0x3f>;
		reg = <0x0 0x11c12000 0x0 0x1000>;
	};

	mipi_rx_ana_csi1b@11c13000 {
		#clock-cells = <0x1>;
		compatible = "mediatek,mipi_rx_ana_csi1b", "syscon";
		linux,phandle = <0x40>;
		phandle = <0x40>;
		reg = <0x0 0x11c13000 0x0 0x1000>;
	};

	mipi_rx_ana_csi2@11c30000 {
		compatible = "mediatek,mipi_rx_ana_csi2";
		reg = <0x0 0x11c30000 0x0 0x10000>;
	};

	mipi_rx_ana_csi2a@11c14000 {
		#clock-cells = <0x1>;
		compatible = "mediatek,mipi_rx_ana_csi2a", "syscon";
		linux,phandle = <0x41>;
		phandle = <0x41>;
		reg = <0x0 0x11c14000 0x0 0x1000>;
	};

	mipi_rx_ana_csi2b@11c15000 {
		#clock-cells = <0x1>;
		compatible = "mediatek,mipi_rx_ana_csi2b", "syscon";
		linux,phandle = <0x42>;
		phandle = <0x42>;
		reg = <0x0 0x11c15000 0x0 0x1000>;
	};

	mipi_tx0@11c80000 {
		compatible = "mediatek,mipi_tx0";
		reg = <0x0 0x11c80000 0x0 0x10000>;
	};

	mm_mutex@14016000 {
		compatible = "mediatek,mm_mutex";
		linux,phandle = <0x9b>;
		phandle = <0x9b>;
		reg = <0x0 0x14016000 0x0 0x1000>;
	};

	mmdvfs_pmqos {
		cam_freq = "mm_step0", "mm_step1", "mm_step2";
		clock-names = "mmdvfs_clk_mm_sel_ck", "mmdvfs_clk_mmpll_ck", "mmdvfs_clk_univpll1_d2_ck", "mmdvfs_clk_mmpll_d2_ck";
		clocks = <0x19 0x6b 0x19 0x24 0x19 0x1a 0x19 0x25>;
		compatible = "mediatek,mmdvfs_pmqos";
		disp_freq = "mm_step0", "mm_step1", "mm_step2";
		img_freq = "mm_step0", "mm_step1", "mm_step2";
		mdp_freq = "mm_step0", "mm_step1", "mm_step2";
		mm_step0 = <0x1b4 0x1 0x0 0x1>;
		mm_step0_ext = <0x1b4 0x2 0x6 0x10c4ec>;
		mm_step1 = <0x138 0x1 0x0 0x2>;
		mm_step1_ext = <0x138 0x2 0x6 0x10c4ec>;
		mm_step2 = <0xe3 0x1 0x0 0x3>;
		mm_step2_ext = <0xe3 0x2 0x6 0x117627>;
		vdec_freq = "mm_step0", "mm_step1", "mm_step2";
		venc_freq = "mm_step0", "mm_step1", "mm_step2";
		vopp_steps = <0x0 0x1 0x3>;
	};

	mmsys_config@14000000 {
		#clock-cells = <0x1>;
		clock-names = "CAM_MDP", "IMG_DL_RELAY", "IMG_DL_ASYNC_TOP";
		clocks = <0x21 0x17 0x21 0x1a 0x21 0x1b>;
		compatible = "mediatek,mmsys_config", "syscon";
		interrupts = <0x0 0xab 0x8>;
		linux,phandle = <0x21>;
		phandle = <0x21>;
		reg = <0x0 0x14000000 0x0 0x1000>;
	};

	mobicore {
		compatible = "trustonic,mobicore";
		interrupts = <0x0 0xc2 0x1>;
	};

	modem_temp_share@10018000 {
		compatible = "mediatek,modem_temp_share";
		reg = <0x0 0x10018000 0x0 0x1000>;
	};

	mrdump_ext_rst {
		compatible = "mediatek, mrdump_ext_rst-eint";
		linux,phandle = <0x71>;
		mode = "IRQ";
		phandle = <0x71>;
		source = "EINT";
		status = "okay";
	};

	msdc0_pad_macro@11cd0000 {
		compatible = "mediatek,msdc0_pad_macro";
		reg = <0x0 0x11cd0000 0x0 0x10000>;
	};

	msdc0_top@11cd0000 {
		compatible = "mediatek,msdc0_top";
		reg = <0x0 0x11cd0000 0x0 0x1000>;
	};

	msdc1_ins@0 {
		compatible = "mediatek,mt6761-sdcard-ins";
		linux,phandle = <0x93>;
		phandle = <0x93>;
	};

	msdc1_pad_macro@11c90000 {
		compatible = "mediatek,msdc1_pad_macro";
		reg = <0x0 0x11c90000 0x0 0x10000>;
	};

	msdc1_top@11c90000 {
		compatible = "mediatek,msdc1_top";
		reg = <0x0 0x11c90000 0x0 0x1000>;
	};

	msdc@11230000 {
		bootable;
		bus-width = <0x8>;
		cap-mmc-highspeed;
		clk_src = [01];
		clock-names = "msdc0-clock", "msdc0-hclock", "msdc0-aes-clock";
		clocks = <0x1f 0x4f 0x1f 0x1c 0x1f 0x45>;
		compatible = "mediatek,msdc";
		host_function = [00];
		index = [00];
		interrupts = <0x0 0x17 0x8>;
		linux,phandle = <0x8f>;
		max-frequency = <0xbebc200>;
		mmc-ddr-1_8v;
		mmc-hs200-1_8v;
		mmc-hs400-1_8v;
		no-sd;
		no-sdio;
		non-removable;
		phandle = <0x8f>;
		pinctl = <0x2d>;
		pinctl_hs200 = <0x2f>;
		pinctl_hs400 = <0x2e>;
		reg = <0x0 0x11230000 0x0 0x10000>;
		register_setting = <0x30>;
		status = "okay";
		vmmc-supply = <0x31>;
	};

	msdc@11240000 {
		bus-width = <0x4>;
		cap-sd-highspeed;
		cd-gpios = <0x37 0x1 0x0>;
		cd_level = [01];
		clk_src = [02];
		clock-names = "msdc1-clock", "msdc1-hclock";
		clocks = <0x1f 0x50 0x1f 0x1d>;
		compatible = "mediatek,msdc";
		host_function = [01];
		index = [01];
		interrupts = <0x0 0x18 0x8>;
		linux,phandle = <0x90>;
		max-frequency = <0xbebc200>;
		no-mmc;
		no-sdio;
		phandle = <0x90>;
		pinctl = <0x32>;
		pinctl_ddr50 = <0x35>;
		pinctl_sdr104 = <0x33>;
		pinctl_sdr50 = <0x34>;
		reg = <0x0 0x11240000 0x0 0x10000>;
		register_setting = <0x36>;
		sd-uhs-ddr50;
		sd-uhs-sdr104;
		sd-uhs-sdr12;
		sd-uhs-sdr25;
		sd-uhs-sdr50;
		status = "okay";
		vmmc-supply = <0x38>;
		vqmmc-supply = <0x39>;
	};

	msdc@11250000 {
		compatible = "mediatek,msdc2";
		linux,phandle = <0x91>;
		phandle = <0x91>;
		reg = <0x0 0x11250000 0x0 0x10000>;
		status = "disable";
	};

	msdc@11260000 {
		compatible = "mediatek,msdc3";
		linux,phandle = <0x92>;
		phandle = <0x92>;
		reg = <0x0 0x11250000 0x0 0x10000>;
		status = "disable";
	};

	mt-pmic {
		compatible = "mediatek,mt_pmic";
		interrupt-controller;
		linux,phandle = <0x52>;
		phandle = <0x52>;

		buck_regulators {

			buck_vcore {
				linux,phandle = <0x56>;
				phandle = <0x56>;
				regulator-enable-ramp-delay = <0xdc>;
				regulator-max-microvolt = <0x1406f4>;
				regulator-min-microvolt = <0x7ea5e>;
				regulator-name = "vcore";
				regulator-ramp-delay = <0x186a>;
			};

			buck_vmodem {
				linux,phandle = <0x55>;
				phandle = <0x55>;
				regulator-enable-ramp-delay = <0xdc>;
				regulator-max-microvolt = <0x123716>;
				regulator-min-microvolt = <0x7a120>;
				regulator-name = "vmodem";
				regulator-ramp-delay = <0x186a>;
			};

			buck_vpa {
				linux,phandle = <0x58>;
				phandle = <0x58>;
				regulator-enable-ramp-delay = <0xdc>;
				regulator-max-microvolt = <0x37b1d0>;
				regulator-min-microvolt = <0x7a120>;
				regulator-name = "vpa";
				regulator-ramp-delay = <0xc350>;
			};

			buck_vproc {
				linux,phandle = <0x57>;
				phandle = <0x57>;
				regulator-enable-ramp-delay = <0xdc>;
				regulator-max-microvolt = <0x1406f4>;
				regulator-min-microvolt = <0x7ea5e>;
				regulator-name = "vproc";
				regulator-ramp-delay = <0x186a>;
			};

			buck_vs1 {
				linux,phandle = <0x54>;
				phandle = <0x54>;
				regulator-enable-ramp-delay = <0xdc>;
				regulator-max-microvolt = <0x2191c0>;
				regulator-min-microvolt = <0x124f80>;
				regulator-name = "vs1";
				regulator-ramp-delay = <0x30d4>;
			};
		};

		ldo_regulators {

			ldo_vaud28 {
				compatible = "regulator-fixed";
				linux,phandle = <0x69>;
				phandle = <0x69>;
				regulator-enable-ramp-delay = <0x108>;
				regulator-max-microvolt = <0x2ab980>;
				regulator-min-microvolt = <0x2ab980>;
				regulator-name = "vaud28";
			};

			ldo_vaux18 {
				compatible = "regulator-fixed";
				linux,phandle = <0x68>;
				phandle = <0x68>;
				regulator-enable-ramp-delay = <0x108>;
				regulator-max-microvolt = <0x1b7740>;
				regulator-min-microvolt = <0x1b7740>;
				regulator-name = "vaux18";
			};

			ldo_vcama {
				linux,phandle = <0x62>;
				phandle = <0x62>;
				regulator-enable-ramp-delay = <0x108>;
				regulator-max-microvolt = <0x2ab980>;
				regulator-min-microvolt = <0x2625a0>;
				regulator-name = "vcama";
			};

			ldo_vcamd {
				linux,phandle = <0x63>;
				phandle = <0x63>;
				regulator-enable-ramp-delay = <0x108>;
				regulator-max-microvolt = <0x1b7740>;
				regulator-min-microvolt = <0xf4240>;
				regulator-name = "vcamd";
			};

			ldo_vcamio {
				compatible = "regulator-fixed";
				linux,phandle = <0x64>;
				phandle = <0x64>;
				regulator-enable-ramp-delay = <0x108>;
				regulator-max-microvolt = <0x1b7740>;
				regulator-min-microvolt = <0x1b7740>;
				regulator-name = "vcamio";
			};

			ldo_vcn18 {
				compatible = "regulator-fixed";
				linux,phandle = <0x61>;
				phandle = <0x61>;
				regulator-enable-ramp-delay = <0x108>;
				regulator-max-microvolt = <0x1b7740>;
				regulator-min-microvolt = <0x1b7740>;
				regulator-name = "vcn18";
			};

			ldo_vcn28 {
				compatible = "regulator-fixed";
				linux,phandle = <0x60>;
				phandle = <0x60>;
				regulator-enable-ramp-delay = <0x108>;
				regulator-max-microvolt = <0x2ab980>;
				regulator-min-microvolt = <0x2ab980>;
				regulator-name = "vcn28";
			};

			ldo_vcn33_bt {
				linux,phandle = <0x5e>;
				phandle = <0x5e>;
				regulator-enable-ramp-delay = <0x108>;
				regulator-max-microvolt = <0x3567e0>;
				regulator-min-microvolt = <0x325aa0>;
				regulator-name = "vcn33_bt";
			};

			ldo_vcn33_wifi {
				linux,phandle = <0x5f>;
				phandle = <0x5f>;
				regulator-enable-ramp-delay = <0x108>;
				regulator-max-microvolt = <0x3567e0>;
				regulator-min-microvolt = <0x325aa0>;
				regulator-name = "vcn33_wifi";
			};

			ldo_vdram {
				linux,phandle = <0x6c>;
				phandle = <0x6c>;
				regulator-enable-ramp-delay = <0xce4>;
				regulator-max-microvolt = <0x124f80>;
				regulator-min-microvolt = <0x10c8e0>;
				regulator-name = "vdram";
			};

			ldo_vefuse {
				linux,phandle = <0x5d>;
				phandle = <0x5d>;
				regulator-enable-ramp-delay = <0x108>;
				regulator-max-microvolt = <0x325aa0>;
				regulator-min-microvolt = <0x124f80>;
				regulator-name = "vefuse";
			};

			ldo_vemc {
				linux,phandle = <0x31>;
				phandle = <0x31>;
				regulator-enable-ramp-delay = <0x2c>;
				regulator-max-microvolt = <0x325aa0>;
				regulator-min-microvolt = <0x2c4020>;
				regulator-name = "vemc";
			};

			ldo_vfe28 {
				compatible = "regulator-fixed";
				linux,phandle = <0x59>;
				phandle = <0x59>;
				regulator-enable-ramp-delay = <0x108>;
				regulator-max-microvolt = <0x2ab980>;
				regulator-min-microvolt = <0x2ab980>;
				regulator-name = "vfe28";
			};

			ldo_vibr {
				linux,phandle = <0x6f>;
				phandle = <0x6f>;
				regulator-enable-ramp-delay = <0x2c>;
				regulator-max-microvolt = <0x325aa0>;
				regulator-min-microvolt = <0x124f80>;
				regulator-name = "vibr";
			};

			ldo_vio18 {
				compatible = "regulator-fixed";
				linux,phandle = <0x6b>;
				phandle = <0x6b>;
				regulator-enable-ramp-delay = <0x108>;
				regulator-max-microvolt = <0x1b7740>;
				regulator-min-microvolt = <0x1b7740>;
				regulator-name = "vio18";
			};

			ldo_vio28 {
				compatible = "regulator-fixed";
				linux,phandle = <0x6a>;
				phandle = <0x6a>;
				regulator-enable-ramp-delay = <0x108>;
				regulator-max-microvolt = <0x2ab980>;
				regulator-min-microvolt = <0x2ab980>;
				regulator-name = "vio28";
			};

			ldo_vldo28 {
				linux,phandle = <0x65>;
				phandle = <0x65>;
				regulator-enable-ramp-delay = <0x108>;
				regulator-max-microvolt = <0x2dc6c0>;
				regulator-min-microvolt = <0x2ab980>;
				regulator-name = "vldo28";
			};

			ldo_vmc {
				linux,phandle = <0x39>;
				phandle = <0x39>;
				regulator-enable-ramp-delay = <0x2c>;
				regulator-max-microvolt = <0x325aa0>;
				regulator-min-microvolt = <0x1b7740>;
				regulator-name = "vmc";
			};

			ldo_vmch {
				linux,phandle = <0x38>;
				phandle = <0x38>;
				regulator-enable-ramp-delay = <0x2c>;
				regulator-max-microvolt = <0x325aa0>;
				regulator-min-microvolt = <0x2c4020>;
				regulator-name = "vmch";
			};

			ldo_vrf12 {
				compatible = "regulator-fixed";
				linux,phandle = <0x5c>;
				phandle = <0x5c>;
				regulator-enable-ramp-delay = <0x6e>;
				regulator-max-microvolt = <0x124f80>;
				regulator-min-microvolt = <0x124f80>;
				regulator-name = "vrf12";
			};

			ldo_vrf18 {
				compatible = "regulator-fixed";
				linux,phandle = <0x5b>;
				phandle = <0x5b>;
				regulator-enable-ramp-delay = <0x6e>;
				regulator-max-microvolt = <0x1b7740>;
				regulator-min-microvolt = <0x1b7740>;
				regulator-name = "vrf18";
			};

			ldo_vsim1 {
				linux,phandle = <0x6d>;
				phandle = <0x6d>;
				regulator-enable-ramp-delay = <0x108>;
				regulator-max-microvolt = <0x2f4d60>;
				regulator-min-microvolt = <0x19f0a0>;
				regulator-name = "vsim1";
			};

			ldo_vsim2 {
				linux,phandle = <0x6e>;
				phandle = <0x6e>;
				regulator-enable-ramp-delay = <0x108>;
				regulator-max-microvolt = <0x2f4d60>;
				regulator-min-microvolt = <0x19f0a0>;
				regulator-name = "vsim2";
			};

			ldo_vsram_others {
				linux,phandle = <0x66>;
				phandle = <0x66>;
				regulator-enable-ramp-delay = <0x6e>;
				regulator-max-microvolt = <0x1406f4>;
				regulator-min-microvolt = <0x7ea5e>;
				regulator-name = "vsram_others";
				regulator-ramp-delay = <0x186a>;
			};

			ldo_vsram_proc {
				linux,phandle = <0x67>;
				phandle = <0x67>;
				regulator-enable-ramp-delay = <0x6e>;
				regulator-max-microvolt = <0x1406f4>;
				regulator-min-microvolt = <0x7ea5e>;
				regulator-name = "vsram_proc";
				regulator-ramp-delay = <0x186a>;
			};

			ldo_vusb33 {
				linux,phandle = <0x70>;
				phandle = <0x70>;
				regulator-enable-ramp-delay = <0x108>;
				regulator-max-microvolt = <0x2f4d60>;
				regulator-min-microvolt = <0x2dc6c0>;
				regulator-name = "vusb33";
			};

			ldo_vxo22 {
				linux,phandle = <0x5a>;
				phandle = <0x5a>;
				regulator-enable-ramp-delay = <0x6e>;
				regulator-max-microvolt = <0x249f00>;
				regulator-min-microvolt = <0x2191c0>;
				regulator-name = "vxo22";
			};
		};

		mt635x-auxadc {
			#io-channel-cells = <0x1>;
			compatible = "mediatek,mt635x-auxadc";
			linux,phandle = <0x53>;
			phandle = <0x53>;

			accdet {
				channel = <0x9>;
			};

			bat_temp {
				channel = <0x3>;
				resistance-ratio = <0x1 0x1>;
			};

			batadc {
				avg-num = <0x80>;
				channel = <0x0>;
				resistance-ratio = <0x3 0x1>;
			};

			chip_temp {
				channel = <0x5>;
			};

			dcxo_temp {
				avg-num = <0x10>;
				channel = <0xd>;
			};

			hpofs_cal {
				avg-num = <0x100>;
				channel = <0xc>;
			};

			isense {
				avg-num = <0x80>;
				channel = <0x1>;
				resistance-ratio = <0x3 0x1>;
			};

			tsx_temp {
				avg-num = <0x80>;
				channel = <0xb>;
			};

			vbif {
				channel = <0xe>;
				resistance-ratio = <0x1 0x1>;
			};

			vcdt {
				channel = <0x2>;
			};

			vcore_temp {
				channel = <0x6>;
			};

			vproc_temp {
				channel = <0x7>;
			};
		};
	};

	mt6357_gauge {
		alias_name = "mt6357";
		compatible = "mediatek,mt6357_gauge";
		gauge_name = "gauge";
	};

	mt6370_pmu_dts {
		#interrupt-cells = <0x1>;
		interrupt-controller;
		linux,phandle = <0xab>;
		mt6370,intr_gpio = <0x37 0x3 0x0>;
		mt6370,intr_gpio_num = <0x3>;
		phandle = <0xab>;

		bled {
			compatible = "mediatek,mt6370_pmu_bled";
			interrupt-names = "bled_ocp";
			mt,bl_ocp_level = <0x2>;
			mt,bl_ovp_level = <0x3>;
			mt,bled_flash_ramp = <0x1>;
			mt,bled_name = "mt6370_pmu_bled";
			mt,bled_ramptime = <0x3>;
			mt,chan_en = <0xf>;
			mt,map_linear;
			mt,max_bled_brightness = <0x200>;
			mt,pwm_avg_cycle = <0x0>;
			mt,pwm_deglitch = <0x1>;
			mt,pwm_fsample = <0x2>;
			mt,use_pwm;
		};

		charger {
			aicr = <0x7a120>;
			charger_name = "primary_chg";
			compatible = "mediatek,mt6370_pmu_charger";
			cv = <0x426030>;
			dc_wdt = <0x3d0900>;
			enable_te;
			enable_wdt;
			ichg = <0x1e8480>;
			ieoc = <0x249f0>;
			interrupt-names = "chg_mivr", "chg_aiclmeasi", "attachi", "ovpctrl_uvp_d_evt", "chg_wdtmri", "chg_vbusov", "chg_tmri", "chg_treg";
			ircmp_resistor = <0x61a8>;
			ircmp_vclamp = <0x7d00>;
			load_switch_name = "primary_load_switch";
			mivr = <0x432380>;
			safety_timer = <0xc>;
		};

		core {
			compatible = "mediatek,mt6370_pmu_core";
			i2cstmr_rst_tmr = <0x0>;
			int_deg = <0x0>;
			int_wdt = <0x0>;
			interrupt-names = "otp", "vdda_ovp", "vdda_uv";
			mrstb_en;
			mrstb_tmr = <0x3>;
		};

		dsv {
			compatible = "mediatek,mt6370_pmu_dsv";
			db_delay = <0x3>;
			db_ext_en = <0x0>;
			db_freq_pm = <0x0>;
			db_periodic_fix = <0x0>;
			db_periodic_mode = <0x0>;
			db_single_pin = <0x0>;
			db_startup = <0x0>;
			db_vbst = <0x1644>;
			db_vneg_20ms = <0x1>;
			db_vneg_disc = <0x0>;
			db_vneg_slew = <0x1>;
			db_vpos_20ms = <0x1>;
			db_vpos_disc = <0x1>;
			db_vpos_slew = <0x1>;
			interrupt-names = "dsv_vneg_ocp", "dsv_vpos_ocp", "dsv_bst_ocp", "dsv_vneg_scp", "dsv_vpos_scp";

			mt6370_dsvn {
				regulator-max-microvolt = <0x5b8d80>;
				regulator-min-microvolt = <0x3d0900>;
				regulator-name = "dsv_neg";
			};

			mt6370_dsvp {
				regulator-max-microvolt = <0x5b8d80>;
				regulator-min-microvolt = <0x3d0900>;
				regulator-name = "dsv_pos";
			};
		};

		ldo {
			compatible = "mediatek,mt6370_pmu_ldo";
			interrupt-names = "ldo_oc";
			ldo_oms = <0x1>;
			ldo_vrc_lt = <0x1>;

			mt6370_ldo {
				regulator-max-microvolt = <0x3d0900>;
				regulator-min-microvolt = <0x186a00>;
				regulator-name = "irtx_ldo";
			};
		};

		mt6370_pmu_fled1 {
			compatible = "mediatek,mt6370_pmu_fled1";
			fled_enable = <0x1>;
			interrupt-names = "fled_lvf", "fled2_short", "fled1_short";
			strobe_cur = <0x124f80>;
			strobe_timeout = <0x960>;
			torch_cur = <0x493e0>;
		};

		mt6370_pmu_fled2 {
			compatible = "mediatek,mt6370_pmu_fled2";
			fled_enable = <0x1>;
			strobe_cur = <0xf4240>;
			strobe_timeout = <0x4b0>;
			torch_cur = <0x30d40>;
		};

		rgbled {
			compatible = "mediatek,mt6370_pmu_rgbled";
			interrupt-names = "isink4_short", "isink3_short", "isink2_short", "isink1_short", "isink4_open", "isink3_open", "isink2_open", "isink1_open";
			mt,led_default_trigger = "cc_mode", "cc_mode", "cc_mode", "none";
			mt,led_name = "mt6370_pmu_led1", "mt6370_pmu_led2", "mt6370_pmu_led3", "mt6370_pmu_led4";
		};
	};

	mt6370_pmu_eint {
		linux,phandle = <0xa6>;
		phandle = <0xa6>;
	};

	mt_charger {
		compatible = "mediatek,mt-charger";
		linux,phandle = <0xa1>;
		phandle = <0xa1>;
	};

	mt_soc_anc_pcm {
		compatible = "mediatek,mt_soc_pcm_anc";
	};

	mt_soc_btcvsd_rx_pcm {
		compatible = "mediatek,mt_soc_btcvsd_rx_pcm";
	};

	mt_soc_btcvsd_tx_pcm {
		compatible = "mediatek,mt_soc_btcvsd_tx_pcm";
	};

	mt_soc_codec_dummy_name {
		compatible = "mediatek,mt_soc_codec_dummy";
	};

	mt_soc_codec_name {
		compatible = "mediatek,mt_soc_codec_63xx";
		use_hp_depop_flow = <0x0>;
		use_ul_260k = <0x0>;
	};

	mt_soc_dai_name {
		compatible = "mediatek,mt_soc_dai_stub";
	};

	mt_soc_deep_buffer_dl_pcm {
		compatible = "mediatek,mt_soc_pcm_deep_buffer_dl";
	};

	mt_soc_dl1_awb_pcm {
		compatible = "mediatek,mt_soc_pcm_dl1_awb";
	};

	mt_soc_dl1_pcm@11220000 {
		clock-names = "aud_afe_clk", "aud_dac_clk", "aud_dac_predis_clk", "aud_adc_clk", "aud_apll22m_clk", "aud_apll1_tuner_clk", "aud_tml_clk", "aud_infra_clk", "mtkaif_26m_clk", "top_mux_audio", "top_mux_audio_int", "top_sys_pll1_d4", "top_mux_aud_1", "top_apll1_ck", "top_mux_aud_eng1", "top_apll1_d8", "apmixed_apll1", "top_clk26m_clk";
		clocks = <0x3a 0x0 0x3a 0x4 0x3a 0x5 0x3a 0x3 0x3a 0x1 0x3a 0x2 0x3a 0x6 0x1f 0x2b 0x1f 0x33 0x19 0x78 0x19 0x79 0x19 0x5 0x19 0x7a 0x19 0x2b 0x19 0x7b 0x19 0x2e 0x3b 0x6 0x1b>;
		compatible = "mediatek,mt_soc_pcm_dl1";
		interrupts = <0x0 0x61 0x8>;
		linux,phandle = <0x94>;
		phandle = <0x94>;
		reg = <0x0 0x11220000 0x0 0x1000>;
	};

	mt_soc_dl2_pcm {
		compatible = "mediatek,mt_soc_pcm_dl2";
	};

	mt_soc_dummy_pcm {
		compatible = "mediatek,mt_soc_pcm_dummy";
	};

	mt_soc_fm_i2s_awb_pcm {
		compatible = "mediatek,mt_soc_pcm_fm_i2s_awb";
	};

	mt_soc_fm_i2s_pcm {
		compatible = "mediatek,mt_soc_pcm_fm_i2s";
	};

	mt_soc_fm_mrgtx_pcm {
		compatible = "mediatek,mt_soc_pcm_fmtx";
	};

	mt_soc_hp_impedance_pcm {
		compatible = "mediatek,mt_soc_pcm_hp_impedance";
	};

	mt_soc_i2s0_awb_pcm {
		compatible = "mediatek,mt_soc_pcm_i2s0_awb";
	};

	mt_soc_i2s0_pcm {
		compatible = "mediatek,mt_soc_pcm_dl1_i2s0";
	};

	mt_soc_i2s0dl1_pcm {
		compatible = "mediatek,mt_soc_pcm_dl1_i2s0dl1";
	};

	mt_soc_mrgrx_awb_pcm {
		compatible = "mediatek,mt_soc_pcm_mrgrx_awb";
	};

	mt_soc_mrgrx_pcm {
		compatible = "mediatek,mt_soc_pcm_mrgrx";
	};

	mt_soc_pcm_dl1_scp_spk {
		compatible = "mediatek,mt_soc_pcm_dl1_scp_spk";
	};

	mt_soc_pcm_voice_scp {
		compatible = "mediatek,mt_soc_pcm_voice_scp";
	};

	mt_soc_pcm_voice_ultra {
		compatible = "mediatek,mt_soc_pcm_voice_ultra";
	};

	mt_soc_pcm_voice_usb {
		compatible = "mediatek,mt_soc_pcm_voice_usb";
	};

	mt_soc_pcm_voice_usb_echoref {
		compatible = "mediatek,mt_soc_pcm_voice_usb_echoref";
	};

	mt_soc_routing_dai_name {
		compatible = "mediatek,mt_soc_dai_routing";
	};

	mt_soc_routing_pcm {
		compatible = "mediatek,mt_soc_pcm_routing";
	};

	mt_soc_tdmrx_pcm {
		compatible = "mediatek,mt_soc_tdm_capture";
	};

	mt_soc_ul1_pcm {
		compatible = "mediatek,mt_soc_pcm_capture";
	};

	mt_soc_ul2_pcm {
		compatible = "mediatek,mt_soc_pcm_capture2";
	};

	mt_soc_uldlloopback_pcm {
		compatible = "mediatek,mt_soc_pcm_uldlloopback";
	};

	mt_soc_voice_md1 {
		compatible = "mediatek,mt_soc_pcm_voice_md1";
	};

	mt_soc_voice_md1_bt {
		compatible = "mediatek,mt_soc_pcm_voice_md1_bt";
	};

	mt_soc_voice_md2 {
		compatible = "mediatek,mt_soc_pcm_voice_md2";
	};

	mt_soc_voice_md2_bt {
		compatible = "mediatek,mt_soc_pcm_voice_md2_bt";
	};

	mt_soc_voip_bt_in {
		compatible = "mediatek,mt_soc_pcm_bt_dai";
	};

	mt_soc_voip_bt_out {
		compatible = "mediatek,mt_soc_pcm_dl1_bt";
	};

	mtkfb@0 {
		compatible = "mediatek,mtkfb";
		linux,phandle = <0x98>;
		phandle = <0x98>;
	};

	nfc {
		compatible = "mediatek,nfc-gpio-v2";
		gpio-irq = <0xa>;
		gpio-irq-std = <0x37 0xa 0x0>;
		gpio-rst = <0xac>;
		gpio-rst-std = <0x37 0xac 0x0>;
		linux,phandle = <0x96>;
		phandle = <0x96>;
	};

	nfi@11018000 {
		compatible = "mediatek,nfi";
		reg = <0x0 0x11018000 0x0 0x1000>;
	};

	nfiecc@11019000 {
		compatible = "mediatek,nfiecc";
		reg = <0x0 0x11019000 0x0 0x1000>;
	};

	odm {
		compatible = "simple-bus";
		linux,phandle = <0xa0>;
		phandle = <0xa0>;
	};

	otg_iddig {
		compatible = "mediatek,usb_iddig_bi_eint";
		linux,phandle = <0x9f>;
		phandle = <0x9f>;
	};

	pericfg@10003000 {
		#clock-cells = <0x1>;
		compatible = "mediatek,pericfg", "syscon";
		linux,phandle = <0x48>;
		phandle = <0x48>;
		reg = <0x0 0x10003000 0x0 0x1000>;
	};

	pinctrl@1000b000 {
		#gpio-cells = <0x2>;
		#interrupt-cells = <0x4>;
		compatible = "mediatek,mt6761-pinctrl";
		gpio-controller;
		interrupt-controller;
		interrupts = <0x0 0x73 0x4>;
		linux,phandle = <0x37>;
		mediatek,pctl-regmap = <0x11 0x12 0x13 0x14 0x15 0x16 0x17 0x18>;
		phandle = <0x37>;
		pins-are-numbered;
		reg = <0x0 0x1000b000 0x0 0x1000>;

		msdc0@default {
			linux,phandle = <0x2d>;
			phandle = <0x2d>;

			pins_clk {
				drive-strength = [03];
			};

			pins_cmd {
				drive-strength = [03];
			};

			pins_dat {
				drive-strength = [03];
			};

			pins_ds {
				drive-strength = [03];
			};

			pins_rst {
				drive-strength = [03];
			};
		};

		msdc0@hs200 {
			linux,phandle = <0x2f>;
			phandle = <0x2f>;

			pins_clk {
				drive-strength = [04];
			};

			pins_cmd {
				drive-strength = [03];
			};

			pins_dat {
				drive-strength = [04];
			};

			pins_ds {
				drive-strength = [04];
			};

			pins_rst {
				drive-strength = [03];
			};
		};

		msdc0@hs400 {
			linux,phandle = <0x2e>;
			phandle = <0x2e>;

			pins_clk {
				drive-strength = [04];
			};

			pins_cmd {
				drive-strength = [03];
			};

			pins_dat {
				drive-strength = [04];
			};

			pins_ds {
				drive-strength = [04];
			};

			pins_rst {
				drive-strength = [03];
			};
		};

		msdc0@register_default {
			cmd_edge = [00];
			linux,phandle = <0x30>;
			phandle = <0x30>;
			rdata_edge = [00];
			wdata_edge = [00];
		};

		msdc1@ddr50 {
			linux,phandle = <0x35>;
			phandle = <0x35>;

			pins_clk {
				drive-strength = [03];
			};

			pins_cmd {
				drive-strength = [03];
			};

			pins_dat {
				drive-strength = [03];
			};
		};

		msdc1@default {
			linux,phandle = <0x32>;
			phandle = <0x32>;

			pins_clk {
				drive-strength = [03];
			};

			pins_cmd {
				drive-strength = [03];
			};

			pins_dat {
				drive-strength = [03];
			};
		};

		msdc1@register_default {
			cmd_edge = [00];
			linux,phandle = <0x36>;
			phandle = <0x36>;
			rdata_edge = [00];
			wdata_edge = [00];
		};

		msdc1@sdr104 {
			linux,phandle = <0x33>;
			phandle = <0x33>;

			pins_clk {
				drive-strength = [03];
			};

			pins_cmd {
				drive-strength = [03];
			};

			pins_dat {
				drive-strength = [03];
			};
		};

		msdc1@sdr50 {
			linux,phandle = <0x34>;
			phandle = <0x34>;

			pins_clk {
				drive-strength = [03];
			};

			pins_cmd {
				drive-strength = [03];
			};

			pins_dat {
				drive-strength = [03];
			};
		};

		msdc3@default {
			linux,phandle = <0x4f>;
			phandle = <0x4f>;

			pins_clk {
				drive-strength = [04];
			};

			pins_cmd {
				drive-strength = [04];
			};

			pins_dat {
				drive-strength = [04];
			};
		};

		msdc3@register_default {
			cmd_edge = [01];
			linux,phandle = <0x50>;
			phandle = <0x50>;
			rdata_edge = [01];
			wdata_edge = [01];
		};
	};

	pmic_clock_buffer_ctrl {
		compatible = "mediatek,pmic_clock_buffer";
		linux,phandle = <0xa7>;
		mediatek,clkbuf-config = <0x2 0x1 0x1 0x2 0x0 0x0 0x0>;
		mediatek,clkbuf-driving-current = <0x1 0x1 0x1 0x1 0x1 0x1 0x1>;
		mediatek,clkbuf-quantity = <0x7>;
		phandle = <0xa7>;
	};

	pmu {
		compatible = "arm,armv8-pmuv3";
		interrupt-parent = <0xd>;
		interrupts = <0x1 0x7 0x8>;
	};

	pogo_charger {
		compatible = "mediatek,pogo-charger";
		linux,phandle = <0xa4>;
		phandle = <0xa4>;
		pogo,en_gpio = <0x37 0xb1 0x0>;
		pogo,intr_pogo_0 = <0x37 0x5 0x0>;
		pogo,intr_pogo_1 = <0x37 0x9 0x0>;
		pogo,otg_gpio = <0x37 0xa9 0x0>;
		pogo,wrx_gpio = <0x37 0xd 0x0>;
	};

	psci {
		compatible = "arm,psci-1.0";
		method = "smc";
	};

	pseudo_m4u {
		compatible = "mediatek,mt-pseudo_m4u";
		iommus = <0x44 0x2>;
	};

	pseudo_m4u-larb0 {
		compatible = "mediatek,mt-pseudo_m4u-port";
		iommus = <0x44 0x0 0x44 0x1 0x44 0x2 0x44 0x3 0x44 0x4 0x44 0x5 0x44 0x6 0x44 0x7>;
		mediatek,larbid = <0x0>;
	};

	pseudo_m4u-larb1 {
		compatible = "mediatek,mt-pseudo_m4u-port";
		iommus = <0x44 0x20 0x44 0x21>;
		mediatek,larbid = <0x1>;
	};

	pseudo_m4u-larb2 {
		compatible = "mediatek,mt-pseudo_m4u-port";
		iommus = <0x44 0x40 0x44 0x41>;
		mediatek,larbid = <0x2>;
	};

	pwm@11006000 {
		clock-names = "PWM1-main", "PWM2-main", "PWM3-main", "PWM4-main", "PWM5-main", "PWM6-main", "PWM-HCLK-main", "PWM-main";
		clocks = <0x1f 0x10 0x1f 0x11 0x1f 0x12 0x1f 0x13 0x1f 0x14 0x1f 0x30 0x1f 0xf 0x1f 0x15>;
		compatible = "mediatek,pwm";
		interrupts = <0x0 0x15 0x8>;
		linux,phandle = <0x7d>;
		phandle = <0x7d>;
		reg = <0x0 0x11006000 0x0 0x1000>;
	};

	pwrap@1000d000 {
		compatible = "mediatek,pwrap";
		interrupts = <0x0 0x7b 0x4>;
		reg = <0x0 0x1000d000 0x0 0x1000>;
	};

	radio_md_cfg {
		compatible = "mediatek,radio_md_cfg";
		linux,phandle = <0xa8>;
		phandle = <0xa8>;
	};

	reserved-memory {
		#address-cells = <0x2>;
		#size-cells = <0x2>;
		linux,phandle = <0x46>;
		phandle = <0x46>;
		ranges;

		consys-reserve-memory {
			alignment = <0x0 0x1000000>;
			alloc-ranges = <0x0 0x40000000 0x0 0x80000000>;
			compatible = "mediatek,consys-reserve-memory";
			no-map;
			size = <0x0 0x400000>;
		};

		minirdump-reserved-memory@47d70000 {
			compatible = "mediatek,minirdump";
			reg = <0x0 0x47d70000 0x0 0x10000>;
		};

		pstore-reserved-memory@47c90000 {
			compatible = "mediatek,pstore";
			reg = <0x0 0x47c90000 0x0 0xe0000>;
		};

		ram_console-reserved-memory@47c80000 {
			compatible = "mediatek,ram_console";
			reg = <0x0 0x47c80000 0x0 0x10000>;
		};

		reserve-memory-scp_share {
			alignment = <0x0 0x1000000>;
			alloc-ranges = <0x0 0x40000000 0x0 0x50000000>;
			compatible = "mediatek,reserve-memory-scp_share";
			no-map;
			size = <0x0 0x300000>;
		};

		reserve-memory-sspm_share {
			alignment = <0x0 0x10000>;
			alloc-ranges = <0x0 0x40000000 0x0 0x60000000>;
			compatible = "mediatek,reserve-memory-sspm_share";
			no-map;
			size = <0x0 0x510000>;
			status = "okay";
		};

		soter-shared-mem {
			alloc-ranges = <0x0 0x40000000 0x0 0x50000000>;
			compatible = "microtrust,shared_mem";
			no-map;
			size = <0x0 0x200000>;
		};

		wifi-reserve-memory {
			alignment = <0x0 0x1000000>;
			alloc-ranges = <0x0 0x40000000 0x0 0x80000000>;
			compatible = "mediatek,wifi-reserve-memory";
			no-map;
			size = <0x0 0x300000>;
		};
	};

	rt-pd-manager {
		compatible = "mediatek,rt-pd-manager";
	};

	rt9465_slave_chr {
		compatible = "richtek,rt9465";
		linux,phandle = <0xa5>;
		phandle = <0xa5>;
		status = "disabled";
	};

	scp@10500000 {
		compatible = "mediatek,scp";
		core_1 = "enable";
		interrupts = <0x0 0x88 0x4>;
		reg = <0x0 0x10500000 0x0 0x40000 0x0 0x105c0000 0x0 0x3000 0x0 0x105c4000 0x0 0x1000 0x0 0x105d4000 0x0 0x6000>;
		scp_sramSize = <0x40000>;
		status = "okay";
	};

	scp_dvfs {
		clock-names = "clk_mux", "clk_pll_0", "clk_pll_1", "clk_pll_2", "clk_pll_3", "clk_pll_4", "clk_pll_5", "clk_pll_6";
		clocks = <0x19 0x6c 0x1b 0x19 0x10 0x19 0x1d 0x19 0x4 0x19 0x1a 0x19 0x8 0x19 0x1c>;
		compatible = "mediatek,scp_dvfs";
	};

	scpsys@10001000 {
		#clock-cells = <0x1>;
		compatible = "mediatek,scpsys", "syscon";
		linux,phandle = <0x20>;
		phandle = <0x20>;
		reg = <0x0 0x10001000 0x0 0x1000 0x0 0x10006000 0x0 0x1000 0x0 0x14002000 0x0 0x1000 0x0 0x1020e000 0x0 0x1000 0x0 0x18004000 0x0 0x1000>;
	};

	security_ao@1001a000 {
		compatible = "mediatek,security_ao";
		reg = <0x0 0x1001a000 0x0 0x1000>;
	};

	serial@11020000 {
		clock-names = "baud", "bus";
		clocks = <0x1b 0x1f 0x16>;
		compatible = "mediatek,mt6761-uart", "mediatek,mt6577-uart";
		dma-names = "tx", "rx";
		dmas = <0x2c 0x0 0x2c 0x1>;
		interrupts = <0x0 0x23 0x8>;
		linux,phandle = <0x7b>;
		phandle = <0x7b>;
		reg = <0x0 0x11002000 0x0 0x1000>;
	};

	serial@11030000 {
		clock-names = "baud", "bus";
		clocks = <0x1b 0x1f 0x17>;
		compatible = "mediatek,mt6761-uart", "mediatek,mt6577-uart";
		interrupts = <0x0 0x24 0x8>;
		linux,phandle = <0x7c>;
		phandle = <0x7c>;
		reg = <0x0 0x11003000 0x0 0x1000>;
	};

	sleep@10006000 {
		compatible = "mediatek,sleep";
		interrupts = <0x0 0x7d 0x8>;
		reg = <0x0 0x10006000 0x0 0x1000>;
		wakeup-source = <0xe 0x0 0x4 0xf 0x1 0x20 0x10 0x3 0x2000000>;
	};

	sleep_reg_md@1000f000 {
		compatible = "mediatek,sleep_reg_md";
		reg = <0x0 0x1000f000 0x0 0x1000>;
	};

	smart_pa {
		linux,phandle = <0x49>;
		phandle = <0x49>;
	};

	smi_common@14002000 {
		clock-names = "mtcmos-dis", "smi-comm0", "smi-comm1", "smi-common";
		clocks = <0x20 0x3 0x21 0x15 0x21 0x16 0x21 0x13>;
		compatible = "mediatek,smi_common";
		larbs = <0x1c 0x1d 0x1e>;
		mmsys_config = <0x21>;
		nr_larbs = <0x3>;
		reg = <0x0 0x14002000 0x0 0x1000>;
	};

	smi_larb0@14003000 {
		cell-index = <0x0>;
		clock-names = "mtcmos-dis", "smi-larb0";
		clocks = <0x20 0x3 0x21 0x14>;
		compatible = "mediatek,smi_larb0", "mediatek,smi_larb";
		linux,phandle = <0x1c>;
		phandle = <0x1c>;
		reg = <0x0 0x14003000 0x0 0x1000>;
	};

	smi_larb1@17010000 {
		cell-index = <0x1>;
		clock-names = "mtcmos-vcodec", "venc-larb1";
		clocks = <0x20 0x9 0x43 0x1>;
		compatible = "mediatek,smi_larb1", "mediatek,smi_larb";
		linux,phandle = <0x1d>;
		phandle = <0x1d>;
		reg = <0x0 0x17010000 0x0 0x10000>;
	};

	smi_larb2@15001000 {
		cell-index = <0x2>;
		clock-names = "mtcmos-cam", "gals-cam2img", "cam-larb2";
		clocks = <0x20 0x8 0x21 0x18 0x3c 0x0>;
		compatible = "mediatek,smi_larb2", "mediatek,smi_larb";
		linux,phandle = <0x1e>;
		phandle = <0x1e>;
		reg = <0x0 0x15001000 0x0 0x1000>;
	};

	spi0@1100a000 {
		clock-names = "parent-clk", "sel-clk", "spi-clk";
		clocks = <0x19 0xd 0x19 0x74 0x1f 0x1b>;
		compatible = "mediatek,mt6765-spi";
		interrupts = <0x0 0x3e 0x8>;
		linux,phandle = <0x89>;
		mediatek,pad-select = <0x0>;
		phandle = <0x89>;
		reg = <0x0 0x1100a000 0x0 0x1000>;
	};

	spi1@11010000 {
		clock-names = "parent-clk", "sel-clk", "spi-clk";
		clocks = <0x19 0xd 0x19 0x74 0x1f 0x34>;
		compatible = "mediatek,mt6765-spi";
		interrupts = <0x0 0x42 0x8>;
		linux,phandle = <0x8a>;
		mediatek,pad-select = <0x0>;
		phandle = <0x8a>;
		reg = <0x0 0x11010000 0x0 0x1000>;
	};

	spi2@11012000 {
		clock-names = "parent-clk", "sel-clk", "spi-clk";
		clocks = <0x19 0xd 0x19 0x74 0x1f 0x37>;
		compatible = "mediatek,mt6765-spi";
		interrupts = <0x0 0x48 0x8>;
		linux,phandle = <0x8b>;
		mediatek,pad-select = <0x0>;
		phandle = <0x8b>;
		reg = <0x0 0x11012000 0x0 0x1000>;
	};

	spi3@11013000 {
		clock-names = "parent-clk", "sel-clk", "spi-clk";
		clocks = <0x19 0xd 0x19 0x74 0x1f 0x38>;
		compatible = "mediatek,mt6765-spi";
		interrupts = <0x0 0x49 0x8>;
		linux,phandle = <0x8c>;
		mediatek,pad-select = <0x0>;
		phandle = <0x8c>;
		reg = <0x0 0x11013000 0x0 0x1000>;
	};

	spi4@11014000 {
		clock-names = "parent-clk", "sel-clk", "spi-clk";
		clocks = <0x19 0xd 0x19 0x74 0x1f 0x41>;
		compatible = "mediatek,mt6765-spi";
		interrupts = <0x0 0x27 0x8>;
		linux,phandle = <0x8d>;
		mediatek,pad-select = <0x0>;
		phandle = <0x8d>;
		reg = <0x0 0x11014000 0x0 0x1000>;
	};

	spi5@11015000 {
		clock-names = "parent-clk", "sel-clk", "spi-clk";
		clocks = <0x19 0xd 0x19 0x74 0x1f 0x42>;
		compatible = "mediatek,mt6765-spi";
		interrupts = <0x0 0x28 0x8>;
		linux,phandle = <0x8e>;
		mediatek,pad-select = <0x0>;
		phandle = <0x8e>;
		reg = <0x0 0x11015000 0x0 0x1000>;
	};

	sramrom@10214000 {
		compatible = "mediatek,sramrom";
		reg = <0x0 0x10214000 0x0 0x1000>;
	};

	sspm@10440000 {
		compatible = "mediatek,sspm";
		interrupt-names = "ipc", "mbox0", "mbox1", "mbox2", "mbox3", "mbox4";
		interrupts = <0x0 0x92 0x4 0x0 0x95 0x4 0x0 0x96 0x4 0x0 0x97 0x4 0x0 0x98 0x4 0x0 0x99 0x4>;
		reg = <0x0 0x10440000 0x0 0x10000 0x0 0x10450000 0x0 0x100 0x0 0x10451000 0x0 0x8 0x0 0x10460000 0x0 0x100 0x0 0x10461000 0x0 0x8 0x0 0x10470000 0x0 0x100 0x0 0x10471000 0x0 0x8 0x0 0x10480000 0x0 0x100 0x0 0x10481000 0x0 0x8 0x0 0x10490000 0x0 0x100 0x0 0x10491000 0x0 0x8>;
		reg-names = "cfgreg", "mbox0_base", "mbox0_ctrl", "mbox1_base", "mbox1_ctrl", "mbox2_base", "mbox2_ctrl", "mbox3_base", "mbox3_ctrl", "mbox4_base", "mbox4_ctrl";
	};

	swtp {
		compatible = "mediatek, swtp-eint";
		linux,phandle = <0x99>;
		phandle = <0x99>;
	};

	sys_cirq@10204000 {
		compatible = "mediatek,sys_cirq";
		interrupts = <0x0 0xe0 0x8>;
		mediatek,cirq_num = <0xd1>;
		mediatek,spi_start_offset = <0x10>;
		reg = <0x0 0x10204000 0x0 0x1000>;
	};

	sys_timer@10017000 {
		compatible = "mediatek,sys_timer";
		interrupts = <0x0 0x8a 0x4>;
		reg = <0x0 0x10017000 0x0 0x1000>;
		reg-names = "sys_timer_base";
	};

	syscfg_pctl_0@10005000 {
		compatible = "mediatek,mt6761-pctl-0-syscfg", "syscon";
		linux,phandle = <0x11>;
		phandle = <0x11>;
		reg = <0x0 0x10005000 0x0 0x1000>;
	};

	syscfg_pctl_1@10002000 {
		compatible = "mediatek,mt6761-pctl-1-syscfg", "syscon";
		linux,phandle = <0x12>;
		phandle = <0x12>;
		reg = <0x0 0x10002000 0x0 0x1000>;
	};

	syscfg_pctl_2@10002200 {
		compatible = "mediatek,mt6761-pctl-2-syscfg", "syscon";
		linux,phandle = <0x13>;
		phandle = <0x13>;
		reg = <0x0 0x10002200 0x0 0x1000>;
	};

	syscfg_pctl_3@10002400 {
		compatible = "mediatek,mt6761-pctl-3-syscfg", "syscon";
		linux,phandle = <0x14>;
		phandle = <0x14>;
		reg = <0x0 0x10002400 0x0 0x1000>;
	};

	syscfg_pctl_4@10002600 {
		compatible = "mediatek,mt6761-pctl-4-syscfg", "syscon";
		linux,phandle = <0x15>;
		phandle = <0x15>;
		reg = <0x0 0x10002600 0x0 0x1000>;
	};

	syscfg_pctl_5@10002800 {
		compatible = "mediatek,mt6761-pctl-5-syscfg", "syscon";
		linux,phandle = <0x16>;
		phandle = <0x16>;
		reg = <0x0 0x10002800 0x0 0x1000>;
	};

	syscfg_pctl_6@10002a00 {
		compatible = "mediatek,mt6761-pctl-6-syscfg", "syscon";
		linux,phandle = <0x17>;
		phandle = <0x17>;
		reg = <0x0 0x10002a00 0x0 0x1000>;
	};

	syscfg_pctl_7@10002c00 {
		compatible = "mediatek,mt6761-pctl-7-syscfg", "syscon";
		linux,phandle = <0x18>;
		phandle = <0x18>;
		reg = <0x0 0x10002c00 0x0 0x1000>;
	};

	tcpc_pd {
		linux,phandle = <0x4a>;
		phandle = <0x4a>;
	};

	therm_ctrl@1100b000 {
		clock-names = "therm-main";
		clocks = <0x1f 0xa>;
		compatible = "mediatek,therm_ctrl";
		interrupts = <0x0 0x16 0x8>;
		reg = <0x0 0x1100b000 0x0 0x1000>;
	};

	timer {
		clock-frequency = <0xc65d40>;
		compatible = "arm,armv8-timer";
		interrupt-parent = <0xd>;
		interrupts = <0x1 0xd 0x8 0x1 0xe 0x8 0x1 0xb 0x8 0x1 0xa 0x8>;
	};

	timer@10008000 {
		clock-names = "clk13m", "clk32k";
		clocks = <0x19 0x87 0x1a>;
		compatible = "mediatek,apxgpt";
		interrupts = <0x0 0x72 0x8>;
		linux,phandle = <0x51>;
		phandle = <0x51>;
		reg = <0x0 0x10008000 0x0 0x1000>;
	};

	tkcore {
		compatible = "trustkernel,tkcore";
		interrupts = <0x0 0xc4 0x1>;
	};

	topckgen@10000000 {
		#clock-cells = <0x1>;
		compatible = "mediatek,topckgen", "syscon";
		linux,phandle = <0x19>;
		phandle = <0x19>;
		reg = <0x0 0x10000000 0x0 0x1000>;
	};

	topckgen_ao@1001b000 {
		compatible = "mediatek,topckgen_ao";
		reg = <0x0 0x1001b000 0x0 0x1000>;
	};

	topmisc@10011000 {
		compatible = "mediatek,topmisc";
		reg = <0x0 0x10011000 0x0 0x1000>;
	};

	toprgu@10007000 {
		compatible = "mediatek,toprgu";
		interrupts = <0x0 0x53 0x0>;
		reg = <0x0 0x10007000 0x0 0x1000>;
	};

	touch {
		compatible = "mediatek,touch";
		linux,phandle = <0x73>;
		phandle = <0x73>;
	};

	trng@1020f000 {
		compatible = "mediatek,trng";
		interrupts = <0x0 0x69 0x8>;
		reg = <0x0 0x1020f000 0x0 0x1000>;
	};

	type_c_port0 {
		linux,phandle = <0xac>;
		mt-tcpc,name = "type_c_port0";
		mt-tcpc,role_def = <0x4>;
		mt-tcpc,rp_level = <0x0>;
		mt-tcpc,vconn_supply = <0x1>;
		mt6370pd,intr_gpio = <0x37 0x18 0x0>;
		mt6370pd,intr_gpio_num = <0x18>;
		phandle = <0xac>;
		tcpc-dual,supported_modes = <0x0>;

		dpm_caps {
			attemp_discover_cable;
			attemp_discover_id;
			attemp_enter_dp_mode;
			dr_check = <0x0>;
			local_dr_data;
			local_dr_power;
			local_no_suspend;
			local_usb_comm;
			local_vconn_supply;
			pr_check = <0x0>;
			pr_check_gp_source;
		};

		pd-data {
			bat,nr = <0x1>;
			pd,charging_policy = <0x21>;
			pd,country_nr = <0x0>;
			pd,id-vdo-data = <0xd10029cf 0x0 0x10000>;
			pd,id-vdo-size = <0x3>;
			pd,mfrs = "RichtekTCPC";
			pd,pid = <0x5081>;
			pd,sink-pdo-data = <0x190c8 0xc0761e3c>;
			pd,sink-pdo-size = <0x2>;
			pd,source-cap-ext = <0x171129cf 0x0 0x102 0x0 0x0 0x2000000>;
			pd,source-pdo-data = <0x19032>;
			pd,source-pdo-size = <0x1>;
			pd,vid = <0x29cf>;

			bat-info0 {
				bat,design_cap = <0xbb8>;
				bat,mfrs = "bat1";
				bat,pid = <0x1711>;
				bat,vid = <0x29cf>;
			};
		};
	};

	usb0@11200000 {
		clock-names = "usb0", "usb0_clk_top_sel", "usb0_clk_univpll3_d4";
		clocks = <0x1f 0x8 0x19 0x7f 0x19 0x23>;
		compatible = "mediatek,mt6761-usb20";
		interrupts = <0x0 0x11 0x8>;
		mode = <0x2>;
		multipoint = <0x1>;
		num_eps = <0x10>;
		reg = <0x0 0x11200000 0x0 0x10000 0x0 0x11cc0000 0x0 0x10000>;
	};

	usb1p_sif@11210000 {
		compatible = "mediatek,usb1p_sif";
		reg = <0x0 0x11210000 0x0 0x10000>;
	};

	usb_sif@11210000 {
		compatible = "mediatek,usb_sif";
		reg = <0x0 0x11210000 0x0 0x1000>;
	};

	utos {
		compatible = "microtrust,utos";
		interrupts = <0x0 0xbc 0x1 0x0 0xbd 0x1>;
	};

	utos_tester {
		compatible = "microtrust,tester-v1";
	};

	vdec@17040000 {
		compatible = "mediatek,vdec";
		interrupts = <0x0 0xb1 0x8>;
		reg = <0x0 0x17040000 0x0 0x10000>;
	};

	venc@17020000 {
		compatible = "mediatek,venc";
		interrupts = <0x0 0xae 0x8>;
		reg = <0x0 0x17020000 0x0 0x10000>;
	};

	venc_gcon@17000000 {
		#clock-cells = <0x1>;
		clock-names = "MT_SCP_SYS_DIS", "MT_SCP_SYS_VCODEC", "MT_CG_MM_SMI_COMM0", "MT_CG_MM_SMI_COMM1", "MT_CG_MM_SMI_COMMON", "MT_CG_VDEC", "MT_CG_VENC";
		clocks = <0x20 0x3 0x20 0x9 0x21 0x15 0x21 0x16 0x21 0x13 0x43 0x3 0x43 0x1>;
		compatible = "mediatek,venc_gcon", "syscon";
		linux,phandle = <0x43>;
		phandle = <0x43>;
		reg = <0x0 0x17000000 0x0 0x10000>;
	};

	venc_jpg@17030000 {
		clock-names = "MT_CG_VENC_JPGENC";
		clocks = <0x43 0x2>;
		compatible = "mediatek,venc_jpg";
		interrupts = <0x0 0xb0 0x8>;
		reg = <0x0 0x17030000 0x0 0x10000>;
	};

	wifi@18000000 {
		compatible = "mediatek,wifi";
		interrupts = <0x0 0xd4 0x8>;
		reg = <0x0 0x18000000 0x0 0x100000>;
	};
};
