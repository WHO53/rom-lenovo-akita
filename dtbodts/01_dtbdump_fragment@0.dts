/dts-v1/;

/ {

	__fixups__ {
		accdet = "/fragment@17:target:0";
		audgpio = "/fragment@23:target:0";
		auxadc = "/fragment@27:target:0";
		chosen = "/fragment@1:target:0";
		consys = "/fragment@22:target:0";
		dbmdx = "/fragment@14:target:0";
		dsi_te = "/fragment@45:target:0";
		gpio = "/fragment@40:target:0";
		gpio_usage_mapping = "/fragment@39:target:0";
		i2c0 = "/fragment@5:target:0", "/fragment@29:target:0";
		i2c1 = "/fragment@30:target:0";
		i2c2 = "/fragment@6:target:0", "/fragment@31:target:0";
		i2c3 = "/fragment@7:target:0", "/fragment@32:target:0";
		i2c4 = "/fragment@33:target:0";
		i2c5 = "/fragment@19:target:0", "/fragment@34:target:0";
		i2c6 = "/fragment@9:target:0", "/fragment@35:target:0";
		i2c7 = "/fragment@36:target:0";
		i2c8 = "/fragment@37:target:0";
		i2c9 = "/fragment@38:target:0";
		kd_camera_hw1 = "/fragment@26:target:0", "/fragment@56:target:0";
		keypad = "/fragment@58:target:0";
		lcm = "/fragment@10:target:0";
		led_pinctrl = "/fragment@3:target:0";
		main_pmic = "/fragment@47:target:0";
		md1_sim1_hot_plug_eint = "/fragment@49:target:0";
		msdc1_ins = "/fragment@41:target:0";
		mt_pmic_vcama_ldo_reg = "/fragment@50:target:0", "/fragment@56/__overlay__:vcama-supply:0", "/fragment@56/__overlay__:vcama_sub-supply:0";
		mt_pmic_vcamd_ldo_reg = "/fragment@53:target:0", "/fragment@56/__overlay__:vcamd_main2-supply:0", "/fragment@56/__overlay__:vcamd_sub-supply:0";
		mt_pmic_vcamio_ldo_reg = "/fragment@54:target:0", "/fragment@56/__overlay__:vcamio-supply:0", "/fragment@56/__overlay__:vcamio_sub-supply:0", "/fragment@56/__overlay__:vcamio_main2-supply:0";
		mt_pmic_vldo28_ldo_reg = "/fragment@55:target:0", "/fragment@56/__overlay__:vcamaf-supply:0", "/fragment@56/__overlay__:vcamaf_sub-supply:0", "/fragment@56/__overlay__:vcamaf_main2-supply:0", "/fragment@57/__overlay__:vtouch-supply:0";
		mt_pmic_vsim1_ldo_reg = "/fragment@51:target:0";
		mt_pmic_vsim2_ldo_reg = "/fragment@52:target:0";
		odm = "/fragment@2:target:0";
		otg_iddig = "/fragment@48:target:0";
		pio = "/fragment@4:target:0", "/fragment@7/__overlay__/sx9311@28:interrupt-parent:0", "/fragment@7/__overlay__/sx9311@28:int-gpio:0", "/fragment@8:target:0", "/fragment@9/__overlay__/aw87519@58:reset-gpio:0", "/fragment@9/__overlay__/aw87519@5b:reset-gpio:0", "/fragment@11:target:0", "/fragment@13:target:0", "/fragment@14/__overlay__:reset-gpio:0", "/fragment@14/__overlay__:wakeup-gpio:0", "/fragment@16:target:0", "/fragment@18:target:0", "/fragment@19/__overlay__/rt-swchg@53:rt,intr_gpio:0", "/fragment@20:target:0", "/fragment@21:target:0", "/fragment@24:target:0", "/fragment@25:target:0", "/fragment@39/__overlay__:GPIO_SIM2_SIO:0", "/fragment@39/__overlay__:GPIO_SIM2_SRST:0", "/fragment@39/__overlay__:GPIO_SIM2_SCLK:0", "/fragment@39/__overlay__:GPIO_SIM1_SCLK:0", "/fragment@39/__overlay__:GPIO_SIM1_SRST:0", "/fragment@39/__overlay__:GPIO_SIM1_SIO:0", "/fragment@39/__overlay__:GPIO_SIM2_HOT_PLUG:0", "/fragment@39/__overlay__:GPIO_SIM1_HOT_PLUG:0", "/fragment@39/__overlay__:GPIO_FDD_BAND_SUPPORT_DETECT_1ST_PIN:0", "/fragment@39/__overlay__:GPIO_FDD_BAND_SUPPORT_DETECT_2ND_PIN:0", "/fragment@39/__overlay__:GPIO_FDD_BAND_SUPPORT_DETECT_3RD_PIN:0", "/fragment@39/__overlay__:GPIO_FDD_BAND_SUPPORT_DETECT_4TH_PIN:0", "/fragment@41/__overlay__:interrupt-parent:0", "/fragment@42/__overlay__:interrupt-parent:0", "/fragment@43/__overlay__:interrupt-parent:0", "/fragment@44/__overlay__:interrupt-parent:0", "/fragment@45/__overlay__:interrupt-parent:0", "/fragment@46/__overlay__:interrupt-parent:0", "/fragment@46/__overlay__:deb-gpios:0", "/fragment@47/__overlay__:interrupt-parent:0", "/fragment@48/__overlay__:interrupt-parent:0";
		pmic_clock_buffer_ctrl = "/fragment@28:target:0";
		reserved_memory = "/fragment@0:target:0";
		smart_pa = "/fragment@42:target:0";
		spi3 = "/fragment@12:target:0";
		subpmic_pmu_eint = "/fragment@44:target:0";
		swtp = "/fragment@46:target:0";
		touch = "/fragment@15:target:0", "/fragment@43:target:0", "/fragment@57:target:0";
	};

	__local_fixups__ {

		fragment@10 {

			__overlay__ {
				pinctrl-0 = <0x0>;
				pinctrl-1 = <0x0>;
				pinctrl-10 = <0x0>;
				pinctrl-11 = <0x0>;
				pinctrl-2 = <0x0>;
				pinctrl-3 = <0x0>;
				pinctrl-4 = <0x0>;
				pinctrl-5 = <0x0>;
				pinctrl-6 = <0x0>;
				pinctrl-7 = <0x0>;
				pinctrl-8 = <0x0>;
				pinctrl-9 = <0x0>;
			};
		};

		fragment@12 {

			__overlay__ {

				dbmd8_interface@0 {
					pinctrl-0 = <0x0>;
					pinctrl-1 = <0x0>;
				};
			};
		};

		fragment@14 {

			__overlay__ {
				cd-interfaces = <0x0>;
			};
		};

		fragment@15 {

			__overlay__ {
				pinctrl-0 = <0x0>;
				pinctrl-1 = <0x0>;
				pinctrl-2 = <0x0>;
				pinctrl-3 = <0x0>;
				pinctrl-4 = <0x0>;
				pinctrl-5 = <0x0>;
			};
		};

		fragment@17 {

			__overlay__ {
				pinctrl-0 = <0x0>;
				pinctrl-1 = <0x0>;
			};
		};

		fragment@19 {

			__overlay__ {

				bq2560x@6B {
					pinctrl-0 = <0x0>;
					pinctrl-1 = <0x0>;
					pinctrl-2 = <0x0>;
				};
			};
		};

		fragment@22 {

			__overlay__ {
				pinctrl-0 = <0x0>;
				pinctrl-1 = <0x0>;
				pinctrl-2 = <0x0>;
				pinctrl-3 = <0x0>;
			};
		};

		fragment@23 {

			__overlay__ {
				pinctrl-0 = <0x0>;
				pinctrl-1 = <0x0>;
				pinctrl-10 = <0x0>;
				pinctrl-11 = <0x0>;
				pinctrl-2 = <0x0>;
				pinctrl-3 = <0x0>;
				pinctrl-4 = <0x0>;
				pinctrl-5 = <0x0>;
				pinctrl-6 = <0x0>;
				pinctrl-7 = <0x0>;
				pinctrl-8 = <0x0>;
				pinctrl-9 = <0x0>;
			};
		};

		fragment@26 {

			__overlay__ {
				pinctrl-0 = <0x0>;
				pinctrl-1 = <0x0>;
				pinctrl-10 = <0x0>;
				pinctrl-11 = <0x0>;
				pinctrl-12 = <0x0>;
				pinctrl-13 = <0x0>;
				pinctrl-14 = <0x0>;
				pinctrl-15 = <0x0>;
				pinctrl-16 = <0x0>;
				pinctrl-17 = <0x0>;
				pinctrl-18 = <0x0>;
				pinctrl-19 = <0x0>;
				pinctrl-2 = <0x0>;
				pinctrl-20 = <0x0>;
				pinctrl-21 = <0x0>;
				pinctrl-22 = <0x0>;
				pinctrl-23 = <0x0>;
				pinctrl-24 = <0x0>;
				pinctrl-25 = <0x0>;
				pinctrl-26 = <0x0>;
				pinctrl-3 = <0x0>;
				pinctrl-4 = <0x0>;
				pinctrl-5 = <0x0>;
				pinctrl-6 = <0x0>;
				pinctrl-7 = <0x0>;
				pinctrl-8 = <0x0>;
				pinctrl-9 = <0x0>;
			};
		};

		fragment@3 {

			__overlay__ {
				pinctrl-0 = <0x0>;
				pinctrl-1 = <0x0>;
				pinctrl-2 = <0x0>;
				pinctrl-3 = <0x0>;
				pinctrl-4 = <0x0>;
			};
		};

		fragment@7 {

			__overlay__ {

				mic_array@38 {
					pinctrl-0 = <0x0>;
					pinctrl-1 = <0x0>;
				};
			};
		};
	};

	__symbols__ {
		accdet_pins_default = "/fragment@18/__overlay__/accdetdefault";
		accdet_pins_eint_as_int = "/fragment@18/__overlay__/accdeteint@0";
		aud_clk_miso_off = "/fragment@24/__overlay__/aud_clk_miso_off";
		aud_clk_miso_on = "/fragment@24/__overlay__/aud_clk_miso_on";
		aud_clk_mosi_off = "/fragment@24/__overlay__/aud_clk_mosi_off";
		aud_clk_mosi_on = "/fragment@24/__overlay__/aud_clk_mosi_on";
		aud_dat_miso_off = "/fragment@24/__overlay__/aud_dat_miso_off";
		aud_dat_miso_on = "/fragment@24/__overlay__/aud_dat_miso_on";
		aud_dat_mosi_off = "/fragment@24/__overlay__/aud_dat_mosi_off";
		aud_dat_mosi_on = "/fragment@24/__overlay__/aud_dat_mosi_on";
		aud_pins_ac107_off = "/fragment@8/__overlay__/aud_pins_ac107_off";
		aud_pins_ac107_on = "/fragment@8/__overlay__/aud_pins_ac107_on";
		aud_pins_dbmdx_off = "/fragment@24/__overlay__/aud_pins_dbmdx_off";
		aud_pins_dbmdx_on = "/fragment@24/__overlay__/aud_pins_dbmdx_on";
		aud_pins_hs_sw_off = "/fragment@24/__overlay__/aud_pins_hs_sw_off";
		aud_pins_hs_sw_on = "/fragment@24/__overlay__/aud_pins_hs_sw_on";
		camera_main_af_mtk = "/fragment@31/__overlay__/camera_main_af@18";
		camera_main_eeprom_mtk = "/fragment@31/__overlay__/camera_main_eeprom@58";
		camera_main_mtk = "/fragment@31/__overlay__/camera_main@1a";
		camera_main_two_af_mtk = "/fragment@35/__overlay__/camera_main_two_af@0c";
		camera_main_two_eeprom_mtk = "/fragment@35/__overlay__/camera_main_two_eeprom@50";
		camera_main_two_mtk = "/fragment@35/__overlay__/camera_main_two@2d";
		camera_pins_cam0_mclk_off = "/fragment@25/__overlay__/camera_pins_cam0_mclk_off";
		camera_pins_cam0_mclk_on = "/fragment@25/__overlay__/camera_pins_cam0_mclk_on";
		camera_pins_cam0_pnd0 = "/fragment@25/__overlay__/cam0@2";
		camera_pins_cam0_pnd1 = "/fragment@25/__overlay__/cam0@3";
		camera_pins_cam0_rst0 = "/fragment@25/__overlay__/cam0@0";
		camera_pins_cam0_rst1 = "/fragment@25/__overlay__/cam0@1";
		camera_pins_cam1_mclk_off = "/fragment@25/__overlay__/camera_pins_cam1_mclk_off";
		camera_pins_cam1_mclk_on = "/fragment@25/__overlay__/camera_pins_cam1_mclk_on";
		camera_pins_cam1_pnd0 = "/fragment@25/__overlay__/cam1@2";
		camera_pins_cam1_pnd1 = "/fragment@25/__overlay__/cam1@3";
		camera_pins_cam1_rst0 = "/fragment@25/__overlay__/cam1@0";
		camera_pins_cam1_rst1 = "/fragment@25/__overlay__/cam1@1";
		camera_pins_cam2_mclk_off = "/fragment@25/__overlay__/camera_pins_cam2_mclk_off";
		camera_pins_cam2_mclk_on = "/fragment@25/__overlay__/camera_pins_cam2_mclk_on";
		camera_pins_cam2_pnd0 = "/fragment@25/__overlay__/cam2@2";
		camera_pins_cam2_pnd1 = "/fragment@25/__overlay__/cam2@3";
		camera_pins_cam2_rst0 = "/fragment@25/__overlay__/cam2@0";
		camera_pins_cam2_rst1 = "/fragment@25/__overlay__/cam2@1";
		camera_pins_cam_ldo_rear2_vcama_0 = "/fragment@25/__overlay__/cam2@vcama0";
		camera_pins_cam_ldo_rear2_vcama_1 = "/fragment@25/__overlay__/cam2@vcama1";
		camera_pins_cam_ldo_rear_vcamd_0 = "/fragment@25/__overlay__/cam0@vcamd0";
		camera_pins_cam_ldo_rear_vcamd_1 = "/fragment@25/__overlay__/cam0@vcamd1";
		camera_pins_cam_ldo_sub_vcama_0 = "/fragment@25/__overlay__/cam1@vcama0";
		camera_pins_cam_ldo_sub_vcama_1 = "/fragment@25/__overlay__/cam1@vcama1";
		camera_pins_cam_ldo_sub_vcamd_0 = "/fragment@25/__overlay__/cam1@vcamd0";
		camera_pins_cam_ldo_sub_vcamd_1 = "/fragment@25/__overlay__/cam1@vcamd1";
		camera_pins_default = "/fragment@25/__overlay__/camdefault";
		camera_sub_eeprom_mtk = "/fragment@33/__overlay__/camera_sub_eeprom@52";
		camera_sub_mtk = "/fragment@33/__overlay__/camera_sub@2e";
		cap_touch_mtk = "/fragment@29/__overlay__/cap_touch@38";
		charger_default = "/fragment@20/__overlay__/charger_default";
		charger_pogo_otg_off = "/fragment@20/__overlay__/pogo_otg_off";
		charger_pogo_otg_on = "/fragment@20/__overlay__/pogo_otg_on";
		consys_pins_default = "/fragment@21/__overlay__/consys_default";
		ctp_pins_default = "/fragment@16/__overlay__/eint0default";
		ctp_pins_eint_as_int = "/fragment@16/__overlay__/eint@0";
		ctp_pins_eint_output0 = "/fragment@16/__overlay__/eintoutput0";
		ctp_pins_eint_output1 = "/fragment@16/__overlay__/eintoutput1";
		ctp_pins_rst_output0 = "/fragment@16/__overlay__/rstoutput0";
		ctp_pins_rst_output1 = "/fragment@16/__overlay__/rstoutput1";
		d4a_vdd_power_output0 = "/fragment@13/__overlay__/poweroutput0";
		d4a_vdd_power_output1 = "/fragment@13/__overlay__/poweroutput1";
		dbmd8_spi = "/fragment@12/__overlay__/dbmd8_interface@0";
		ext_buck_lp4_mtk = "/fragment@32/__overlay__/ext_buck_lp4@57";
		ext_buck_lp4x_mtk = "/fragment@32/__overlay__/ext_buck_lp4x@50";
		ext_buck_vgpu_mtk = "/fragment@35/__overlay__/ext_buck_vgpu@55";
		gpslna_pins_init = "/fragment@21/__overlay__/gpslna@0";
		gpslna_pins_oh = "/fragment@21/__overlay__/gpslna@1";
		gpslna_pins_ol = "/fragment@21/__overlay__/gpslna@2";
		green_red_off = "/fragment@4/__overlay__/greenoff";
		green_red_on = "/fragment@4/__overlay__/greenon";
		lcm_pins_enn_output0 = "/fragment@11/__overlay__/ennoutput0";
		lcm_pins_enn_output1 = "/fragment@11/__overlay__/ennoutput1";
		lcm_pins_enp_output0 = "/fragment@11/__overlay__/enpoutput0";
		lcm_pins_enp_output1 = "/fragment@11/__overlay__/enpoutput1";
		lcm_pins_ldo_output0 = "/fragment@11/__overlay__/ldooutput0";
		lcm_pins_ldo_output1 = "/fragment@11/__overlay__/ldooutput1";
		lcm_pins_led_output0 = "/fragment@11/__overlay__/ledoutput0";
		lcm_pins_led_output1 = "/fragment@11/__overlay__/ledoutput1";
		lcm_pins_rst_output0 = "/fragment@11/__overlay__/resetoutput0";
		lcm_pins_rst_output1 = "/fragment@11/__overlay__/resetoutput1";
		led0 = "/fragment@2/__overlay__/led@0";
		led1 = "/fragment@2/__overlay__/led@1";
		led2 = "/fragment@2/__overlay__/led@2";
		led3 = "/fragment@2/__overlay__/led@3";
		led4 = "/fragment@2/__overlay__/led@4";
		led5 = "/fragment@2/__overlay__/led@5";
		led6 = "/fragment@2/__overlay__/led@6";
		led_pins_default = "/fragment@4/__overlay__/leddefault";
		led_red_off = "/fragment@4/__overlay__/redoff";
		led_red_on = "/fragment@4/__overlay__/redon";
		memory_ssmr_features = "/fragment@2/__overlay__/memory-ssmr-features";
		nfc_mtk = "/fragment@32/__overlay__/nfc@08";
		slave_charger_mtk = "/fragment@32/__overlay__/slave_charger@4b";
		speaker_amp_mtk = "/fragment@32/__overlay__/speaker_amp@34";
		tp_pins_rst_output0 = "/fragment@11/__overlay__/tprstoutput0";
		tp_pins_rst_output1 = "/fragment@11/__overlay__/tprstoutput1";
		vibrator0 = "/fragment@2/__overlay__/vibrator@0";
	};

	fragment@0 {
		target = <0xffffffff>;

		__overlay__ {
			#address-cells = <0x2>;
			#size-cells = <0x2>;
			ranges;

			zmc-default {
				alignment = <0x0 0x10000000>;
				alloc-ranges = <0x0 0xc0000000 0x1 0x0>;
				compatible = "mediatek,zone_movable_cma";
				size = <0x0 0xffc00000>;
			};
		};
	};

	fragment@1 {
		target = <0xffffffff>;

		__overlay__ {
			atag,videolfb-fb_base_h = <0x0>;
			atag,videolfb-fb_base_l = "^`P";
			atag,videolfb-fps = <0x1770>;
			atag,videolfb-islcm_inited = <0x0>;
			atag,videolfb-islcmfound = <0x1>;
			atag,videolfb-lcmname = "nt35521_hd_dsi_vdo_truly_rt5081_drv";
			atag,videolfb-vramSize = <0x17bb000>;
		};
	};

	fragment@10 {
		target = <0xffffffff>;

		__overlay__ {
			pinctrl-0 = <0x8>;
			pinctrl-1 = <0x9>;
			pinctrl-10 = <0x12>;
			pinctrl-11 = <0x13>;
			pinctrl-2 = <0xa>;
			pinctrl-3 = <0xb>;
			pinctrl-4 = <0xc>;
			pinctrl-5 = <0xd>;
			pinctrl-6 = <0xe>;
			pinctrl-7 = <0xf>;
			pinctrl-8 = <0x10>;
			pinctrl-9 = <0x11>;
			pinctrl-names = "state_enp_output0", "state_enp_output1", "state_enn_output0", "state_enn_output1", "state_reset_output0", "state_reset_output1", "state_tp_reset_output0", "state_tp_reset_output1", "state_ldo_output0", "state_ldo_output1", "state_led_output0", "state_led_output1";
			status = "okay";
		};
	};

	fragment@11 {
		target = <0xffffffff>;

		__overlay__ {

			ennoutput0 {
				linux,phandle = <0xa>;
				phandle = <0xa>;

				pins_cmd_dat {
					output-low;
					pinmux = <0xa800>;
					slew-rate = <0x1>;
				};
			};

			ennoutput1 {
				linux,phandle = <0xb>;
				phandle = <0xb>;

				pins_cmd_dat {
					output-high;
					pinmux = <0xa800>;
					slew-rate = <0x1>;
				};
			};

			enpoutput0 {
				linux,phandle = <0x8>;
				phandle = <0x8>;

				pins_cmd_dat {
					output-low;
					pinmux = <0xa700>;
					slew-rate = <0x1>;
				};
			};

			enpoutput1 {
				linux,phandle = <0x9>;
				phandle = <0x9>;

				pins_cmd_dat {
					output-high;
					pinmux = <0xa700>;
					slew-rate = <0x1>;
				};
			};

			ldooutput0 {
				linux,phandle = <0x10>;
				phandle = <0x10>;

				pins_cmd_dat {
					output-low;
					pinmux = <0x9800>;
					slew-rate = <0x1>;
				};
			};

			ldooutput1 {
				linux,phandle = <0x11>;
				phandle = <0x11>;

				pins_cmd_dat {
					output-high;
					pinmux = <0x9800>;
					slew-rate = <0x1>;
				};
			};

			ledoutput0 {
				linux,phandle = <0x12>;
				phandle = <0x12>;

				pins_cmd_dat {
					output-low;
					pinmux = <0x9a00>;
					slew-rate = <0x1>;
				};
			};

			ledoutput1 {
				linux,phandle = <0x13>;
				phandle = <0x13>;

				pins_cmd_dat {
					output-high;
					pinmux = <0x9a00>;
					slew-rate = <0x1>;
				};
			};

			resetoutput0 {
				linux,phandle = <0xc>;
				phandle = <0xc>;

				pins_cmd_dat {
					output-low;
					pinmux = <0x2d00>;
					slew-rate = <0x1>;
				};
			};

			resetoutput1 {
				linux,phandle = <0xd>;
				phandle = <0xd>;

				pins_cmd_dat {
					output-high;
					pinmux = <0x2d00>;
					slew-rate = <0x1>;
				};
			};

			tprstoutput0 {
				linux,phandle = <0xe>;
				phandle = <0xe>;

				pins_cmd_dat {
					output-low;
					pinmux = <0xac00>;
					slew-rate = <0x1>;
				};
			};

			tprstoutput1 {
				linux,phandle = <0xf>;
				phandle = <0xf>;

				pins_cmd_dat {
					output-high;
					pinmux = <0xac00>;
					slew-rate = <0x1>;
				};
			};
		};
	};

	fragment@12 {
		target = <0xffffffff>;

		__overlay__ {
			#address-cells = <0x1>;
			#size-cells = <0x0>;
			status = "okay";

			dbmd8_interface@0 {
				compatible = "dspg,dbmd8-spi";
				dma_min_buffer_size = <0x0>;
				linux,phandle = <0x16>;
				phandle = <0x16>;
				pinctrl-0 = <0x14>;
				pinctrl-1 = <0x15>;
				pinctrl-names = "state_power_output0", "state_power_output1";
				read-chunk-size = <0x2000>;
				reg = <0x0>;
				spi-max-frequency = <0x7735940>;
				write-chunk-size = <0x8000>;
			};
		};
	};

	fragment@13 {
		target = <0xffffffff>;

		__overlay__ {

			poweroutput0 {
				linux,phandle = <0x14>;
				phandle = <0x14>;

				pins_cmd_dat {
					output-low;
					pinmux = <0x9f00>;
					slew-rate = <0x1>;
				};
			};

			poweroutput1 {
				linux,phandle = <0x15>;
				phandle = <0x15>;

				pins_cmd_dat {
					output-high;
					pinmux = <0x9f00>;
					slew-rate = <0x1>;
				};
			};
		};
	};

	fragment@14 {
		target = <0xffffffff>;

		__overlay__ {
			alsa_streaming_options = <0x8>;
			amodel_options = <0x1>;
			asrp_delay = <0x1>;
			asrp_rx_out_gain = <0x2cfc>;
			asrp_tx_out_gain = <0x2cfc>;
			asrp_vcpf_out_gain = <0x2cfc>;
			auto_buffering = <0x1>;
			auto_detection = <0x1>;
			boot_options = <0x220>;
			buffering_timeout = <0x5>;
			cd-interfaces = <0x16>;
			change_clock_src_options = <0x4003>;
			compatible = "dspg,dbmdx-codec";
			default-streaming-usecase-name = "uc_melon_ga_2mic_aec_48k";
			default_va_clock = <0x5dc0000>;
			detection_after_buffering = <0x1>;
			detection_buffer_channels = <0x0>;
			feature-va_ve;
			firmware_id = <0xdbd8>;
			hw_revision = <0x0>;
			low_power_mode_disabled = <0x0>;
			master-clk-rate = <0x8000>;
			multi-interface-support = <0x1>;
			pcm_streaming_mode = <0x1>;
			project_sub_type = <0x1>;
			qed_enabled = <0x0>;
			reset-gpio = <0xffffffff 0x2a 0x0>;
			reset_gpio_shared = <0x0>;
			send_uevent_after_buffering = <0x1>;
			send_uevent_on_detection = <0x1>;
			send_wakeup_seq = <0x0>;
			status = "okay";
			uart_low_speed_enabled = <0x1>;
			use_gpio_for_wakeup = <0x1>;
			va-config = <0x80000000 0x80000000 0x80000000 0x80290020 0x801b0020 0x80091800 0x80221002 0x80330076 0x80230000 0x8038ffa0 0x8016000e 0x80161200 0x80159494 0x801a0013 0x80107000 0x8aab0040 0x800c7530 0x80000000 0x80000000 0x80000000>;
			va-firmware-name = "dbmd8_va_fw.bin";
			va-interfaces = <0x0 0x0 0x0 0x0>;
			va-mic-config = <0x5076 0xa061 0x8>;
			va-mic-mode = <0x0>;
			va-preboot-firmware-name = "dbmd8_va_preboot_fw.bin";
			va-speeds = <0x0 0x70800 0x0 0xf4240 0x0 0x1e8480 0x0 0x2dc6c0 0x0 0x2dc6c0 0x0 0x4c4b40>;
			va_backlog_length = <0x1f6>;
			va_ve-mic-config = <0x5076 0xa061 0xa093 0x0>;
			wakeup-gpio = <0xffffffff 0x6 0x0>;
			wakeup_disabled = <0x0>;
			wakeup_set_value = <0x0>;
		};
	};

	fragment@15 {
		target = <0xffffffff>;

		__overlay__ {
			pinctrl-0 = <0x17>;
			pinctrl-1 = <0x18>;
			pinctrl-2 = <0x19>;
			pinctrl-3 = <0x1a>;
			pinctrl-4 = <0x1b>;
			pinctrl-5 = <0x1c>;
			pinctrl-names = "default", "state_eint_as_int", "state_eint_output0", "state_eint_output1", "state_rst_output0", "state_rst_output1";
			status = "okay";
			tpd-filter-custom-prameters = <0x0 0x0 0x0 0x0 0x0 0x0 0x0 0x0 0x0 0x0 0x0 0x0>;
			tpd-filter-custom-speed = <0x0 0x0 0x0>;
			tpd-filter-enable = <0x0>;
			tpd-filter-pixel-density = <0x6a>;
			tpd-key-dim-local = <0x5a 0x373 0x64 0x28 0xe6 0x373 0x64 0x28 0x172 0x373 0x64 0x28 0x0 0x0 0x0 0x0>;
			tpd-key-local = <0x8b 0xac 0x9e 0x0>;
			tpd-key-num = <0x3>;
			tpd-max-touch-num = <0xa>;
			tpd-resolution = <0x320 0x500>;
			use-tpd-button = <0x0>;
		};
	};

	fragment@16 {
		target = <0xffffffff>;

		__overlay__ {

			eint0default {
				linux,phandle = <0x17>;
				phandle = <0x17>;
			};

			eint@0 {
				linux,phandle = <0x18>;
				phandle = <0x18>;

				pins_cmd_dat {
					bias-disable;
					pinmux = <0xa00>;
					slew-rate = <0x0>;
				};
			};

			eintoutput0 {
				linux,phandle = <0x19>;
				phandle = <0x19>;

				pins_cmd_dat {
					output-low;
					pinmux = <0xa00>;
					slew-rate = <0x1>;
				};
			};

			eintoutput1 {
				linux,phandle = <0x1a>;
				phandle = <0x1a>;

				pins_cmd_dat {
					output-high;
					pinmux = <0xa00>;
					slew-rate = <0x1>;
				};
			};

			rstoutput0 {
				linux,phandle = <0x1b>;
				phandle = <0x1b>;

				pins_cmd_dat {
					output-low;
					pinmux = <0xac00>;
					slew-rate = <0x1>;
				};
			};

			rstoutput1 {
				linux,phandle = <0x1c>;
				phandle = <0x1c>;

				pins_cmd_dat {
					output-high;
					pinmux = <0xac00>;
					slew-rate = <0x1>;
				};
			};
		};
	};

	fragment@17 {
		target = <0xffffffff>;

		__overlay__ {
			accdet-mic-mode = <0x1>;
			accdet-mic-vol = <0x6>;
			accdet-plugout-debounce = <0x1>;
			headset-eint-level-pol = <0x8>;
			headset-four-key-threshold = <0x0 0x3a 0x79 0xc0 0x190>;
			headset-mode-setting = <0x500 0x500 0x1 0x1f0 0x800 0x800 0x20 0x44>;
			headset-three-key-threshold = <0x0 0x50 0xdc 0x190>;
			headset-three-key-threshold-CDD = <0x0 0x79 0xc0 0x258>;
			pinctrl-0 = <0x1d>;
			pinctrl-1 = <0x1e>;
			pinctrl-names = "default", "state_eint_as_int";
			status = "okay";
		};
	};

	fragment@18 {
		target = <0xffffffff>;

		__overlay__ {

			accdetdefault {
				linux,phandle = <0x1d>;
				phandle = <0x1d>;
			};

			accdeteint@0 {
				linux,phandle = <0x1e>;
				phandle = <0x1e>;

				pins_cmd_dat {
					bias-disable;
					pinmux = <0x900>;
					slew-rate = <0x0>;
				};
			};
		};
	};

	fragment@19 {
		target = <0xffffffff>;

		__overlay__ {

			bias_i2c@3e {
				compatible = "mediatek,I2C_LCD_BIAS";
				reg = <0x3e>;
				status = "okay";
			};

			bq2560x@6B {
				compatible = "ti,bq25601";
				pinctrl-0 = <0x1f>;
				pinctrl-1 = <0x20>;
				pinctrl-2 = <0x21>;
				pinctrl-names = "default", "pogo_otg_on", "pogo_otg_off";
				reg = <0x6b>;
				ti,bq2560x,boost-current = <0x4b0>;
				ti,bq2560x,boost-voltage = <0x141e>;
				ti,bq2560x,enable_term;
				ti,bq2560x,precharge-current = <0x100>;
				ti,bq2560x,stat-pin-ctrl = <0x3>;
				ti,bq2560x,termination-current = <0xb4>;
				ti,bq2560x,usb-ichg = <0x1f4>;
				ti,bq2560x,usb-ilim = <0x1f4>;
				ti,bq2560x,usb-vlim = <0x11f8>;
				ti,bq2560x,usb-vreg = <0x1130>;
				ti,bq2560x,vac-ovp-threshold = <0x1964>;
			};

			rt-swchg@53 {
				compatible = "richtek,swchg";
				reg = <0x53>;
				rt,intr_gpio = <0xffffffff 0x2 0x0>;
				rt,intr_gpio_num = <0x2>;
				status = "okay";

				rt9471 {
					aicr = <0x7a120>;
					charger_name = "primary_chg";
					chg_alias_name = "rt9471_chg";
					cv = <0x426030>;
					en-qon-rst;
					en-te;
					ichg = <0xf4240>;
					ieoc = <0x30d40>;
					interrupt-names = "wdt", "chg_mivr", "vbus_gd", "bc12_done", "detach", "vac_ov", "otg_fault";
					mivr = <0x432380>;
					mivr-track = <0x0>;
					rm-name = "rt9471";
					rm-slave-addr = [53];
					safe-tmr = <0xa>;
					wdt = <0x28>;
				};
			};
		};
	};

	fragment@2 {
		target = <0xffffffff>;

		__overlay__ {

			led@0 {
				compatible = "mediatek,red";
				data = <0x1>;
				led_mode = <0x2>;
				linux,phandle = <0x4d>;
				phandle = <0x4d>;
				pwm_config = <0x0 0x0 0x0 0x0 0x0>;
			};

			led@1 {
				compatible = "mediatek,green";
				data = <0x1>;
				led_mode = <0x2>;
				linux,phandle = <0x4e>;
				phandle = <0x4e>;
				pwm_config = <0x0 0x0 0x0 0x0 0x0>;
			};

			led@2 {
				compatible = "mediatek,blue";
				data = <0x2>;
				led_mode = <0x3>;
				linux,phandle = <0x4f>;
				phandle = <0x4f>;
				pwm_config = <0x0 0x0 0x0 0x0 0x0>;
			};

			led@3 {
				compatible = "mediatek,jogball-backlight";
				data = <0x1>;
				led_mode = <0x0>;
				linux,phandle = <0x50>;
				phandle = <0x50>;
				pwm_config = <0x0 0x0 0x0 0x0 0x0>;
			};

			led@4 {
				compatible = "mediatek,keyboard-backlight";
				data = <0x1>;
				led_mode = <0x0>;
				linux,phandle = <0x51>;
				phandle = <0x51>;
				pwm_config = <0x0 0x0 0x0 0x0 0x0>;
			};

			led@5 {
				compatible = "mediatek,button-backlight";
				data = <0x1>;
				led_mode = <0x0>;
				linux,phandle = <0x52>;
				phandle = <0x52>;
				pwm_config = <0x0 0x0 0x0 0x0 0x0>;
			};

			led@6 {
				compatible = "mediatek,lcd-backlight";
				data = <0x1>;
				led_mode = <0x5>;
				linux,phandle = <0x53>;
				phandle = <0x53>;
				pwm_config = <0x0 0x0 0x0 0x0 0x0>;
			};

			memory-ssmr-features {
				2d_fr-size = <0x0 0x0>;
				compatible = "mediatek,memory-ssmr-features";
				iris-recognition-size = <0x0 0x0>;
				linux,phandle = <0x55>;
				phandle = <0x55>;
				prot-sharedmem-size = <0x0 0x0>;
				svp-size = <0x0 0x0>;
				tui-size = <0x0 0x0>;
				wfd-size = <0x0 0x0>;
			};

			vibrator@0 {
				compatible = "mediatek,vibrator";
				linux,phandle = <0x54>;
				phandle = <0x54>;
				vib_limit = <0x9>;
				vib_timer = <0x19>;
				vib_vol = <0x9>;
			};
		};
	};

	fragment@20 {
		target = <0xffffffff>;

		__overlay__ {

			charger_default {
				linux,phandle = <0x1f>;
				phandle = <0x1f>;
			};

			pogo_otg_off {
				linux,phandle = <0x21>;
				phandle = <0x21>;

				pins_cmd_dat {
					output-low;
					pinmux = <0xa900>;
					slew-rate = <0x1>;
				};
			};

			pogo_otg_on {
				linux,phandle = <0x20>;
				phandle = <0x20>;

				pins_cmd_dat {
					output-high;
					pinmux = <0xa900>;
					slew-rate = <0x1>;
				};
			};
		};
	};

	fragment@21 {
		target = <0xffffffff>;

		__overlay__ {

			consys_default {
				linux,phandle = <0x22>;
				phandle = <0x22>;
			};

			gpslna@0 {
				linux,phandle = <0x23>;
				phandle = <0x23>;

				pins_cmd_dat {
					bias-disable;
					output-low;
					pinmux = <0x5b00>;
					slew-rate = <0x0>;
				};
			};

			gpslna@1 {
				linux,phandle = <0x24>;
				phandle = <0x24>;

				pins_cmd_dat {
					output-high;
					pinmux = <0x5b00>;
					slew-rate = <0x1>;
				};
			};

			gpslna@2 {
				linux,phandle = <0x25>;
				phandle = <0x25>;

				pins_cmd_dat {
					output-low;
					pinmux = <0x5b00>;
					slew-rate = <0x1>;
				};
			};
		};
	};

	fragment@22 {
		target = <0xffffffff>;

		__overlay__ {
			pinctrl-0 = <0x22>;
			pinctrl-1 = <0x23>;
			pinctrl-2 = <0x24>;
			pinctrl-3 = <0x25>;
			pinctrl-names = "default", "gps_lna_state_init", "gps_lna_state_oh", "gps_lna_state_ol";
			status = "okay";
		};
	};

	fragment@23 {
		target = <0xffffffff>;

		__overlay__ {
			pinctrl-0 = <0x26>;
			pinctrl-1 = <0x27>;
			pinctrl-10 = <0x30>;
			pinctrl-11 = <0x31>;
			pinctrl-2 = <0x28>;
			pinctrl-3 = <0x29>;
			pinctrl-4 = <0x2a>;
			pinctrl-5 = <0x2b>;
			pinctrl-6 = <0x2c>;
			pinctrl-7 = <0x2d>;
			pinctrl-8 = <0x2e>;
			pinctrl-9 = <0x2f>;
			pinctrl-names = "aud_clk_mosi_off", "aud_clk_mosi_on", "aud_clk_miso_off", "aud_clk_miso_on", "aud_dat_mosi_off", "aud_dat_mosi_on", "aud_dat_miso_off", "aud_dat_miso_on", "aud_dbmdx_off", "aud_dbmdx_on", "aud_hs_sw_off", "aud_hs_sw_on";
			status = "okay";
		};
	};

	fragment@24 {
		target = <0xffffffff>;

		__overlay__ {

			aud_clk_miso_off {
				linux,phandle = <0x28>;
				phandle = <0x28>;

				pins_cmd0_dat {
					pinmux = <0x8c00>;
				};
			};

			aud_clk_miso_on {
				linux,phandle = <0x29>;
				phandle = <0x29>;

				pins_cmd0_dat {
					pinmux = <0x8c01>;
				};
			};

			aud_clk_mosi_off {
				linux,phandle = <0x26>;
				phandle = <0x26>;

				pins_cmd0_dat {
					pinmux = <0x8800>;
				};
			};

			aud_clk_mosi_on {
				linux,phandle = <0x27>;
				phandle = <0x27>;

				pins_cmd0_dat {
					pinmux = <0x8801>;
				};
			};

			aud_dat_miso_off {
				linux,phandle = <0x2c>;
				phandle = <0x2c>;

				pins_cmd1_dat {
					bias-disable;
					input-enable;
					pinmux = <0x8e00>;
					slew-rate = <0x0>;
				};

				pins_cmd2_dat {
					bias-disable;
					input-enable;
					pinmux = <0x8f00>;
					slew-rate = <0x0>;
				};
			};

			aud_dat_miso_on {
				linux,phandle = <0x2d>;
				phandle = <0x2d>;

				pins_cmd1_dat {
					pinmux = <0x8e01>;
				};

				pins_cmd2_dat {
					pinmux = <0x8f01>;
				};
			};

			aud_dat_mosi_off {
				linux,phandle = <0x2a>;
				phandle = <0x2a>;

				pins_cmd1_dat {
					bias-disable;
					input-enable;
					pinmux = <0x8a00>;
					slew-rate = <0x0>;
				};

				pins_cmd2_dat {
					bias-disable;
					input-enable;
					pinmux = <0x8b00>;
					slew-rate = <0x0>;
				};
			};

			aud_dat_mosi_on {
				linux,phandle = <0x2b>;
				phandle = <0x2b>;

				pins_cmd1_dat {
					pinmux = <0x8a01>;
				};

				pins_cmd2_dat {
					pinmux = <0x8b01>;
				};
			};

			aud_pins_dbmdx_off {
				linux,phandle = <0x2e>;
				phandle = <0x2e>;

				pins_cmd0_dat {
					pinmux = <0xe00>;
				};

				pins_cmd1_dat {
					pinmux = <0xf00>;
				};

				pins_cmd2_dat {
					pinmux = <0x1100>;
				};

				pins_cmd3_dat {
					pinmux = <0x1200>;
				};

				pins_cmd4_dat {
					pinmux = <0x1300>;
				};

				pins_cmd5_dat {
					pinmux = <0x1400>;
				};
			};

			aud_pins_dbmdx_on {
				linux,phandle = <0x2f>;
				phandle = <0x2f>;

				pins_cmd0_dat {
					pinmux = <0xe06>;
				};

				pins_cmd1_dat {
					pinmux = <0xf06>;
				};

				pins_cmd2_dat {
					pinmux = <0x1106>;
				};

				pins_cmd3_dat {
					pinmux = <0x1206>;
				};

				pins_cmd4_dat {
					pinmux = <0x1306>;
				};

				pins_cmd5_dat {
					pinmux = <0x1406>;
				};
			};

			aud_pins_hs_sw_off {
				linux,phandle = <0x30>;
				phandle = <0x30>;

				pins_cmd0_dat {
					output-low;
					pinmux = <0x6b00>;
					slew-rate = <0x1>;
				};

				pins_cmd1_dat {
					output-low;
					pinmux = <0xa000>;
					slew-rate = <0x1>;
				};
			};

			aud_pins_hs_sw_on {
				linux,phandle = <0x31>;
				phandle = <0x31>;

				pins_cmd0_dat {
					output-high;
					pinmux = <0x6b00>;
					slew-rate = <0x1>;
				};

				pins_cmd1_dat {
					output-high;
					pinmux = <0xa000>;
					slew-rate = <0x1>;
				};
			};
		};
	};

	fragment@25 {
		target = <0xffffffff>;

		__overlay__ {

			cam0@0 {
				linux,phandle = <0x33>;
				phandle = <0x33>;

				pins_cmd_dat {
					output-low;
					pinmux = <0x6500>;
					slew-rate = <0x1>;
				};
			};

			cam0@1 {
				linux,phandle = <0x34>;
				phandle = <0x34>;

				pins_cmd_dat {
					output-high;
					pinmux = <0x6500>;
					slew-rate = <0x1>;
				};
			};

			cam0@2 {
				linux,phandle = <0x35>;
				phandle = <0x35>;

				pins_cmd_dat {
					output-low;
					pinmux = <0x6100>;
					slew-rate = <0x1>;
				};
			};

			cam0@3 {
				linux,phandle = <0x36>;
				phandle = <0x36>;

				pins_cmd_dat {
					output-high;
					pinmux = <0x6100>;
					slew-rate = <0x1>;
				};
			};

			cam0@vcamd0 {
				linux,phandle = <0x40>;
				phandle = <0x40>;

				pins_cmd_dat {
					output-low;
					pinmux = <0x5800>;
					slew-rate = <0x1>;
				};
			};

			cam0@vcamd1 {
				linux,phandle = <0x3f>;
				phandle = <0x3f>;

				pins_cmd_dat {
					output-high;
					pinmux = <0x5800>;
					slew-rate = <0x1>;
				};
			};

			cam1@0 {
				linux,phandle = <0x37>;
				phandle = <0x37>;

				pins_cmd_dat {
					output-low;
					pinmux = <0x6600>;
					slew-rate = <0x1>;
				};
			};

			cam1@1 {
				linux,phandle = <0x38>;
				phandle = <0x38>;

				pins_cmd_dat {
					output-high;
					pinmux = <0x6600>;
					slew-rate = <0x1>;
				};
			};

			cam1@2 {
				linux,phandle = <0x39>;
				phandle = <0x39>;

				pins_cmd_dat {
					output-low;
					pinmux = <0x6200>;
					slew-rate = <0x1>;
				};
			};

			cam1@3 {
				linux,phandle = <0x3a>;
				phandle = <0x3a>;

				pins_cmd_dat {
					output-high;
					pinmux = <0x6200>;
					slew-rate = <0x1>;
				};
			};

			cam1@vcama0 {
				linux,phandle = <0x44>;
				phandle = <0x44>;
			};

			cam1@vcama1 {
				linux,phandle = <0x43>;
				phandle = <0x43>;
			};

			cam1@vcamd0 {
				linux,phandle = <0x42>;
				phandle = <0x42>;

				pins_cmd_dat {
					output-low;
					pinmux = <0xaa00>;
					slew-rate = <0x1>;
				};
			};

			cam1@vcamd1 {
				linux,phandle = <0x41>;
				phandle = <0x41>;

				pins_cmd_dat {
					output-high;
					pinmux = <0xaa00>;
					slew-rate = <0x1>;
				};
			};

			cam2@0 {
				linux,phandle = <0x3b>;
				phandle = <0x3b>;

				pins_cmd_dat {
					output-low;
					pinmux = <0x5700>;
					slew-rate = <0x1>;
				};
			};

			cam2@1 {
				linux,phandle = <0x3c>;
				phandle = <0x3c>;

				pins_cmd_dat {
					output-high;
					pinmux = <0x5700>;
					slew-rate = <0x1>;
				};
			};

			cam2@2 {
				linux,phandle = <0x3d>;
				phandle = <0x3d>;

				pins_cmd_dat {
					output-low;
					pinmux = <0xa000>;
					slew-rate = <0x1>;
				};
			};

			cam2@3 {
				linux,phandle = <0x3e>;
				phandle = <0x3e>;

				pins_cmd_dat {
					output-high;
					pinmux = <0xa000>;
					slew-rate = <0x1>;
				};
			};

			cam2@vcama0 {
				linux,phandle = <0x46>;
				phandle = <0x46>;

				pins_cmd_dat {
					output-low;
					pinmux = <0x9f00>;
					slew-rate = <0x1>;
				};
			};

			cam2@vcama1 {
				linux,phandle = <0x45>;
				phandle = <0x45>;

				pins_cmd_dat {
					output-high;
					pinmux = <0x9f00>;
					slew-rate = <0x1>;
				};
			};

			camdefault {
				linux,phandle = <0x32>;
				phandle = <0x32>;
			};

			camera_pins_cam0_mclk_off {
				linux,phandle = <0x48>;
				phandle = <0x48>;

				pins_cmd_dat {
					pinmux = <0x6300>;
				};
			};

			camera_pins_cam0_mclk_on {
				linux,phandle = <0x47>;
				phandle = <0x47>;

				pins_cmd_dat {
					pinmux = <0x6301>;
				};
			};

			camera_pins_cam1_mclk_off {
				linux,phandle = <0x4a>;
				phandle = <0x4a>;

				pins_cmd_dat {
					pinmux = <0x6400>;
				};
			};

			camera_pins_cam1_mclk_on {
				linux,phandle = <0x49>;
				phandle = <0x49>;

				pins_cmd_dat {
					pinmux = <0x6401>;
				};
			};

			camera_pins_cam2_mclk_off {
				linux,phandle = <0x4c>;
				phandle = <0x4c>;

				pins_cmd_dat {
					pinmux = <0x6c00>;
				};
			};

			camera_pins_cam2_mclk_on {
				linux,phandle = <0x4b>;
				phandle = <0x4b>;

				pins_cmd_dat {
					pinmux = <0x6c01>;
				};
			};
		};
	};

	fragment@26 {
		target = <0xffffffff>;

		__overlay__ {
			pinctrl-0 = <0x32>;
			pinctrl-1 = <0x33>;
			pinctrl-10 = <0x3c>;
			pinctrl-11 = <0x3d>;
			pinctrl-12 = <0x3e>;
			pinctrl-13 = <0x3f>;
			pinctrl-14 = <0x40>;
			pinctrl-15 = <0x41>;
			pinctrl-16 = <0x42>;
			pinctrl-17 = <0x43>;
			pinctrl-18 = <0x44>;
			pinctrl-19 = <0x45>;
			pinctrl-2 = <0x34>;
			pinctrl-20 = <0x46>;
			pinctrl-21 = <0x47>;
			pinctrl-22 = <0x48>;
			pinctrl-23 = <0x49>;
			pinctrl-24 = <0x4a>;
			pinctrl-25 = <0x4b>;
			pinctrl-26 = <0x4c>;
			pinctrl-3 = <0x35>;
			pinctrl-4 = <0x36>;
			pinctrl-5 = <0x37>;
			pinctrl-6 = <0x38>;
			pinctrl-7 = <0x39>;
			pinctrl-8 = <0x3a>;
			pinctrl-9 = <0x3b>;
			pinctrl-names = "default", "cam0_rst0", "cam0_rst1", "cam0_pnd0", "cam0_pnd1", "cam1_rst0", "cam1_rst1", "cam1_pnd0", "cam1_pnd1", "cam2_rst0", "cam2_rst1", "cam2_pnd0", "cam2_pnd1", "cam0_vcamd_on", "cam0_vcamd_off", "cam1_vcamd_on", "cam1_vcamd_off", "cam1_vcama_on", "cam1_vcama_off", "cam2_vcama_on", "cam2_vcama_off", "cam0_mclk_on", "cam0_mclk_off", "cam1_mclk_on", "cam1_mclk_off", "cam2_mclk_on", "cam2_mclk_off";
			status = "okay";
		};
	};

	fragment@27 {
		target = <0xffffffff>;

		__overlay__ {

			adc_channel@ {
				compatible = "mediatek,adc_channel";
				mediatek,adc_fdd_rf_params_dynamic_custom_ch = <0x2>;
				mediatek,temperature0 = <0x0>;
				mediatek,temperature1 = <0x1>;
				status = "okay";
			};
		};
	};

	fragment@28 {
		target = <0xffffffff>;

		__overlay__ {
			mediatek,clkbuf-config = <0x2 0x1 0x1 0x2 0x0 0x0 0x0>;
			mediatek,clkbuf-driving-current = <0x1 0x1 0x1 0x1 0x1 0x1 0x1>;
			mediatek,clkbuf-quantity = <0x7>;
			status = "okay";
		};
	};

	fragment@29 {
		target = <0xffffffff>;

		__overlay__ {
			#address-cells = <0x1>;
			#size-cells = <0x0>;
			clock-frequency = <0x61a80>;
			mediatek,use-push-pull;

			cap_touch@38 {
				compatible = "mediatek,cap_touch";
				linux,phandle = <0x56>;
				phandle = <0x56>;
				reg = <0x38>;
				status = "okay";
			};
		};
	};

	fragment@3 {
		target = <0xffffffff>;

		__overlay__ {
			pinctrl-0 = <0x1>;
			pinctrl-1 = <0x2>;
			pinctrl-2 = <0x3>;
			pinctrl-3 = <0x4>;
			pinctrl-4 = <0x5>;
			pinctrl-names = "default", "red_on", "red_off", "green_on", "green_off";
			status = "okay";
		};
	};

	fragment@30 {
		target = <0xffffffff>;

		__overlay__ {
			#address-cells = <0x1>;
			#size-cells = <0x0>;
			clock-frequency = <0x61a80>;
			mediatek,use-open-drain;
		};
	};

	fragment@31 {
		target = <0xffffffff>;

		__overlay__ {
			#address-cells = <0x1>;
			#size-cells = <0x0>;
			clock-frequency = <0x61a80>;
			mediatek,use-open-drain;

			camera_main@1a {
				compatible = "mediatek,camera_main";
				linux,phandle = <0x57>;
				phandle = <0x57>;
				reg = <0x1a>;
				status = "okay";
			};

			camera_main_af@18 {
				compatible = "mediatek,camera_main_af";
				linux,phandle = <0x59>;
				phandle = <0x59>;
				reg = <0x18>;
				status = "okay";
			};

			camera_main_eeprom@58 {
				compatible = "mediatek,camera_main_eeprom";
				linux,phandle = <0x58>;
				phandle = <0x58>;
				reg = <0x58>;
				status = "okay";
			};
		};
	};

	fragment@32 {
		target = <0xffffffff>;

		__overlay__ {
			#address-cells = <0x1>;
			#size-cells = <0x0>;
			clock-frequency = <0x61a80>;
			mediatek,use-open-drain;

			ext_buck_lp4@57 {
				compatible = "mediatek,ext_buck_lp4";
				linux,phandle = <0x5d>;
				phandle = <0x5d>;
				reg = <0x57>;
				status = "okay";
			};

			ext_buck_lp4x@50 {
				compatible = "mediatek,ext_buck_lp4x";
				linux,phandle = <0x5e>;
				phandle = <0x5e>;
				reg = <0x50>;
				status = "okay";
			};

			nfc@08 {
				compatible = "mediatek,nfc";
				linux,phandle = <0x5c>;
				phandle = <0x5c>;
				reg = <0x8>;
				status = "okay";
			};

			slave_charger@4b {
				compatible = "mediatek,slave_charger";
				linux,phandle = <0x5b>;
				phandle = <0x5b>;
				reg = <0x4b>;
				status = "okay";
			};

			speaker_amp@34 {
				compatible = "mediatek,speaker_amp";
				linux,phandle = <0x5a>;
				phandle = <0x5a>;
				reg = <0x34>;
				status = "okay";
			};
		};
	};

	fragment@33 {
		target = <0xffffffff>;

		__overlay__ {
			#address-cells = <0x1>;
			#size-cells = <0x0>;
			clock-frequency = <0x61a80>;
			mediatek,use-open-drain;

			camera_sub@2e {
				compatible = "mediatek,camera_sub";
				linux,phandle = <0x5f>;
				phandle = <0x5f>;
				reg = <0x2e>;
				status = "okay";
			};

			camera_sub_eeprom@52 {
				compatible = "mediatek,camera_sub_eeprom";
				linux,phandle = <0x60>;
				phandle = <0x60>;
				reg = <0x52>;
				status = "okay";
			};
		};
	};

	fragment@34 {
		target = <0xffffffff>;

		__overlay__ {
			#address-cells = <0x1>;
			#size-cells = <0x0>;
			clock-frequency = <0x61a80>;
			mediatek,use-open-drain;
		};
	};

	fragment@35 {
		target = <0xffffffff>;

		__overlay__ {
			#address-cells = <0x1>;
			#size-cells = <0x0>;
			clock-frequency = <0x61a80>;
			mediatek,use-open-drain;

			camera_main_two@2d {
				compatible = "mediatek,camera_main_two";
				linux,phandle = <0x61>;
				phandle = <0x61>;
				reg = <0x2d>;
				status = "okay";
			};

			camera_main_two_af@0c {
				compatible = "mediatek,camera_main_two_af";
				linux,phandle = <0x63>;
				phandle = <0x63>;
				reg = <0xc>;
				status = "okay";
			};

			camera_main_two_eeprom@50 {
				compatible = "mediatek,camera_main_two_eeprom";
				linux,phandle = <0x62>;
				phandle = <0x62>;
				reg = <0x50>;
				status = "okay";
			};

			ext_buck_vgpu@55 {
				compatible = "mediatek,ext_buck_vgpu";
				linux,phandle = <0x64>;
				phandle = <0x64>;
				reg = <0x55>;
				status = "okay";
			};
		};
	};

	fragment@36 {
		target = <0xffffffff>;

		__overlay__ {
			#address-cells = <0x1>;
			#size-cells = <0x0>;
			clock-frequency = <0x61a80>;
			mediatek,use-open-drain;
		};
	};

	fragment@37 {
		target = <0xffffffff>;

		__overlay__ {
			#address-cells = <0x1>;
			#size-cells = <0x0>;
			clock-frequency = <0x61a80>;
			mediatek,use-open-drain;
		};
	};

	fragment@38 {
		target = <0xffffffff>;

		__overlay__ {
			#address-cells = <0x1>;
			#size-cells = <0x0>;
			clock-frequency = <0x61a80>;
			mediatek,use-open-drain;
		};
	};

	fragment@39 {
		target = <0xffffffff>;

		__overlay__ {
			GPIO_FDD_BAND_SUPPORT_DETECT_1ST_PIN = <0xffffffff 0xa3 0x0>;
			GPIO_FDD_BAND_SUPPORT_DETECT_2ND_PIN = <0xffffffff 0xa4 0x0>;
			GPIO_FDD_BAND_SUPPORT_DETECT_3RD_PIN = <0xffffffff 0xa5 0x0>;
			GPIO_FDD_BAND_SUPPORT_DETECT_4TH_PIN = <0xffffffff 0xa6 0x0>;
			GPIO_SIM1_HOT_PLUG = <0xffffffff 0x2f 0x0>;
			GPIO_SIM1_SCLK = <0xffffffff 0x26 0x0>;
			GPIO_SIM1_SIO = <0xffffffff 0x28 0x0>;
			GPIO_SIM1_SRST = <0xffffffff 0x27 0x0>;
			GPIO_SIM2_HOT_PLUG = <0xffffffff 0x2e 0x0>;
			GPIO_SIM2_SCLK = <0xffffffff 0x25 0x0>;
			GPIO_SIM2_SIO = <0xffffffff 0x23 0x0>;
			GPIO_SIM2_SRST = <0xffffffff 0x24 0x0>;
		};
	};

	fragment@4 {
		target = <0xffffffff>;

		__overlay__ {

			greenoff {
				linux,phandle = <0x5>;
				phandle = <0x5>;

				pins_cmd_dat {
					output-low;
					pinmux = <0x0>;
					slew-rate = <0x1>;
				};
			};

			greenon {
				linux,phandle = <0x4>;
				phandle = <0x4>;

				pins_cmd_dat {
					output-high;
					pinmux = <0x0>;
					slew-rate = <0x1>;
				};
			};

			leddefault {
				linux,phandle = <0x1>;
				phandle = <0x1>;
			};

			redoff {
				linux,phandle = <0x3>;
				phandle = <0x3>;

				pins_cmd_dat {
					output-low;
					pinmux = <0x400>;
					slew-rate = <0x1>;
				};
			};

			redon {
				linux,phandle = <0x2>;
				phandle = <0x2>;

				pins_cmd_dat {
					output-high;
					pinmux = <0x400>;
					slew-rate = <0x1>;
				};
			};
		};
	};

	fragment@40 {
		target = <0xffffffff>;

		__overlay__ {
			gpio_init_default = <0x0 0x0 0x1 0x0 0x1 0x0 0x1 0x1 0x0 0x0 0x0 0x1 0x1 0x1 0x2 0x0 0x0 0x0 0x0 0x0 0x1 0x3 0x0 0x0 0x0 0x1 0x1 0x0 0x4 0x0 0x1 0x0 0x1 0x0 0x0 0x5 0x0 0x0 0x0 0x1 0x1 0x0 0x6 0x0 0x0 0x0 0x1 0x1 0x0 0x7 0x0 0x0 0x0 0x1 0x0 0x0 0x8 0x7 0x0 0x0 0x1 0x1 0x0 0x9 0x0 0x0 0x0 0x1 0x1 0x0 0xa 0x0 0x0 0x0 0x1 0x1 0x0 0xb 0x0 0x0 0x0 0x1 0x1 0x0 0xc 0x0 0x0 0x0 0x1 0x1 0x0 0xd 0x0 0x1 0x0 0x1 0x0 0x0 0xe 0x6 0x0 0x0 0x0 0x0 0x0 0xf 0x6 0x0 0x0 0x0 0x0 0x0 0x10 0x3 0x0 0x0 0x0 0x0 0x0 0x11 0x6 0x0 0x0 0x1 0x0 0x0 0x12 0x6 0x0 0x0 0x0 0x0 0x0 0x13 0x6 0x0 0x0 0x0 0x0 0x0 0x14 0x6 0x0 0x0 0x0 0x0 0x0 0x15 0x1 0x0 0x0 0x1 0x0 0x0 0x16 0x1 0x1 0x0 0x0 0x0 0x0 0x17 0x1 0x1 0x0 0x0 0x0 0x0 0x18 0x1 0x1 0x0 0x0 0x0 0x0 0x19 0x3 0x0 0x0 0x1 0x0 0x0 0x1a 0x3 0x0 0x0 0x1 0x0 0x0 0x1b 0x3 0x0 0x0 0x0 0x0 0x0 0x1c 0x0 0x1 0x1 0x1 0x0 0x0 0x1d 0x1 0x0 0x0 0x1 0x0 0x1 0x1e 0x1 0x0 0x0 0x1 0x0 0x1 0x1f 0x1 0x0 0x0 0x1 0x0 0x1 0x20 0x1 0x0 0x0 0x1 0x0 0x1 0x21 0x1 0x0 0x0 0x1 0x0 0x1 0x22 0x1 0x0 0x0 0x1 0x0 0x1 0x23 0x1 0x0 0x0 0x1 0x1 0x0 0x24 0x1 0x0 0x0 0x0 0x0 0x0 0x25 0x1 0x0 0x0 0x0 0x0 0x0 0x26 0x1 0x0 0x0 0x0 0x0 0x0 0x27 0x1 0x0 0x0 0x0 0x0 0x0 0x28 0x1 0x0 0x0 0x1 0x1 0x0 0x29 0x1 0x0 0x0 0x1 0x1 0x0 0x2a 0x0 0x0 0x0 0x1 0x0 0x0 0x2b 0x1 0x0 0x0 0x0 0x0 0x0 0x2c 0x1 0x0 0x0 0x1 0x0 0x0 0x2d 0x0 0x1 0x0 0x0 0x0 0x0 0x2e 0x1 0x0 0x0 0x1 0x1 0x0 0x2f 0x1 0x0 0x0 0x1 0x1 0x0 0x30 0x1 0x0 0x0 0x1 0x1 0x1 0x31 0x1 0x0 0x0 0x1 0x1 0x1 0x32 0x1 0x0 0x0 0x1 0x1 0x1 0x33 0x1 0x0 0x0 0x1 0x1 0x1 0x34 0x1 0x0 0x0 0x1 0x0 0x0 0x35 0x1 0x0 0x0 0x1 0x0 0x0 0x36 0x1 0x0 0x0 0x1 0x0 0x0 0x37 0x1 0x0 0x0 0x1 0x0 0x0 0x38 0x1 0x0 0x0 0x1 0x0 0x0 0x39 0x1 0x0 0x0 0x1 0x0 0x0 0x3a 0x0 0x0 0x0 0x1 0x0 0x0 0x3b 0x1 0x0 0x0 0x1 0x0 0x0 0x3c 0x1 0x0 0x0 0x1 0x0 0x0 0x3d 0x1 0x0 0x0 0x1 0x0 0x0 0x3e 0x1 0x0 0x0 0x1 0x0 0x0 0x3f 0x1 0x0 0x0 0x1 0x0 0x0 0x40 0x1 0x0 0x0 0x1 0x0 0x0 0x41 0x1 0x0 0x0 0x1 0x0 0x0 0x42 0x1 0x0 0x0 0x1 0x0 0x0 0x43 0x1 0x0 0x0 0x1 0x0 0x0 0x44 0x1 0x0 0x0 0x1 0x0 0x0 0x45 0x1 0x0 0x0 0x1 0x0 0x0 0x46 0x1 0x0 0x0 0x1 0x0 0x0 0x47 0x1 0x0 0x0 0x1 0x0 0x0 0x48 0x1 0x0 0x0 0x1 0x0 0x0 0x49 0x0 0x0 0x0 0x0 0x0 0x0 0x4a 0x1 0x0 0x0 0x1 0x0 0x0 0x4b 0x1 0x0 0x0 0x1 0x0 0x0 0x4c 0x1 0x0 0x0 0x1 0x0 0x0 0x4d 0x1 0x0 0x0 0x1 0x0 0x0 0x4e 0x1 0x0 0x0 0x1 0x0 0x0 0x4f 0x1 0x0 0x0 0x1 0x0 0x0 0x50 0x1 0x0 0x0 0x1 0x0 0x0 0x51 0x1 0x0 0x0 0x1 0x1 0x1 0x52 0x1 0x0 0x0 0x1 0x1 0x1 0x53 0x1 0x0 0x0 0x1 0x1 0x1 0x54 0x1 0x0 0x0 0x1 0x1 0x1 0x55 0x1 0x0 0x0 0x1 0x0 0x0 0x56 0x1 0x0 0x0 0x1 0x0 0x0 0x57 0x0 0x1 0x1 0x1 0x0 0x0 0x58 0x0 0x1 0x0 0x1 0x0 0x0 0x59 0x1 0x0 0x0 0x1 0x0 0x0 0x5a 0x2 0x0 0x0 0x0 0x0 0x0 0x5b 0x0 0x1 0x0 0x1 0x0 0x0 0x5c 0x0 0x0 0x0 0x1 0x0 0x0 0x5d 0x1 0x0 0x0 0x1 0x1 0x0 0x5e 0x1 0x0 0x0 0x1 0x1 0x0 0x5f 0x1 0x0 0x0 0x1 0x1 0x0 0x60 0x1 0x0 0x0 0x0 0x0 0x0 0x61 0x0 0x1 0x0 0x1 0x0 0x0 0x62 0x0 0x1 0x0 0x1 0x0 0x0 0x63 0x1 0x0 0x0 0x0 0x0 0x0 0x64 0x1 0x0 0x0 0x0 0x0 0x0 0x65 0x0 0x1 0x1 0x1 0x0 0x0 0x66 0x0 0x1 0x1 0x1 0x0 0x0 0x67 0x1 0x0 0x0 0x1 0x1 0x1 0x68 0x1 0x0 0x0 0x1 0x1 0x1 0x69 0x1 0x0 0x0 0x1 0x1 0x1 0x6a 0x1 0x0 0x0 0x1 0x1 0x1 0x6b 0x2 0x0 0x0 0x0 0x0 0x0 0x6c 0x1 0x0 0x0 0x0 0x0 0x0 0x6d 0x2 0x0 0x0 0x1 0x1 0x0 0x6e 0x0 0x0 0x0 0x1 0x0 0x0 0x6f 0x0 0x0 0x0 0x1 0x0 0x0 0x70 0x0 0x0 0x0 0x1 0x0 0x0 0x71 0x0 0x0 0x0 0x1 0x0 0x0 0x72 0x0 0x0 0x0 0x1 0x0 0x0 0x73 0x0 0x0 0x0 0x1 0x0 0x0 0x74 0x0 0x0 0x0 0x1 0x0 0x0 0x75 0x0 0x0 0x0 0x1 0x0 0x0 0x76 0x0 0x0 0x0 0x1 0x0 0x0 0x77 0x0 0x0 0x0 0x1 0x0 0x0 0x78 0x0 0x0 0x0 0x1 0x0 0x0 0x79 0x0 0x0 0x0 0x1 0x0 0x0 0x86 0x1 0x0 0x0 0x1 0x0 0x1 0x87 0x1 0x0 0x0 0x0 0x0 0x0 0x88 0x1 0x0 0x0 0x0 0x0 0x0 0x89 0x1 0x0 0x0 0x0 0x0 0x0 0x8a 0x1 0x0 0x0 0x0 0x0 0x0 0x8b 0x1 0x0 0x0 0x0 0x0 0x0 0x8c 0x1 0x0 0x0 0x1 0x0 0x0 0x8d 0x1 0x0 0x0 0x1 0x0 0x0 0x8e 0x1 0x0 0x0 0x1 0x0 0x0 0x8f 0x1 0x0 0x0 0x1 0x0 0x0 0x90 0x1 0x0 0x0 0x1 0x0 0x0 0x91 0x1 0x0 0x0 0x0 0x0 0x0 0x92 0x1 0x0 0x0 0x1 0x0 0x0 0x93 0x1 0x0 0x0 0x0 0x0 0x0 0x94 0x1 0x0 0x0 0x0 0x0 0x0 0x95 0x1 0x0 0x0 0x0 0x0 0x0 0x96 0x0 0x1 0x0 0x1 0x0 0x0 0x97 0x6 0x0 0x0 0x1 0x0 0x0 0x98 0x5 0x0 0x0 0x1 0x1 0x0 0x99 0x5 0x0 0x0 0x1 0x0 0x0 0x9a 0x0 0x1 0x1 0x1 0x0 0x0 0x9b 0x7 0x0 0x0 0x0 0x0 0x0 0x9c 0x7 0x0 0x0 0x1 0x0 0x0 0x9d 0x7 0x0 0x0 0x1 0x0 0x0 0x9e 0x7 0x0 0x0 0x1 0x0 0x0 0x9f 0x0 0x1 0x0 0x1 0x0 0x0 0xa0 0x0 0x1 0x0 0x1 0x0 0x0 0xa1 0x1 0x0 0x0 0x1 0x1 0x1 0xa2 0x1 0x0 0x0 0x1 0x1 0x1 0xa3 0x0 0x0 0x0 0x1 0x0 0x0 0xa4 0x0 0x0 0x0 0x1 0x0 0x0 0xa5 0x0 0x0 0x0 0x1 0x0 0x0 0xa6 0x0 0x0 0x0 0x1 0x0 0x0 0xa7 0x0 0x1 0x0 0x0 0x0 0x0 0xa8 0x0 0x1 0x0 0x0 0x0 0x0 0xa9 0x0 0x1 0x0 0x1 0x0 0x0 0xaa 0x0 0x1 0x0 0x1 0x0 0x0 0xab 0x0 0x0 0x0 0x1 0x0 0x0 0xac 0x0 0x1 0x0 0x0 0x0 0x0 0xad 0x0 0x1 0x0 0x1 0x0 0x0 0xae 0x0 0x1 0x1 0x1 0x0 0x0 0xaf 0x0 0x1 0x0 0x1 0x0 0x0 0xb0 0x0 0x1 0x0 0x1 0x0 0x0 0xb1 0x0 0x1 0x0 0x1 0x0 0x0 0xb2 0x0 0x1 0x0 0x1 0x0 0x0 0xb3 0x0 0x0 0x0 0x1 0x0 0x0>;
		};
	};

	fragment@41 {
		target = <0xffffffff>;

		__overlay__ {
			interrupt-parent = <0xffffffff>;
			interrupts = <0x1 0x1 0x1 0x0>;
			status = "okay";
		};
	};

	fragment@42 {
		target = <0xffffffff>;

		__overlay__ {
			interrupt-parent = <0xffffffff>;
			interrupts = <0x7 0x8 0x7 0x0>;
			status = "okay";
		};
	};

	fragment@43 {
		target = <0xffffffff>;

		__overlay__ {
			interrupt-parent = <0xffffffff>;
			interrupts = <0xa 0x2 0xa 0x0>;
			status = "okay";
		};
	};

	fragment@44 {
		target = <0xffffffff>;

		__overlay__ {
			interrupt-parent = <0xffffffff>;
			interrupts = <0xb 0x2 0xb 0x0>;
			status = "okay";
		};
	};

	fragment@45 {
		target = <0xffffffff>;

		__overlay__ {
			interrupt-parent = <0xffffffff>;
			interrupts = <0x2c 0x1 0x2c 0x1>;
			status = "okay";
		};
	};

	fragment@46 {
		target = <0xffffffff>;

		__overlay__ {
			deb-gpios = <0xffffffff 0x49 0x0>;
			debounce = <0x3e800>;
			interrupt-parent = <0xffffffff>;
			interrupts = <0x49 0x4 0x49 0x0>;
			status = "okay";
		};
	};

	fragment@47 {
		target = <0xffffffff>;

		__overlay__ {
			interrupt-parent = <0xffffffff>;
			interrupts = <0x90 0x4 0x90 0x1>;
			status = "okay";
		};
	};

	fragment@48 {
		target = <0xffffffff>;

		__overlay__ {
			interrupt-parent = <0xffffffff>;
			interrupts = <0x93 0x8 0x29 0x1>;
			status = "okay";
		};
	};

	fragment@49 {
		target = <0xffffffff>;

		__overlay__ {
			compatible = "mediatek,md1_sim1_hot_plug_eint-eint";
			debounce = <0x0 0x2710>;
			dedicated = <0x0 0x0>;
			interrupts = <0x0 0x8>;
			sockettype = <0x0 0x0>;
			src_pin = <0x0 0x1>;
			status = "okay";
		};
	};

	fragment@5 {
		target = <0xffffffff>;

		__overlay__ {

			cap_touch@38 {
				compatible = "mediatek,cap_touch";
				reg = <0x38>;
				status = "okay";
			};
		};
	};

	fragment@50 {
		target = <0xffffffff>;

		__overlay__ {
			regulator-default-on = <0x1>;
			regulator-name = "vcama";
			status = "okay";
		};
	};

	fragment@51 {
		target = <0xffffffff>;

		__overlay__ {
			regulator-default-on = <0x1>;
			regulator-name = "vsim1";
			status = "okay";
		};
	};

	fragment@52 {
		target = <0xffffffff>;

		__overlay__ {
			regulator-default-on = <0x1>;
			regulator-name = "vsim2";
			status = "okay";
		};
	};

	fragment@53 {
		target = <0xffffffff>;

		__overlay__ {
			regulator-default-on = <0x1>;
			regulator-name = "vcamd";
			status = "okay";
		};
	};

	fragment@54 {
		target = <0xffffffff>;

		__overlay__ {
			regulator-default-on = <0x1>;
			regulator-name = "vcamio";
			status = "okay";
		};
	};

	fragment@55 {
		target = <0xffffffff>;

		__overlay__ {
			regulator-default-on = <0x1>;
			regulator-name = "vldo28";
			status = "okay";
		};
	};

	fragment@56 {
		target = <0xffffffff>;

		__overlay__ {
			status = "okay";
			vcama-supply = <0xffffffff>;
			vcama_sub-supply = <0xffffffff>;
			vcamaf-supply = <0xffffffff>;
			vcamaf_main2-supply = <0xffffffff>;
			vcamaf_sub-supply = <0xffffffff>;
			vcamd_main2-supply = <0xffffffff>;
			vcamd_sub-supply = <0xffffffff>;
			vcamio-supply = <0xffffffff>;
			vcamio_main2-supply = <0xffffffff>;
			vcamio_sub-supply = <0xffffffff>;
		};
	};

	fragment@57 {
		target = <0xffffffff>;

		__overlay__ {
			status = "okay";
			vtouch-supply = <0xffffffff>;
		};
	};

	fragment@58 {
		target = <0xffffffff>;

		__overlay__ {
			mediatek,kpd-hw-dl-key0 = <0x11>;
			mediatek,kpd-hw-dl-key2 = <0x8>;
			mediatek,kpd-hw-factory-key = <0x0>;
			mediatek,kpd-hw-init-map = <0x72 0x0 0x0 0x0 0x0 0x0 0x0 0x0 0x0 0x0 0x0 0x0 0x0 0x0 0x0 0x0 0x0 0x0 0x0 0x0 0x0 0x0 0x0 0x0 0x0 0x0 0x0 0x0 0x0 0x0 0x0 0x0 0x0 0x0 0x0 0x0 0x0 0x0 0x0 0x0 0x0 0x0 0x0 0x0 0x0 0x0 0x0 0x0 0x0 0x0 0x0 0x0 0x0 0x0 0x0 0x0 0x0 0x0 0x0 0x0 0x0 0x0 0x0 0x0 0x0 0x0 0x0 0x0 0x0 0x0 0x0 0x0>;
			mediatek,kpd-hw-map-num = <0x48>;
			mediatek,kpd-hw-pwrkey = <0x8>;
			mediatek,kpd-hw-recovery-key = <0x11>;
			mediatek,kpd-hw-rstkey = <0x11>;
			mediatek,kpd-key-debounce = <0x400>;
			mediatek,kpd-pwkey-gpio-din = <0x0>;
			mediatek,kpd-pwrkey-eint-gpio = <0x0>;
			mediatek,kpd-sw-pwrkey = <0x74>;
			mediatek,kpd-sw-rstkey = <0x73>;
			mediatek,kpd-use-extend-type = <0x0>;
			status = "okay";
		};
	};

	fragment@6 {
		target = <0xffffffff>;

		__overlay__ {
			#address-cells = <0x1>;
			#size-cells = <0x0>;
			clock-frequency = <0x61a80>;

			mtk-usb@60 {
				compatible = "mediatek,mtk-usb";
				reg = <0x60>;
				status = "okay";
			};
		};
	};

	fragment@7 {
		target = <0xffffffff>;

		__overlay__ {

			ext_buck_lp4@57 {
				regulator-max-microvolt = <0x13d620>;
				regulator-min-microvolt = <0x493e0>;
				regulator-name = "ext_buck_vdd2";
				vsel_pin = <0x0>;
			};

			ext_buck_lp4x@50 {
				regulator-max-microvolt = <0x13d620>;
				regulator-min-microvolt = <0x493e0>;
				regulator-name = "ext_buck_vddq";
				vsel_pin = <0x1>;
			};

			mic_array@38 {
				compatible = "ac107_0";
				pinctrl-0 = <0x6>;
				pinctrl-1 = <0x7>;
				pinctrl-names = "state_power_off", "state_power_on";
				reg = <0x38>;
			};

			sx9311@28 {
				Semtech,reg-init = <0x3 0x70 0x4 0x0 0x10 0x27 0x11 0x0 0x12 0xb 0x13 0xa 0x14 0x25 0x15 0xc3 0x16 0x20 0x17 0x4c 0x18 0x28 0x19 0x38 0x1a 0x10 0x1b 0x0 0x1c 0x0 0x1d 0x0 0x1e 0x0 0x1f 0x0 0x20 0x0 0x21 0x18 0x22 0x25 0x23 0x0 0x2a 0x1>;
				compatible = "mediatek,SAR";
				int-gpio = <0xffffffff 0xb 0x0>;
				interrupt-parent = <0xffffffff>;
				interrupts = <0xb 0x2 0xb 0x0>;
				polling_mode = <0x0>;
				power_id = <0xffff>;
				power_vol = <0x0>;
				reg = <0x28>;
				status = "okay";
			};
		};
	};

	fragment@8 {
		target = <0xffffffff>;

		__overlay__ {

			aud_pins_ac107_off {
				linux,phandle = <0x6>;
				phandle = <0x6>;

				pins_cmd_dat {
					output-low;
					pinmux = <0x5700>;
					slew-rate = <0x1>;
				};
			};

			aud_pins_ac107_on {
				linux,phandle = <0x7>;
				phandle = <0x7>;

				pins_cmd_dat {
					output-high;
					pinmux = <0x5700>;
					slew-rate = <0x1>;
				};
			};
		};
	};

	fragment@9 {
		target = <0xffffffff>;

		__overlay__ {

			aw87519@58 {
				compatible = "awinic,aw87519_left";
				reg = <0x58>;
				reset-gpio = <0xffffffff 0xae 0x0>;
				status = "okay";
			};

			aw87519@5b {
				compatible = "awinic,aw87519_right";
				reg = <0x5b>;
				reset-gpio = <0xffffffff 0x99 0x0>;
				status = "okay";
			};

			ext_buck_vgpu@55 {
				regulator-max-microvolt = <0x13d620>;
				regulator-min-microvolt = <0x493e0>;
				regulator-name = "ext_buck_vgpu";
				vsel_pin = <0x2>;
			};
		};
	};
};
